## tools/test_apps/system/clang_build_test/sdkconfig.defaults
```kconfig
CONFIG_PARTITION_TABLE_OFFSET=0x9000
CONFIG_BT_ENABLED=y
CONFIG_FREERTOS_TASK_FUNCTION_WRAPPER=n

# want to test clang build with HAL assertion disabled
CONFIG_HAL_ASSERTION_DISABLE=y
```

## tools/test_apps/system/cxx_pthread_bluetooth/sdkconfig.defaults
```kconfig
CONFIG_PARTITION_TABLE_OFFSET=0x9000
CONFIG_BT_ENABLED=y
CONFIG_FREERTOS_TASK_FUNCTION_WRAPPER=n
```

## tools/test_apps/system/eh_frame/sdkconfig.defaults
```kconfig
# Enable eh_frame sections generation
CONFIG_ESP_SYSTEM_USE_EH_FRAME=y
# use non-rom systimer implementation, can't backtrace functions in ROM
CONFIG_HAL_SYSTIMER_USE_ROM_IMPL=n
```

## tools/test_apps/system/esp_intr_dump/sdkconfig.defaults
```kconfig
# The Wi-Fi task otherwise runs on core 0, which reserves CPU0 interrupt 0 for WMAC, so the "test_esp_intr_dump_expected_output" case no longer finds "Used: RTC_CORE" on interrupt 0 and fails. Pin the Wi-Fi task to core 1 to keep interrupt 0 free.
CONFIG_ESP_WIFI_TASK_PINNED_TO_CORE_1=y
```

## tools/test_apps/system/flash_psram/sdkconfig.defaults
```kconfig
CONFIG_FREERTOS_HZ=1000
CONFIG_ESP_TASK_WDT_EN=n

CONFIG_PARTITION_TABLE_CUSTOM=y
CONFIG_PARTITION_TABLE_CUSTOM_FILENAME="partitions.csv"
CONFIG_PARTITION_TABLE_FILENAME="partitions.csv"

# For test access psram with DFS enabled
CONFIG_SPIRAM_FETCH_INSTRUCTIONS=y
CONFIG_SPIRAM_RODATA=y
CONFIG_PM_ENABLE=y
CONFIG_FREERTOS_USE_TICKLESS_IDLE=y
CONFIG_FREERTOS_IDLE_TIME_BEFORE_SLEEP=5
```

## tools/test_apps/system/g0_components/sdkconfig.defaults
```kconfig
# G0 components test does not use IDF's linker scripts, so stray sections could exist.
# Suppress linker's messages about orphan sections.
CONFIG_COMPILER_ORPHAN_SECTIONS_PLACE=y
```

## tools/test_apps/system/gdb_loadable_elf/sdkconfig.defaults
```kconfig
CONFIG_APP_BUILD_TYPE_RAM=y
CONFIG_VFS_SUPPORT_TERMIOS=n
CONFIG_NEWLIB_NANO_FORMAT=y
CONFIG_ESP_SYSTEM_PANIC_PRINT_HALT=y
CONFIG_ESP_DEBUG_STUBS_ENABLE=n
CONFIG_ESP_ERR_TO_NAME_LOOKUP=n
```

## tools/test_apps/system/kasan_test/sdkconfig.defaults
```kconfig
# Minimal KASAN enablement — everything else stays at Kconfig defaults
# (redzone=8, quarantine=8192, heap poisoning=disabled, HEAP_USE_HOOKS selected).

CONFIG_IDF_EXPERIMENTAL_FEATURES=y
CONFIG_COMPILER_KASAN=y
CONFIG_ESP_TASK_WDT_EN=n
```

## tools/test_apps/system/log/main/Kconfig.projbuild
```kconfig
menu "Example Configuration"

    config EXAMPLE_USE_TEXT_LOG
        bool "Use text log mode for main file"
        default n
        help
            Enable this option to compile logs in the main file as text logs
            even if global binary logging is enabled.
            Used for testing purposes.

endmenu
```

## tools/test_apps/system/longjmp_test/sdkconfig.defaults
```kconfig
CONFIG_COMPILER_OPTIMIZATION_PERF=y

CONFIG_ESP_INT_WDT=n
CONFIG_ESP_TASK_WDT_EN=n

CONFIG_ESP_SYSTEM_PANIC_PRINT_REBOOT=y

CONFIG_ESP_TIMER_TASK_STACK_SIZE=3584

CONFIG_FREERTOS_UNICORE=y
CONFIG_FREERTOS_HZ=1000
```

## tools/test_apps/system/memprot/sdkconfig.defaults
```kconfig
CONFIG_ESP_SYSTEM_MEMPROT=y
CONFIG_ESP_SYSTEM_MEMPROT_PMS_LOCK=n
CONFIG_ESP_SYSTEM_MEMPROT_PMS_TEST=y
```

## tools/test_apps/system/mmu_page_size/sdkconfig.defaults
```kconfig
CONFIG_PARTITION_TABLE_CUSTOM=y
CONFIG_PARTITION_TABLE_OFFSET=0xa000
CONFIG_SECURE_SIGNED_APPS_NO_SECURE_BOOT=y
CONFIG_ESP_MAIN_TASK_STACK_SIZE=4096
```

## tools/test_apps/system/monitor_addr_lookup/main/Kconfig.projbuild
```kconfig
config TEST_ADDR_LOOKUP_IN_APP
    bool "TEST_ADDR_LOOKUP_IN_APP"
    default n

config TEST_ADDR_LOOKUP_IN_ROM
    bool "TEST_ADDR_LOOKUP_IN_ROM"
    default n
```

## tools/test_apps/system/panic/coredump/sdkconfig.defaults
```kconfig
# Flash DOUT mode (QEMU limitation)
CONFIG_ESPTOOLPY_FLASHMODE_DOUT=y

# Less noisy output
CONFIG_BOOTLOADER_LOG_LEVEL_WARN=y
CONFIG_LOG_DEFAULT_LEVEL_WARN=y

# To check for stack overflows
CONFIG_FREERTOS_WATCHPOINT_END_OF_STACK=y

# To panic on task WDT
CONFIG_ESP_TASK_WDT_PANIC=y

# For vTaskGetInfo() used in test_stack_overflow()
CONFIG_FREERTOS_USE_TRACE_FACILITY=y

# Increase main task stack size
CONFIG_ESP_MAIN_TASK_STACK_SIZE=4096

# CONFIG_VFS_SUPPORT_IO resolves to its default (y) in this test's Kconfig closure; the extra console I/O task makes the core dump header declare more bytes than are emitted, so espcoredump.py info_corefile fails to parse it in the "test_hw_stack_guard_cpu0" case. Disable it.
CONFIG_VFS_SUPPORT_IO=n
```

## tools/test_apps/system/panic/main/Kconfig.projbuild
```kconfig
menu "Test-app Configuration"

    config TEST_MEMPROT
        bool "Enable memprot test"

endmenu
```

## tools/test_apps/system/panic/sdkconfig.defaults
```kconfig
# Flash DOUT mode (QEMU limitation)
CONFIG_ESPTOOLPY_FLASHMODE_DOUT=y

# Less noisy output
CONFIG_BOOTLOADER_LOG_LEVEL_WARN=y
CONFIG_LOG_DEFAULT_LEVEL_WARN=y

# To check for stack overflows
CONFIG_FREERTOS_WATCHPOINT_END_OF_STACK=y

# To panic on task WDT
CONFIG_ESP_TASK_WDT_PANIC=y

# For vTaskGetInfo() used in test_stack_overflow()
CONFIG_FREERTOS_USE_TRACE_FACILITY=y

# Reduce IRAM size
CONFIG_FREERTOS_PLACE_FUNCTIONS_INTO_FLASH=y

# Increase main task stack size
CONFIG_ESP_MAIN_TASK_STACK_SIZE=4096
```

## tools/test_apps/system/psram_stack/sdkconfig.defaults
```kconfig
CONFIG_SPIRAM=y
CONFIG_FREERTOS_TASK_CREATE_ALLOW_EXT_MEM=y
CONFIG_FREERTOS_PLACE_TASK_STACKS_IN_EXT_RAM=y
```

## tools/test_apps/system/ram_loadable_app/sdkconfig.defaults
```kconfig
CONFIG_APP_BUILD_TYPE_RAM=y

# Reset is meaningless to ram_app
CONFIG_ESP_SYSTEM_PANIC_PRINT_HALT=y

CONFIG_APP_BUILD_TYPE_PURE_RAM_APP=n
```

## tools/test_apps/system/ram_loadable_app/sdkconfig.defaults.esp32
```kconfig
CONFIG_APP_BUILD_TYPE_RAM=y

# Save size
CONFIG_VFS_SUPPORT_TERMIOS=n

# Reset is meaningless to ram_app
CONFIG_ESP_SYSTEM_PANIC_PRINT_HALT=y

CONFIG_APP_BUILD_TYPE_PURE_RAM_APP=y
```

## tools/test_apps/system/rtc_mem_reserve/sdkconfig.defaults
```kconfig
CONFIG_BOOTLOADER_RESERVE_RTC_SIZE=0x10
CONFIG_BOOTLOADER_CUSTOM_RESERVE_RTC=y
CONFIG_BOOTLOADER_CUSTOM_RESERVE_RTC_SIZE=0x200
CONFIG_ESP_TASK_WDT_EN=n
CONFIG_HEAP_POISONING_COMPREHENSIVE=y

# Enable ULP
CONFIG_ULP_COPROC_ENABLED=y
CONFIG_ULP_COPROC_TYPE_LP_CORE=y
CONFIG_ULP_COPROC_RESERVE_MEM=4096
```

## tools/test_apps/system/startup/main/Kconfig
```kconfig
menu "Test app config"
    config SINGLE_CORE_VARIANT
        bool "Patch esp_chip_info to return single core in a multicore chip"
        default "n"
        depends on IDF_TARGET_ESP32 || IDF_TARGET_ESP32S3
endmenu
```

## tools/test_apps/system/test_api_check/sdkconfig.defaults.esp32p4
```kconfig
# Clang toolchain doesn't support ESP32-P4 rev >= 3.0
CONFIG_ESP32P4_REV_MIN_100=y
CONFIG_ESP32P4_SELECTS_REV_LESS_V3=y
```

## tools/test_apps/system/ulp/full_subproject/lp_core/main/ulp/components/ulp_math/Kconfig
```kconfig
menu "ULP Math Component"

    config ULP_MATH_ENABLED
        bool "Enable ULP math multiplication"
        default y
        help
            When enabled, the ULP program will compute a product using the
            ulp_math component.

endmenu
```
