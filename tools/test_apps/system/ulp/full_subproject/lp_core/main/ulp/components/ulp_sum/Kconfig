## tools/test_apps/system/ulp/full_subproject/lp_core/main/ulp/components/ulp_sum/Kconfig
```kconfig
menu "ULP Sum Component"

    config ULP_SUM_ENABLED
        bool "Enable ULP sum function"
        default y
        help
            When enabled, the ULP program will compute a sum using the
            ulp_sum component.

endmenu
```

## tools/test_apps/system/ulp/full_subproject/lp_core/main/ulp/extra/ulp_clamp/Kconfig
```kconfig
menu "ULP Clamp Component"

    config ULP_CLAMP_MAX_VALUE
        int "Maximum clamp value"
        default 255
        help
            The upper bound used by the ulp_clamp() function.

endmenu
```

## tools/test_build_system/build_test_app/main/KConfig.projbuild
```kconfig
# Misspelled Kconfig file checks whether it is picked up by the build system
config FROM_MISSPELLED_KCONFIG
    bool "From misspelled Kconfig"
    default y
```

## tools/test_build_system/configdep_test_app/main/Kconfig.projbuild
```kconfig
menu "Configdep Test"
    config TEST_CONFIGDEP_OPTION
        bool "Test configdep option"
        default y
endmenu
```

## tools/unit-test-app/components/test_utils/Kconfig
```kconfig
menu "IDF unit test"

    config UNITY_FREERTOS_PRIORITY
        int "Priority of Unity test task"
        default 5

    config UNITY_FREERTOS_CPU
        int "CPU to run Unity test task on"
        default 0

    config UNITY_FREERTOS_STACK_SIZE
        int "Stack size of Unity test task, in bytes"
        default 8192

    config UNITY_WARN_LEAK_LEVEL_GENERAL
        int "Leak warning level"
        default 255

    config UNITY_CRITICAL_LEAK_LEVEL_GENERAL
        int "Critical leak"
        default 1024

    config UNITY_CRITICAL_LEAK_LEVEL_LWIP
        int "Critical leak for UT which use LWIP component"
        default 4095

endmenu
```

## tools/unit-test-app/components/unity/Kconfig
```kconfig
menu "Unity test framework"

config UNITY_FREERTOS_PRIORITY
	int "Priority of Unity test task"
	default 5

config UNITY_FREERTOS_CPU
	int "CPU to run Unity test task on"
	default 0

config UNITY_FREERTOS_STACK_SIZE
	int "Stack size of Unity test task, in bytes"
	default 8192

endmenu

menu "Test options"

config TEST_ESP32_SUBTEST_ONLY
    bool "Test only 4M PSRAM cases for esp32 component"
    depends on SPIRAM_SUPPORT
    default n
    help
        If this option is enabled, only 4M PSRAM cases are compiled. Otherwise all cases are included.

endmenu
```

## tools/unit-test-app/sdkconfig.defaults
```kconfig
CONFIG_BOOTLOADER_LOG_LEVEL_WARN=y
CONFIG_ESPTOOLPY_FLASHSIZE_4MB=y
CONFIG_PARTITION_TABLE_CUSTOM=y
CONFIG_PARTITION_TABLE_CUSTOM_FILENAME="partition_table_unit_test_app.csv"
CONFIG_PARTITION_TABLE_FILENAME="partition_table_unit_test_app.csv"
CONFIG_PARTITION_TABLE_OFFSET=0x8000
CONFIG_FREERTOS_HZ=1000
CONFIG_FREERTOS_WATCHPOINT_END_OF_STACK=y
CONFIG_HEAP_POISONING_COMPREHENSIVE=y
CONFIG_SPI_FLASH_ENABLE_COUNTERS=y
CONFIG_ESP_TASK_WDT_INIT=n
CONFIG_SPI_FLASH_DANGEROUS_WRITE_FAILS=y
CONFIG_COMPILER_STACK_CHECK_MODE_STRONG=y
CONFIG_COMPILER_STACK_CHECK=y
CONFIG_ADC_DISABLE_DAC=n
CONFIG_COMPILER_WARN_WRITE_STRINGS=y
CONFIG_SPI_MASTER_IN_IRAM=y
CONFIG_EFUSE_VIRTUAL=y
CONFIG_UNITY_ENABLE_BACKTRACE_ON_FAIL=y
```

## tools/unit-test-app/sdkconfig.defaults.esp32
```kconfig
CONFIG_ESP32_DEFAULT_CPU_FREQ_240=y
CONFIG_ESP32_XTAL_FREQ_AUTO=y
CONFIG_ULP_COPROC_ENABLED=y
CONFIG_ULP_COPROC_TYPE_FSM=y
CONFIG_ULP_COPROC_RESERVE_MEM=4096
CONFIG_SPI_FLASH_SHARE_SPI1_BUS=y
```

## tools/unit-test-app/sdkconfig.defaults.esp32c2
```kconfig
CONFIG_ESP_SYSTEM_MEMPROT_FEATURE=n
CONFIG_ESPTOOLPY_FLASHSIZE_2MB=y
CONFIG_PARTITION_TABLE_CUSTOM_FILENAME="partition_table_unit_test_app_2m.csv"
CONFIG_PARTITION_TABLE_FILENAME="partition_table_unit_test_app_2m.csv"

# 2MB partition table has a FAT partition too small for 4k sectors
CONFIG_WL_SECTOR_SIZE_512=y
```

## tools/unit-test-app/sdkconfig.defaults.esp32s2
```kconfig
CONFIG_ESP32S2_DEFAULT_CPU_FREQ_240=y
CONFIG_ESP32S2_ULP_COPROC_ENABLED=y
CONFIG_ESP32S2_MEMPROT_FEATURE=n
```

## tools/unit-test-app/sdkconfig.defaults.esp32s2beta
```kconfig
CONFIG_ESP32S2_DEFAULT_CPU_FREQ_240=y
CONFIG_ESP32S2_ULP_COPROC_ENABLED=y

# Hardware MPI disabled, ref. IDF-757
CONFIG_MBEDTLS_HARDWARE_MPI=n
```

## tools/unit-test-app/sdkconfig.defaults.esp32s3
```kconfig
CONFIG_ESP32S3_DEFAULT_CPU_FREQ_240=y

CONFIG_ESP32S3_ULP_COPROC_ENABLED=y
CONFIG_ESP32S3_ULP_COPROC_RISCV=y
CONFIG_ESP32S3_ULP_COPROC_RESERVE_MEM=4096
```
