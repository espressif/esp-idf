## tools/test_apps/build_system/bootloader/sdkconfig.defaults.esp32
```kconfig
# Change revision to use secure boot version 2
CONFIG_ESP32_REV_MIN_3=y
CONFIG_ESP32_REV_MIN=3
```

## tools/test_apps/build_system/bootloader/sdkconfig.defaults.esp32c61
```kconfig
# ESP32-C61 has no RSA based Secure Boot V2; only the ECDSA scheme exists, and it
# is not functional for certain input vectors (see SECURE_BOOT_V2_ECDSA_INSECURE),
# so it is gated behind the insecure option. Force-enable it for this build-only test.
CONFIG_SECURE_BOOT_INSECURE=y
CONFIG_SECURE_BOOT_V2_FORCE_ENABLE_ECDSA=y
CONFIG_SECURE_SIGNED_APPS_ECDSA_V2_SCHEME=y
```

## tools/test_apps/build_system/rsource_test/Kconfig.extra
```kconfig
menu "RSOURCE test"
    config RSOURCE_EXTRA_CONFIG
        bool "rsource extra config"
        default y
endmenu
```

## tools/test_apps/components/test_utils/Kconfig
```kconfig
menu "IDF unit test"

    config UNITY_FREERTOS_PRIORITY
        int "Priority of Unity test task"
        default 5

    config UNITY_FREERTOS_CPU
        int "CPU to run Unity test task on"
        default 0

    config UNITY_FREERTOS_STACK_SIZE
        int "Stack size of Unity test task, in bytes"
        default 8192

    config UNITY_WARN_LEAK_LEVEL_GENERAL
        int "Leak warning level"
        default 255

    config UNITY_CRITICAL_LEAK_LEVEL_GENERAL
        int "Critical leak"
        default 1200

    config UNITY_CRITICAL_LEAK_LEVEL_LWIP
        int "Critical leak for UT which use LWIP component"
        default 4095

    config UNITY_IGNORE_PERFORMANCE_TESTS
        bool "Ignore performance test results"
        default y if IDF_ENV_FPGA
        default n
        help
            If set, performance tests that use TEST_PERFORMANCE_LESS_THAN and
            TEST_PERFORMANCE_GREATER_THAN macros will log the performance value
            but not fail the test if the threshold is not met.

endmenu
```

## tools/test_apps/peripherals/i2c_wifi/main/Kconfig.projbuild
```kconfig
menu "Test Configuration"

    choice TEST_I2C_WORK_MODE
        prompt "I2C working mode select"
        default TEST_I2C_MASTER_MODE

        config TEST_I2C_MASTER_MODE
            bool "i2c master mode"
        config TEST_I2C_SLAVE_MODE
            bool "I2C slave mode"
    endchoice

    menu "I2C Configuration"

        orsource "$IDF_PATH/examples/common_components/env_caps/$IDF_TARGET/Kconfig.env_caps"

        config TEST_I2C_SCL_NUM
            int "SCL GPIO Num"
            range ENV_GPIO_RANGE_MIN ENV_GPIO_OUT_RANGE_MAX
            default 2 if  IDF_TARGET_ESP32S3
            default 19 if IDF_TARGET_ESP32 || IDF_TARGET_ESP32S2
            default 9
            help
                GPIO number for I2C Master clock line.

        config TEST_I2C_SDA_NUM
            int "SDA GPIO Num"
            range ENV_GPIO_RANGE_MIN ENV_GPIO_OUT_RANGE_MAX
            default 1 if  IDF_TARGET_ESP32S3
            default 18 if IDF_TARGET_ESP32 || IDF_TARGET_ESP32S2
            default 5
            help
                GPIO number for I2C Master data line.

        config TEST_I2C_PORT_NUM
            int "Port Number"
            default 0
            help
                Port number for I2C Master device.

        config TEST_I2C_MASTER_FREQUENCY
            int "Master Frequency"
            default 400000
            depends on TEST_I2C_MASTER_MODE
            help
                I2C Speed of Master device.

        config TEST_I2C_SLAVE_ADDR
            hex "ESP Slave Address"
            default 0x58
            help
                Hardware Address of I2C Slave Port.
    endmenu

    config TEST_I2C_WIFI_AP_ENABLE
        bool "Enable WIFI AP"
        default y
        # C6 has not supported WIFI yet.
        depends on TEST_I2C_MASTER_MODE && !IDF_TARGET_ESP32C6

    menu "WiFi softAP Configuration"
        depends on TEST_I2C_WIFI_AP_ENABLE

        config TEST_WIFI_SSID
            string "WiFi SSID"
            default "myssid"
            help
                SSID (network name) for the test to connect to.

        config TEST_WIFI_PASSWORD
            string "WiFi Password"
            default "mypassword"
            help
                WiFi password (WPA or WPA2) for the test to use.
        config TEST_WIFI_CHANNEL
            int "WiFi Channel"
            range 1 13
            default 1
            help
                WiFi channel (network channel) for the test to use.

        config TEST_MAX_STA_CONN
            int "Maximal STA connections"
            default 4
            help
                Max number of the STA connects to AP.
    endmenu

endmenu
```

## tools/test_apps/peripherals/usb/sdkconfig.defaults
```kconfig
# Defaults for generating a new "sdkconfig" file (project settings).
# https://docs.espressif.com/projects/esp-idf/en/latest/esp32/api-guides/build-system.html#custom-sdkconfig-defaults
#
# NOTE - if this file changes, to get new defaults, you must erase any existing
# "sdkconfig" file (this will undo manual settings from "idf.py menuconfig").

# Configure TinyUSB, it will be used to mock USB devices
CONFIG_TINYUSB=y
CONFIG_TINYUSB_MSC_ENABLED=y
CONFIG_TINYUSB_CDC_ENABLED=y
CONFIG_TINYUSB_CDC_COUNT=2

# Disable watchdogs, they'd get triggered during unity interactive menu
CONFIG_ESP_INT_WDT=n
CONFIG_ESP_TASK_WDT=n

# Run-time checks of Heap and Stack
CONFIG_HEAP_POISONING_COMPREHENSIVE=y
CONFIG_COMPILER_STACK_CHECK_MODE_STRONG=y
CONFIG_COMPILER_STACK_CHECK=y

CONFIG_UNITY_ENABLE_BACKTRACE_ON_FAIL=y
```

## tools/test_apps/phy/phy_tsens/sdkconfig.defaults
```kconfig
CONFIG_PM_ENABLE=y
CONFIG_PM_DFS_INIT_AUTO=y
CONFIG_FREERTOS_USE_TICKLESS_IDLE=y
CONFIG_FREERTOS_HZ=1000
```

## tools/test_apps/protocols/mdns/main/Kconfig.projbuild
```kconfig
menu "Example Configuration"

    config TEST_MDNS_HOSTNAME
        string "mDNS Hostname"
        default "esp32-mdns"
        help
            mDNS Hostname for example to use

    config TEST_MDNS_INSTANCE
        string "mDNS Instance Name"
        default "ESP32 with mDNS"
        help
            mDNS Instance Name for example to use

    config TEST_MDNS_PUBLISH_DELEGATE_HOST
        bool "Publish a delegated host"
        help
            Enable publishing a delegated host other than ESP32.
            The example will also add a mock service for this host.

    config TEST_MDNS_ADD_MAC_TO_HOSTNAME
        bool "Add mac suffix to hostname"
        default n
        help
            If enabled, a portion of MAC address is added to the hostname, this is used
            for evaluation of tests in CI

endmenu
```

## tools/test_apps/protocols/mqtt/publish_connect_test/main/Kconfig.projbuild
```kconfig
menu "Example Configuration"

    config EXAMPLE_BROKER_SSL_URI
        string "Broker SSL URL"
        default "mqtts://mqtt.eclipseprojects.io:8883"
        help
            URL of an mqtt broker for ssl transport

    config EXAMPLE_BROKER_TCP_URI
        string "Broker TCP URL"
        default "mqtt://mqtt.eclipseprojects.io:1883"
        help
            URL of an mqtt broker for tcp transport

    config EXAMPLE_BROKER_WS_URI
        string "Broker WS URL"
        default "ws://mqtt.eclipseprojects.io:80/mqtt"
        help
            URL of an mqtt broker for ws transport

    config EXAMPLE_BROKER_WSS_URI
        string "Broker WSS URL"
        default "wss://mqtt.eclipseprojects.io:443/mqtt"
        help
            URL of an mqtt broker for wss transport

    config EXAMPLE_BROKER_CERTIFICATE_OVERRIDE
        string "Broker certificate override"
        default ""
        help
            Please leave empty if broker certificate included from a textfile; otherwise fill in a base64 part of PEM
            format certificate

    config EXAMPLE_BROKER_CERTIFICATE_OVERRIDDEN
        bool
        default y if EXAMPLE_BROKER_CERTIFICATE_OVERRIDE != ""

    config EXAMPLE_RUN_LOCAL_BROKER
        bool "Run local mosquitto"
        default n
        help
            If enabled, this tests uses local mosquitto broker
            running on the same endpoint as the client

    config EXAMPLE_BROKER_HOST
        string "Broker host address"
        default "0.0.0.0"
        depends on EXAMPLE_RUN_LOCAL_BROKER
        help
            Host name of the endpoint to bind the mosquitto listener.

    config EXAMPLE_BROKER_PORT
        int "Broker port"
        default 1234
        depends on EXAMPLE_RUN_LOCAL_BROKER
        help
            Port of the endpoint to bind the mosquitto listener

    config EXAMPLE_CONNECT_CASE_NO_CERT
        # Note: All the below config values (EXAMPLE_CONNECT_CASE...) are hidden and
        # used to give symbolic names to test cases, which are then referenced from both
        # the embedded C code as well as the test counterpart in python
        int
        default 1

    config EXAMPLE_CONNECT_CASE_SERVER_CERT
        int
        default 2

    config EXAMPLE_CONNECT_CASE_MUTUAL_AUTH
        int
        default 3

    config EXAMPLE_CONNECT_CASE_INVALID_SERVER_CERT
        int
        default 4

    config EXAMPLE_CONNECT_CASE_SERVER_DER_CERT
        int
        default 5

    config EXAMPLE_CONNECT_CASE_MUTUAL_AUTH_KEY_PWD
        int
        default 6

    config EXAMPLE_CONNECT_CASE_MUTUAL_AUTH_BAD_CRT
        int
        default 7

    config EXAMPLE_CONNECT_CASE_NO_CERT_ALPN
        int
        default 8

endmenu
```

## tools/test_apps/protocols/netif_components/main/Kconfig.projbuild
```kconfig
menu "TestApp Configuration"

    choice TESTAPP_COMPONENT_TEST
        prompt "Component under test"
        help
            Component for which we check their dependencies

        config TESTAPP_COMPONENT_ESP_NETIF
            bool "esp_netif"

        config TESTAPP_COMPONENT_LWIP
            bool "lwip"

        config TESTAPP_COMPONENT_ESP_NETIF_WITHOUT_LWIP
            bool "esp_netif without lwip"
            depends on ESP_NETIF_LOOPBACK

    endchoice

endmenu
```

## tools/test_apps/protocols/pppos/main/Kconfig.projbuild
```kconfig
menu "Test App Configuration"

    config TEST_APP_PPP_SERVER_IP
        string "IP address of PPP server"
        default "10.0.0.1"
        help
            IP address of PPP server. Note: this is also the address
            where the TCP server is started to test the connection

    config TEST_APP_PPP_CLIENT_IP
        string "IP address of PPP client"
        default "10.0.0.2"
        help
            IP address that PPP server assigns to PPP client.

    config TEST_APP_TCP_PORT
        int "Port of test"
        range 0 65535
        default 2222
        help
            The remote port to which the client will connects to
            once the PPP connection established

endmenu
```

## tools/test_apps/security/secure_boot/main/Kconfig.projbuild
```kconfig
menu "Example Configuration"

    config EXAMPLE_TARGET_QEMU
        bool "Run the example tests for target QEMU"
        default n
        help
            Run the example tests for target QEMU

endmenu
```

## tools/test_apps/security/secure_boot/sdkconfig.defaults
```kconfig
# Defaults for generating a new "sdkconfig" file (project settings).
# https://docs.espressif.com/projects/esp-idf/en/latest/esp32/api-guides/build-system.html#custom-sdkconfig-defaults
#
# NOTE - if this file changes, to get new defaults, you must erase any existing
# "sdkconfig" file (this will undo manual settings from "idf.py menuconfig").

# Default Secure Boot bootloader is too large to fit in default
# bootloader size without adding 0x1000 bytes or reducing the log level.
#
# If you find yourself needing to edit this in the future, it's a sign the
# bootloader is bloating out!
CONFIG_PARTITION_TABLE_OFFSET=0xC000

# Maximize the number of possible build warnings
CONFIG_COMPILER_OPTIMIZATION_PERF=y
```

## tools/test_apps/security/signed_app_no_secure_boot/sdkconfig.defaults
```kconfig
CONFIG_SECURE_SIGNED_ON_UPDATE=y
CONFIG_SECURE_SIGNED_APPS=y
CONFIG_SECURE_BOOT_V2_PREFERRED=y
CONFIG_SECURE_SIGNED_APPS_NO_SECURE_BOOT=y
CONFIG_SECURE_SIGNED_ON_UPDATE_NO_SECURE_BOOT=y
# CONFIG_SECURE_BOOT is not set
# CONFIG_SECURE_BOOT_BUILD_SIGNED_BINARIES is not set
# CONFIG_SECURE_FLASH_ENC_ENABLED is not set
```

## tools/test_apps/storage/fatfsgen/main/Kconfig.projbuild
```kconfig
menu "Example Configuration"

    config EXAMPLE_FATFS_MODE_READ_ONLY
        bool "Read only mode for generated FATFS image"
        default n
        help
            If read-only mode is set, the generated fatfs image will be raw (without wear levelling support).
            Otherwise it will support wear levelling that enables read-write mounting.

    config EXAMPLE_FATFS_WRITE_COUNT
        int "Number of volumes"
        default 1
        range 1 600
        help
            Number of writes to the file (for testing purposes).

    config EXAMPLE_FATFS_DEFAULT_DATETIME
        bool "Default modification date and time for generated FATFS image"
        default n
        help
            If default datetime is set, all files created in the generated FATFS partition have default time
            equal to FATFS origin time (1 January 1980)

endmenu
```

## tools/test_apps/storage/partition_table_readonly/sdkconfig.defaults
```kconfig
# General options for additional checks
CONFIG_HEAP_POISONING_COMPREHENSIVE=y
CONFIG_COMPILER_WARN_WRITE_STRINGS=y
CONFIG_BOOTLOADER_LOG_LEVEL_WARN=y
CONFIG_FREERTOS_WATCHPOINT_END_OF_STACK=y
CONFIG_COMPILER_STACK_CHECK_MODE_STRONG=y
CONFIG_COMPILER_STACK_CHECK=y
CONFIG_NVS_ASSERT_ERROR_CHECK=y

# Disable task watchdog since this app uses an interactive menu
CONFIG_ESP_TASK_WDT_INIT=n

# SPIFFS configuration
CONFIG_SPIFFS_USE_MTIME=n # Disable mtime update as the partition is read-only

# Custom partition table related
CONFIG_PARTITION_TABLE_CUSTOM=y
CONFIG_PARTITION_TABLE_CUSTOM_FILENAME="partitions_example.csv"
CONFIG_PARTITION_TABLE_FILENAME="partitions_example.csv"
CONFIG_ESPTOOLPY_FLASHSIZE_2MB=y
```

## tools/test_apps/storage/sdmmc_console/sdkconfig.defaults
```kconfig
CONFIG_BOOTLOADER_LOG_LEVEL_WARN=y
CONFIG_ESPTOOLPY_FLASHSIZE_2MB=y
CONFIG_FREERTOS_WATCHPOINT_END_OF_STACK=y
CONFIG_HEAP_POISONING_COMPREHENSIVE=y
CONFIG_COMPILER_STACK_CHECK_MODE_STRONG=y
CONFIG_COMPILER_STACK_CHECK=y
CONFIG_COMPILER_WARN_WRITE_STRINGS=y
CONFIG_PARTITION_TABLE_CUSTOM=y
CONFIG_PARTITION_TABLE_CUSTOM_FILENAME="partitions.csv"
CONFIG_LOG_MAXIMUM_LEVEL_VERBOSE=y
CONFIG_FREERTOS_USE_STATS_FORMATTING_FUNCTIONS=y
```

## tools/test_apps/storage/sdmmc_console/sdkconfig.defaults.esp32h2
```kconfig
CONFIG_ESPTOOLPY_FLASHSIZE_2MB=y
CONFIG_SDMMC_BOARD_CUSTOM_MISO=0
CONFIG_SDMMC_BOARD_CUSTOM_MOSI=5
CONFIG_SDMMC_BOARD_CUSTOM_SCK=4
CONFIG_SDMMC_BOARD_CUSTOM_CS=1
```

## tools/test_apps/storage/std_filesystem/sdkconfig.defaults
```kconfig
CONFIG_COMPILER_CXX_EXCEPTIONS=y
CONFIG_ESP_MAIN_TASK_STACK_SIZE=8192
CONFIG_PARTITION_TABLE_CUSTOM=y
CONFIG_PARTITION_TABLE_CUSTOM_FILENAME="partitions.csv"
CONFIG_FATFS_LFN_HEAP=y
CONFIG_COMPILER_STACK_CHECK_MODE_STRONG=y
CONFIG_COMPILER_WARN_WRITE_STRINGS=y
CONFIG_COMPILER_DISABLE_DEFAULT_ERRORS=n
CONFIG_FREERTOS_USE_LIST_DATA_INTEGRITY_CHECK_BYTES=y
CONFIG_FREERTOS_WATCHPOINT_END_OF_STACK=y
CONFIG_HEAP_POISONING_COMPREHENSIVE=y
CONFIG_BOOTLOADER_LOG_LEVEL_WARN=y
CONFIG_LOG_DEFAULT_LEVEL_WARN=y
CONFIG_LOG_MAXIMUM_LEVEL_INFO=y
```
