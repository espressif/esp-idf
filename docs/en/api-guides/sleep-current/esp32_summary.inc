.. list-table::
  :header-rows: 1
  :widths: 20  20 30 20 20

  * - Item
    - Modem-sleep
    - Modem-sleep+DFS
    - Auto Light-sleep
    - Deep-sleep

  * - Sleep
    - Automatic
    - Automatic
    - Automatic
    - Manual

  * - Wake-up
    - Automatic
    - Automatic
    - Automatic
    - Configure Wake-up Source

  * - Wi-Fi Connection
    - Maintain
    - Maintain
    - Maintain
    - Disconnect

  * - CPU
    - On
    - On/Throttled
    - Paused
    - Off

  * - System Clock
    - On
    - On
    - Off
    - Off

  * - Peripherals
    - On
    - On
    - On
    - Off

  * - DTIM1
    - 31.12 mA
    - 22.65 mA
    - 3.34 mA
    - /

  * - DTIM3
    - 28.81 mA
    - 21.89 mA
    - 2.33 mA
    - /

  * - DTIM10
    - 29.66 mA
    - 20.01 mA
    - 2.19 mA
    - /

  * - Average Current
    - /
    - /
    - /
    - 5 μA
