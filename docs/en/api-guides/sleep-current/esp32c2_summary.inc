.. list-table::
  :header-rows: 1
  :widths: 20  20 30 20 20

  * - Item
    - Modem-sleep
    - Modem-sleep+DFS
    - Auto Light-sleep
    - Deep-sleep

  * - Sleep
    - Automatic
    - Automatic
    - Automatic
    - Manual

  * - Wake-up
    - Automatic
    - Automatic
    - Automatic
    - Configure Wake-up Source

  * - Wi-Fi Connection
    - Maintain
    - Maintain
    - Maintain
    - Disconnect

  * - CPU
    - On
    - On/Throttled
    - Paused
    - Off

  * - System Clock
    - On
    - On
    - Off
    - Off

  * - Peripherals
    - On
    - On
    - On
    - Off

  * - DTIM1
    - 13.6
    - 7.5
    - 1.6
    - /

  * - DTIM3
    - 13.0
    - 6.9
    - 0.71
    - /

  * - DTIM10
    - 12.9
    - 6.6
    - 0.39
    - /

  * - Average Current
    - /
    - /
    - /
    - 4.9 μA
