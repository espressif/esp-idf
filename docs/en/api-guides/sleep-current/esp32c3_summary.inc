.. list-table::
  :header-rows: 1
  :widths: 20  20 30 20 20

  * - Item
    - Modem-sleep
    - Modem-sleep+DFS
    - Auto Ligh-sleep
    - Deep-sleep

  * - Sleep
    - Automatic
    - Automatic
    - Automatic
    - Manual

  * - Wake-up
    - Automatic
    - Automatic
    - Automatic
    - Configure Wake-up Source

  * - Wi-Fi Connection
    - Maintain
    - Maintain
    - Maintain
    - Disconnect

  * - CPU
    - On
    - On/Throttled
    - Paused
    - Off

  * - System Clock
    - On
    - On
    - Off
    - Off

  * - Peripherals
    - On
    - On
    - On
    - Off

  * - DTIM1
    - 21.47 mA
    - 11.35 mA
    - 1.4 mA
    - /

  * - DTIM3
    - 20.82 mA
    - 10.71 mA
    - 0.62 mA
    - /

  * - DTIM10
    - 20.67 mA
    - 10.32 mA
    - 0.31 mA
    - /

  * - Average Current
    - /
    - /
    - /
    - 4.8 μA
