.. list-table::
  :header-rows: 1
  :widths: 20  20 30 20 20

  * - Item
    - Modem-sleep
    - Modem-sleep+DFS
    - Auto Light-sleep
    - Deep-sleep

  * - Sleep
    - Automatic
    - Automatic
    - Automatic
    - Manual

  * - Wake-up
    - Automatic
    - Automatic
    - Automatic
    - Configure Wake-up Source

  * - Wi-Fi Connection
    - Maintain
    - Maintain
    - Maintain
    - Disconnect

  * - CPU
    - On
    - On/Throttled
    - Paused
    - Off

  * - System Clock
    - On
    - On
    - Off
    - Off

  * - Peripherals
    - On
    - On
    - On
    - Off

  * - DTIM1 (2.4 GHz)
    - 32.394 mA
    - 24.766 mA
    - 1.342 mA
    - /

  * - DTIM1 (5 GHz)
    - 32.329 mA
    - 25.467 mA
    - 1.514 mA
    - /

  * - DTIM3 (2.4 GHz)
    - 31.618 mA
    - 24.19 mA
    - 0.651 mA
    - /

  * - DTIM3 (5 GHz)
    - 32.088 mA
    - 25.208 mA
    - 0.764 mA
    - /

  * - DTIM10 (2.4 GHz)
    - 31.281 mA
    - 23.998 mA
    - 0.398 mA
    - /

  * - DTIM10 (5 GHz)
    - 32.011 mA
    - 25.151 mA
    - 0.451 mA
    - /

  * - Average Current
    - /
    - /
    - /
    - 10.0 μA
