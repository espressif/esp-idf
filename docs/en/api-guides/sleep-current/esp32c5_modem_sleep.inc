.. list-table::
  :header-rows: 1
  :widths: 20 10 10 20 24 20 20

  * - CPU frequency
    - DFS
    - DTIM
    - Wi-Fi Band
    - Average current (mA)
    - Max current (mA)
    - Min current (mA)

  * - 240 MHz
    - ON
    - 1
    - 2.4 GHz
    - 24.766
    - 88.836
    - 23.139

  * - 240 MHz
    - OFF
    - 1
    - 2.4 GHz
    - 32.394
    - 97.378
    - 30.776

  * - 240 MHz
    - ON
    - 3
    - 2.4 GHz
    - 24.19
    - 89.176
    - 23.229

  * - 240 MHz
    - OFF
    - 3
    - 2.4 GHz
    - 31.618
    - 97.439
    - 30.778

  * - 240 MHz
    - ON
    - 10
    - 2.4 GHz
    - 23.998
    - 88.524
    - 23.252

  * - 240 MHz
    - OFF
    - 10
    - 2.4 GHz
    - 31.281
    - 98.254
    - 30.788

  * - 240 MHz
    - ON
    - 1
    - 5 GHz
    - 25.467
    - 114.746
    - 24.387

  * - 240 MHz
    - OFF
    - 1
    - 5 GHz
    - 32.329
    - 117.077
    - 31.948

  * - 240 MHz
    - ON
    - 3
    - 5 GHz
    - 25.208
    - 112.746
    - 24.421

  * - 240 MHz
    - OFF
    - 3
    - 5 GHz
    - 32.088
    - 117.227
    - 31.948

  * - 240 MHz
    - ON
    - 10
    - 5 GHz
    - 25.151
    - 114.438
    - 24.432

  * - 160 MHz
    - OFF
    - 10
    - 5 GHz
    - 32.011
    - 119.908
    - 31.955
