.. list-table::
  :header-rows: 1
  :widths: 20  20 30 20 20

  * - Item
    - Modem-sleep
    - Modem-sleep+DFS
    - Auto Light-sleep
    - Deep-sleep

  * - Sleep
    - Automatic
    - Automatic
    - Automatic
    - Manual

  * - Wake-up
    - Automatic
    - Automatic
    - Automatic
    - Configure Wake-up Source

  * - Wi-Fi Connection
    - Maintain
    - Maintain
    - Maintain
    - Disconnect

  * - CPU
    - On
    - On/Throttled
    - Paused
    - Off

  * - System Clock
    - On
    - On
    - Off
    - Off

  * - Peripherals
    - On
    - On
    - On
    - Off

  * - DTIM1
    - 40.1
    - 20.7
    - 2.45
    - /

  * - DTIM3
    - 38.7
    - 19.9
    - 1.33
    - /

  * - DTIM10
    - 38.2
    - 19.5
    - 0.93
    - /

  * - Average Current
    - /
    - /
    - /
    - 6.8 μA
