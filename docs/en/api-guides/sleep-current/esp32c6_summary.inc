.. list-table::
  :header-rows: 1
  :widths: 20  20 30 20 20

  * - Item
    - Modem-sleep
    - Modem-sleep+DFS
    - Auto Light-sleep
    - Deep-sleep

  * - Sleep
    - Automatic
    - Automatic
    - Automatic
    - Manual

  * - Wake-up
    - Automatic
    - Automatic
    - Automatic
    - Configure Wake-up Source

  * - Wi-Fi Connection
    - Maintain
    - Maintain
    - Maintain
    - Disconnect

  * - CPU
    - On
    - On/Throttled
    - Paused
    - Off

  * - System Clock
    - On
    - On
    - Off
    - Off

  * - Peripherals
    - On
    - On
    - On
    - Off

  * - DTIM1
    - 27.48 mA
    - 14.37 mA
    - 0.919 mA
    - /

  * - DTIM3
    - 27.08 mA
    - 13.9 mA
    - 0.368 mA
    - /

  * - DTIM10
    - 26.85 mA
    - 13.71 mA
    - 0.172 mA
    - /

  * - Average Current
    - /
    - /
    - /
    - 6.7 μA
