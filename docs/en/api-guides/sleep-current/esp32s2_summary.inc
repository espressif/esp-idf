.. list-table::
  :header-rows: 1
  :widths: 20  20 30 20 20

  * - Item
    - Modem-sleep
    - Modem-sleep+DFS
    - Auto Light-sleep
    - Deep-sleep

  * - Sleep
    - Automatic
    - Automatic
    - Automatic
    - Manual

  * - Wake-up
    - Automatic
    - Automatic
    - Automatic
    - Configure Wake-up Source

  * - Wi-Fi Connection
    - Maintain
    - Maintain
    - Maintain
    - Disconnect

  * - CPU
    - On
    - On/Throttled
    - Paused
    - Off

  * - System Clock
    - On
    - On
    - Off
    - Off

  * - Peripherals
    - On
    - On
    - On
    - Off

  * - DTIM1
    - 31.14 mA
    - 11.71 mA
    - 2.48 mA
    - /

  * - DTIM3
    - 29.06 mA
    - 12.4 mA
    - 2.96 mA
    - /

  * - DTIM10
    - 28.5 mA
    - 12.15 mA
    - 2.69 mA
    - /

  * - Average Current
    - /
    - /
    - /
    - 5 μA
