.. This file gets included from auto-generated part of idf-tools.rst.
.. Comments "tool-NAME-notes" act as delimiters.
..
.. This is a padding to have the same line numbers as zh_CN version>


.. tool-xtensa-esp-elf-gdb-notes


---

.. tool-riscv32-esp-elf-gdb-notes


---

.. tool-xtensa-esp-elf-notes


---

.. tool-riscv32-esp-elf-notes


---

.. tool-esp32ulp-elf-notes


---

.. tool-openocd-esp32-notes


---

.. tool-cmake-notes

On Linux and macOS, it is recommended to install CMake using the OS-specific package manager (like apt, yum, brew, etc.). However, for convenience it is possible to install CMake using idf_tools.py along with the other tools.

---

.. tool-esp-clang-notes


---

.. tool-ninja-notes

On Linux and macOS, it is recommended to install ninja using the OS-specific package manager (like apt, yum, brew, etc.). However, for convenience it is possible to install ninja using idf_tools.py along with the other tools.

---

.. tool-idf-exe-notes


---

.. tool-ccache-notes


---

.. tool-dfu-util-notes


---

.. tool-esp-rom-elfs-notes


---

.. tool-qemu-xtensa-notes

Some ESP-specific instructions for running QEMU for Xtensa chips are here: https://github.com/espressif/esp-toolchain-docs/blob/main/qemu/esp32/README.md

---

.. tool-qemu-riscv32-notes

Some ESP-specific instructions for running QEMU for RISC-V chips are here: https://github.com/espressif/esp-toolchain-docs/blob/main/qemu/esp32c3/README.md

---

.. tool-idf-python-notes


---

.. tool-idf-python-wheels-notes


---
