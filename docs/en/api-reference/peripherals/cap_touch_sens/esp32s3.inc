.. This file gets included from other .rst files in this folder.
.. It contains target-specific snippets.
.. Comments and '---' lines act as delimiters.
..
.. This is necessary mainly because RST doesn't support substitutions
.. (defined in RST, not in Python) inside code blocks. If that is ever implemented,
.. These code blocks can be moved back to the main .rst files, with target-specific
.. file names being replaced by substitutions.

.. touch-chan-mapping

.. list-table::
    :header-rows: 1
    :widths: 20  20

    * - Channel
      - GPIO

    * - CH0
      - Internal

    * - CH1
      - IO1

    * - CH2
      - IO2

    * - CH3
      - IO3

    * - CH4
      - IO4

    * - CH5
      - IO5

    * - CH6
      - IO6

    * - CH7
      - IO7

    * - CH8
      - IO8

    * - CH9
      - IO9

    * - CH10
      - IO10

    * - CH11
      - IO11

    * - CH12
      - IO12

    * - CH13
      - IO13

    * - CH14
      - IO14

---
