.. This file gets included from other .rst files in this folder.
.. It contains target-specific snippets.
.. Comments and '---' lines act as delimiters.
..
.. This is necessary mainly because RST doesn't support substitutions
.. (defined in RST, not in Python) inside code blocks. If that is ever implemented,
.. These code blocks can be moved back to the main .rst files, with target-specific
.. file names being replaced by substitutions.

.. touch-chan-mapping

.. list-table::
    :header-rows: 1
    :widths: 20  20

    * - Channel
      - GPIO

    * - CH0
      - IO6

    * - CH1
      - IO7

    * - CH2
      - IO8

    * - CH3
      - IO9

    * - CH4
      - IO10

    * - CH5
      - IO11

    * - CH6
      - IO12

    * - CH7
      - IO13

    * - CH8
      - IO14

    * - CH9
      - IO15

    * - CH10
      - IO16

    * - CH11
      - IO17

    * - CH12
      - IO18

    * - CH13
      - IO19

---
