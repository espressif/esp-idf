.. output_log


.. code-block:: none

    ...
    esptool.py v4.8.dev3
    Serial port /dev/cu.SLAB_USBtoUART
    Connecting....
    Chip is ESP32-P4 (revision v0.0)
    Features: High-Performance MCU
    Crystal is 40MHz
    MAC: 00:00:00:00:00:00
    Uploading stub...
    Running stub...
    Stub running...
    Changing baud rate to 460800
    Changed.
    Configuring flash size...
    Flash will be erased from 0x00002000 to 0x00007fff...
    Flash will be erased from 0x00010000 to 0x0003bfff...
    Flash will be erased from 0x00008000 to 0x00008fff...
    SHA digest in image updated
    Compressed 20960 bytes to 12653...
    Writing at 0x00002000... (100 %)
    Wrote 20960 bytes (12653 compressed) at 0x00002000 in 0.6 seconds (effective 277.1 kbit/s)...
    Hash of data verified.
    Compressed 179584 bytes to 94528...
    Writing at 0x00035efb... (100 %)
    Wrote 179584 bytes (94528 compressed) at 0x00010000 in 2.6 seconds (effective 549.9 kbit/s)...
    Hash of data verified.
    Compressed 3072 bytes to 103...
    Writing at 0x00008000... (100 %)
    Wrote 3072 bytes (103 compressed) at 0x00008000 in 0.1 seconds (effective 420.7 kbit/s)...
    Hash of data verified.

    Leaving...
    Hard resetting via RTS pin...
    Done
