.. list-table::
  :header-rows: 1
  :widths: 20  20 30 20 20

  * - 项目
    - Modem Sleep
    - Modem Sleep+DFS
    - auto light Sleep
    - Deep Sleep

  * - 休眠
    - 自动
    - 自动
    - 自动
    - 手动

  * - 唤醒
    - 自动
    - 自动
    - 自动
    - 配置唤醒源

  * - Wi-Fi连接
    - 保持
    - 保持
    - 保持
    - 断开

  * - CPU
    - 开
    - 开/降频
    - 暂停
    - 关

  * - 系统时钟
    - 开
    - 开
    - 关
    - 关

  * - 外设
    - 开
    - 开
    - 开
    - 关

  * - DTIM1
    - 13.6
    - 7.5
    - 1.6
    - /

  * - DTIM3
    - 13.0
    - 6.9
    - 0.71
    - /

  * - DTIM10
    - 12.9
    - 6.6
    - 0.39
    - /

  * - 平均电流
    - /
    - /
    - /
    - 4.9 μA
