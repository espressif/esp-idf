.. list-table::
  :header-rows: 1
  :widths: 20  20 30 20 20

  * - 项目
    - Modem-sleep
    - Modem-sleep+DFS
    - Auto Light-sleep
    - Deep-sleep

  * - 休眠
    - 自动
    - 自动
    - 自动
    - 手动

  * - 唤醒
    - 自动
    - 自动
    - 自动
    - 配置唤醒源

  * - Wi-Fi连接
    - 保持
    - 保持
    - 保持
    - 断开

  * - CPU
    - 开
    - 开/降频
    - 暂停或关
    - 关

  * - 系统时钟
    - 开
    - 开
    - 关
    - 关

  * - 外设
    - 开
    - 开
    - 暂停或关
    - 关

  * - DTIM1 (2.4 GHz)
    - 32.394 mA
    - 24.766 mA
    - 1.342 mA
    - /

  * - DTIM1 (5 GHz)
    - 32.329 mA
    - 25.467 mA
    - 1.514 mA
    - /

  * - DTIM3 (2.4 GHz)
    - 31.618 mA
    - 24.19 mA
    - 0.651 mA
    - /

  * - DTIM3 (5 GHz)
    - 32.088 mA
    - 25.208 mA
    - 0.764 mA
    - /

  * - DTIM10 (2.4 GHz)
    - 31.281 mA
    - 23.998 mA
    - 0.398 mA
    - /

  * - DTIM10 (5 GHz)
    - 32.011 mA
    - 25.151 mA
    - 0.451 mA
    - /

  * - 平均电流
    - /
    - /
    - /
    - 10.0 μA
