.. list-table::
  :header-rows: 1
  :widths: 20  20 30 20 20

  * - 项目
    - Modem Sleep
    - Modem Sleep+DFS
    - auto light Sleep
    - Deep Sleep

  * - 休眠
    - 自动
    - 自动
    - 自动
    - 手动

  * - 唤醒
    - 自动
    - 自动
    - 自动
    - 配置唤醒源

  * - Wi-Fi连接
    - 保持
    - 保持
    - 保持
    - 断开

  * - CPU
    - 开
    - 开/降频
    - 暂停
    - 关

  * - 系统时钟
    - 开
    - 开
    - 关
    - 关

  * - 外设
    - 开
    - 开
    - 开
    - 关

  * - DTIM1
    - 21.47 mA
    - 11.35 mA
    - 1.4 mA
    - /

  * - DTIM3
    - 20.82 mA
    - 10.71 mA
    - 0.62 mA
    - /

  * - DTIM10
    - 20.67 mA
    - 10.32 mA
    - 0.31 mA
    - /

  * - 平均电流
    - /
    - /
    - /
    - 4.8 μA
