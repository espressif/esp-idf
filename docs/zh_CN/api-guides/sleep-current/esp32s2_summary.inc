.. list-table::
  :header-rows: 1
  :widths: 20  20 30 20 20

  * - 项目
    - Modem Sleep
    - Modem Sleep+DFS
    - auto light Sleep
    - Deep Sleep

  * - 休眠
    - 自动
    - 自动
    - 自动
    - 手动

  * - 唤醒
    - 自动
    - 自动
    - 自动
    - 配置唤醒源

  * - Wi-Fi连接
    - 保持
    - 保持
    - 保持
    - 断开

  * - CPU
    - 开
    - 开/降频
    - 暂停
    - 关

  * - 系统时钟
    - 开
    - 开
    - 关
    - 关

  * - 外设
    - 开
    - 开
    - 开
    - 关

  * - DTIM1
    - 31.14 mA
    - 11.71 mA
    - 2.48 mA
    - /

  * - DTIM3
    - 29.06 mA
    - 12.4 mA
    - 2.96 mA
    - /

  * - DTIM10
    - 28.5 mA
    - 12.15 mA
    - 2.69 mA
    - /

  * - 平均电流
    - /
    - /
    - /
    - 5 μA
