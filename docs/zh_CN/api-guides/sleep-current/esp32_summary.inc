.. list-table::
  :header-rows: 1
  :widths: 20  20 30 20 20

  * - 项目
    - Modem Sleep
    - Modem Sleep+DFS
    - auto light Sleep
    - Deep Sleep

  * - 休眠
    - 自动
    - 自动
    - 自动
    - 手动

  * - 唤醒
    - 自动
    - 自动
    - 自动
    - 配置唤醒源

  * - Wi-Fi连接
    - 保持
    - 保持
    - 保持
    - 断开

  * - CPU
    - 开
    - 开/降频
    - 暂停
    - 关

  * - 系统时钟
    - 开
    - 开
    - 关
    - 关

  * - 外设
    - 开
    - 开
    - 开
    - 关

  * - DTIM1
    - 31.12 mA
    - 22.65 mA
    - 3.34 mA
    - /

  * - DTIM3
    - 28.81 mA
    - 21.89 mA
    - 2.33 mA
    - /

  * - DTIM10
    - 29.66 mA
    - 20.01 mA
    - 2.19 mA
    - /

  * - 平均电流
    - /
    - /
    - /
    - 5 μA
