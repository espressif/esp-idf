.. This file gets included from other .rst files in this folder.
.. It contains target-specific snippets.
.. Comments and '---' lines act as delimiters.
..
.. This is necessary mainly because RST doesn't support substitutions
.. (defined in RST, not in Python) inside code blocks. If that is ever implemented,
.. These code blocks can be moved back to the main .rst files, with target-specific
.. file names being replaced by substitutions.

.. touch-chan-mapping

.. list-table::
    :header-rows: 1
    :widths: 20  20

    * - 通道
      - GPIO

    * - CH0
      - IO0

    * - CH1
      - IO1

    * - CH2
      - IO2

    * - CH3
      - IO3

    * - CH4
      - IO29

    * - CH5
      - IO30

    * - CH6
      - IO31

    * - CH7
      - IO32

    * - CH8
      - IO33

    * - CH9
      - IO34

    * - CH10
      - IO35

    * - CH11
      - IO36

    * - CH12
      - IO37

    * - CH13
      - IO38

    * - CH14
      - IO39

---
