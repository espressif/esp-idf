.. This file gets included from other .rst files in this folder.
.. It contains target-specific snippets.
.. Comments and '---' lines act as delimiters.
..
.. This is necessary mainly because RST doesn't support substitutions
.. (defined in RST, not in Python) inside code blocks. If that is ever implemented,
.. These code blocks can be moved back to the main .rst files, with target-specific
.. file names being replaced by substitutions.

.. touch-chan-mapping

.. list-table::
    :header-rows: 1
    :widths: 20  20

    * - 通道
      - GPIO

    * - CH1
      - IO2

    * - CH2
      - IO3

    * - CH3
      - IO4

    * - CH4
      - IO5

    * - CH5
      - IO6

    * - CH6
      - IO7

    * - CH7
      - IO8

    * - CH8
      - IO9

    * - CH9
      - IO10

    * - CH10
      - IO11

    * - CH11
      - IO12

    * - CH12
      - IO13

    * - CH13
      - IO14

    * - CH14
      - IO15

    * - CH15
      - 未引出

---
