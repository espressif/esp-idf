.. This file gets included from other .rst files in this folder.
.. It contains target-specific snippets.
.. Comments and '---' lines act as delimiters.
..
.. This is necessary mainly because RST doesn't support substitutions
.. (defined in RST, not in Python) inside code blocks. If that is ever implemented,
.. These code blocks can be moved back to the main .rst files, with target-specific
.. file names being replaced by substitutions.

.. touch-chan-mapping

.. list-table::
    :header-rows: 1
    :widths: 20  20

    * - 通道
      - GPIO

    * - CH0
      - IO4

    * - CH1
      - IO0

    * - CH2
      - IO2

    * - CH3
      - IO15

    * - CH4
      - IO13

    * - CH5
      - IO12

    * - CH6
      - IO14

    * - CH7
      - IO27

    * - CH8
      - IO33

    * - CH9
      - IO32

---
