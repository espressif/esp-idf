.. output_log

.. code-block:: none

    ...
    esptool.py esp32s3 -p /dev/ttyUSB0 -b 460800 --before=default_reset --after=hard_reset write_flash --flash_mode dio --flash_freq 80m --flash_size 2MB 0x0 bootloader/bootloader.bin 0x10000 hello_world.bin 0x8000 partition_table/partition-table.bin
    esptool.py v3.2-dev
    Serial port /dev/ttyUSB0
    Connecting....
    Chip is ESP32-S3
    Features: WiFi, BLE
    Crystal is 40MHz
    MAC: 7c:df:a1:e0:00:64
    Uploading stub...
    Running stub...
    Stub running...
    Changing baud rate to 460800
    Changed.
    Configuring flash size...
    Flash will be erased from 0x00000000 to 0x00004fff...
    Flash will be erased from 0x00010000 to 0x00039fff...
    Flash will be erased from 0x00008000 to 0x00008fff...
    Compressed 18896 bytes to 11758...
    Writing at 0x00000000... (100 %)
    Wrote 18896 bytes (11758 compressed) at 0x00000000 in 0.5 seconds (effective 279.9 kbit/s)...
    Hash of data verified.
    Compressed 168208 bytes to 88178...
    Writing at 0x00010000... (16 %)
    Writing at 0x0001a80f... (33 %)
    Writing at 0x000201f1... (50 %)
    Writing at 0x00025dcf... (66 %)
    Writing at 0x0002d0be... (83 %)
    Writing at 0x00036c07... (100 %)
    Wrote 168208 bytes (88178 compressed) at 0x00010000 in 2.4 seconds (effective 569.2 kbit/s)...
    Hash of data verified.
    Compressed 3072 bytes to 103...
    Writing at 0x00008000... (100 %)
    Wrote 3072 bytes (103 compressed) at 0x00008000 in 0.1 seconds (effective 478.9 kbit/s)...
    Hash of data verified.

    Leaving...
    Hard resetting via RTS pin...
    Done