.. output_log

.. code-block:: none

    ...
    esptool.py --chip esp32 -p /dev/ttyUSB0 -b 460800 --before=default_reset --after=hard_reset write_flash --flash_mode dio --flash_freq 40m --flash_size 2MB 0x8000 partition_table/partition-table.bin 0x1000 bootloader/bootloader.bin 0x10000 hello_world.bin
    esptool.py v3.0-dev
    Serial port /dev/ttyUSB0
    Connecting........_
    Chip is ESP32D0WDQ6 (revision 0)
    Features: WiFi, BT, Dual Core, Coding Scheme None
    Crystal is 40MHz
    MAC: 24:0a:c4:05:b9:14
    Uploading stub...
    Running stub...
    Stub running...
    Changing baud rate to 460800
    Changed.
    Configuring flash size...
    Compressed 3072 bytes to 103...
    Writing at 0x00008000... (100 %)
    Wrote 3072 bytes (103 compressed) at 0x00008000 in 0.0 seconds (effective 5962.8 kbit/s)...
    Hash of data verified.
    Compressed 26096 bytes to 15408...
    Writing at 0x00001000... (100 %)
    Wrote 26096 bytes (15408 compressed) at 0x00001000 in 0.4 seconds (effective 546.7 kbit/s)...
    Hash of data verified.
    Compressed 147104 bytes to 77364...
    Writing at 0x00010000... (20 %)
    Writing at 0x00014000... (40 %)
    Writing at 0x00018000... (60 %)
    Writing at 0x0001c000... (80 %)
    Writing at 0x00020000... (100 %)
    Wrote 147104 bytes (77364 compressed) at 0x00010000 in 1.9 seconds (effective 615.5 kbit/s)...
    Hash of data verified.

    Leaving...
    Hard resetting via RTS pin...
    Done