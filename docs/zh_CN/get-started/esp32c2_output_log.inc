.. output_log

.. code-block:: none

    ...
    esptool.py esp32c2 -p /dev/ttyUSB0 -b 460800 --before=default_reset --after=hard_reset write_flash --flash_mode dio --flash_freq 60m --flash_size 2MB 0x0 bootloader/bootloader.bin 0x10000 hello_world.bin 0x8000 partition_table/partition-table.bin
    esptool.py v3.3.1
    Serial port /dev/ttyUSB0
    Connecting....
    Chip is ESP32-C2 (revision 1)
    Features: Wi-Fi
    Crystal is 40MHz
    MAC: 10:97:bd:f0:e5:0c
    Uploading stub...
    Running stub...
    Stub running...
    Changing baud rate to 460800
    Changed.
    Configuring flash size...
    Flash will be erased from 0x00000000 to 0x00004fff...
    Flash will be erased from 0x00010000 to 0x0002ffff...
    Flash will be erased from 0x00008000 to 0x00008fff...
    Compressed 18192 bytes to 10989...
    Writing at 0x00000000... (100 %)
    Wrote 18192 bytes (10989 compressed) at 0x00000000 in 0.6 seconds (effective 248.5 kbit/s)...
    Hash of data verified.
    Compressed 128640 bytes to 65895...
    Writing at 0x00010000... (20 %)
    Writing at 0x00019539... (40 %)
    Writing at 0x00020bf2... (60 %)
    Writing at 0x00027de1... (80 %)
    Writing at 0x0002f480... (100 %)
    Wrote 128640 bytes (65895 compressed) at 0x00010000 in 1.7 seconds (effective 603.0 kbit/s)...
    Hash of data verified.
    Compressed 3072 bytes to 103...
    Writing at 0x00008000... (100 %)
    Wrote 3072 bytes (103 compressed) at 0x00008000 in 0.1 seconds (effective 360.1 kbit/s)...
    Hash of data verified.

    Leaving...
    Hard resetting via RTS pin...