## tools/mocks/esp_wifi/Kconfig
```kconfig
# Mock Kconfig file to provide definitions
menu "Wi-Fi"
    config ESP_WIFI_STATIC_RX_BUFFER_NUM
        int "Max number of WiFi static RX buffers"
        range 2 25
        default 10

    config ESP_WIFI_DYNAMIC_RX_BUFFER_NUM
        int "Max number of WiFi dynamic RX buffers"
        range 0 1024
        default 32

    config ESP_WIFI_TX_BUFFER_TYPE
        int
        default 1

    config ESP_WIFI_ESPNOW_MAX_ENCRYPT_NUM
        int "Maximum espnow encrypt peers number"
        range 0 17
        default 7

    choice ESP_WIFI_MGMT_RX_BUFFER
        prompt "Type of WiFi RX MGMT buffers"
        default ESP_WIFI_DYNAMIC_RX_MGMT_BUFFER
        help
            This is just a placeholder configuration for mocking the WiFi driver.

        config ESP_WIFI_STATIC_RX_MGMT_BUFFER
            bool "Static"
        config ESP_WIFI_DYNAMIC_RX_MGMT_BUFFER
            bool "Dynamic"
    endchoice

    config ESP_WIFI_DYNAMIC_RX_MGMT_BUF
        int
        default 0 if ESP_WIFI_STATIC_RX_MGMT_BUFFER
        default 1 if ESP_WIFI_DYNAMIC_RX_MGMT_BUFFER

endmenu # Wi-Fi
```

## tools/mocks/freertos/Kconfig
```kconfig
menu "FreeRTOS"

    menu "Kernel"
        config FREERTOS_HZ
            int "configTICK_RATE_HZ"
            range 1 1000
            default 1000
            help
                Sets the FreeRTOS tick interrupt frequency in Hz (see configTICK_RATE_HZ documentation for more
                details).

        config FREERTOS_MAX_TASK_NAME_LEN
            int "configMAX_TASK_NAME_LEN"
            range 1 256
            default 16
            help
                Sets the maximum number of characters for task names (see configMAX_TASK_NAME_LEN documentation for
                more details).

                Note: For most uses, the default of 16 characters is sufficient.

        config FREERTOS_TASK_NOTIFICATION_ARRAY_ENTRIES
            int "configTASK_NOTIFICATION_ARRAY_ENTRIES"
            range 1 32
            default 1
            help
                Set the size of the task notification array of each task. When increasing this value, keep in
                mind that this means additional memory for each and every task on the system.
                However, task notifications in general are more light weight compared to alternatives
                such as semaphores.
    endmenu

    config FREERTOS_NO_AFFINITY
        # This invisible config value sets the value of tskNO_AFFINITY in task.h.
        # Intended to be used as a constant from other Kconfig files.
        # Value is (32-bit) INT_MAX.
        hex
        default 0x7FFFFFFF if !FREERTOS_SMP
        default 0xFFFFFFFF if FREERTOS_SMP

    config FREERTOS_UNICORE
        # This invisible config ensures that ESP-IDF components are always built as single-core
        # when building for CMock. CMock is currently only supported on the Linux target, and the
        # Linux FreeRTOS port supports single-core only.
        bool
        default y

    config FREERTOS_NUMBER_OF_CORES
        # Invisible option to configure the number of cores on which FreeRTOS runs
        # Todo: Unhide this option and deprecate CONFIG_FREERTOS_UNICORE (IDF-9156)
        int
        range 1 2
        default 1 if FREERTOS_UNICORE
        default 2 if !FREERTOS_UNICORE

endmenu
```

## tools/mocks/lwip/Kconfig
```kconfig
menu "LWIP"
    config LWIP_TCP_OVERSIZE_MSS
        bool "MSS"
        default y

    config LWIP_DHCP_COARSE_TIMER_SECS
        int "DHCP coarse timer interval(s)"
        default 1
        range 1 10

    config LWIP_IPV4
        bool "Enable IPv4"
        default y
        help
            Enable IPv4 stack. If you want to use IPv6 only TCP/IP stack, disable this.
endmenu
```

## tools/mocks/usb/usb_host_layer_mock/usb/Kconfig
```kconfig
# Config item from the original USB component needed for this CMock build

menu "USB Host Layer mock"

    config USB_HOST_CONTROL_TRANSFER_MAX_SIZE
        int "Largest size (in bytes) of transfers to/from default endpoints"
        default 256
        help
            Each USB device attached is allocated a dedicated buffer for its OUT/IN transfers to/from the device's
            control endpoint. The maximum size of that buffer is determined by this option. The limited size of the
            transfer buffer have the following implications:
            - The maximum length of control transfers is limited
            - Device's with configuration descriptors larger than this limit cannot be supported
endmenu
```

## tools/mocks/usb/usbh_layer_mock/usb/Kconfig
```kconfig
# Config items from the original USB component needed for this CMock build

menu "USBH Layer mock"

    config USB_HOST_CONTROL_TRANSFER_MAX_SIZE
        int "Largest size (in bytes) of transfers to/from default endpoints"
        default 256
        help
            Each USB device attached is allocated a dedicated buffer for its OUT/IN transfers to/from the device's
            control endpoint. The maximum size of that buffer is determined by this option. The limited size of the
            transfer buffer have the following implications:
            - The maximum length of control transfers is limited
            - Device's with configuration descriptors larger than this limit cannot be supported

    menu "Hub Driver Configuration"

        menu "Root Port configuration"

            config USB_HOST_DEBOUNCE_DELAY_MS
                int "Debounce delay in ms"
                default 250
                help
                    On connection of a USB device, the USB 2.0 specification requires
                    a "debounce interval with a minimum duration of 100ms" to allow the connection to stabilize
                    (see USB 2.0 chapter 7.1.7.3 for more details).
                    During the debounce interval, no new connection/disconnection events are registered.

                    The default value is set to 250 ms to be safe.

            config USB_HOST_RESET_HOLD_MS
                int "Reset hold in ms"
                default 30
                help
                    The reset signaling can be generated on any Hub or Host Controller port by request from
                    the USB System Software. The USB 2.0 specification requires that "the reset signaling must
                    be driven for a minimum of 10ms" (see USB 2.0 chapter 7.1.7.5 for more details).
                    After the reset, the hub port will transition to the Enabled state (refer to Section 11.5).

                    The default value is set to 30 ms to be safe.

            config USB_HOST_RESET_RECOVERY_MS
                int "Reset recovery delay in ms"
                default 30
                help
                    After a port stops driving the reset signal, the USB 2.0 specification requires that
                    the "USB System Software guarantees a minimum of 10 ms for reset recovery" before the
                    attached device is expected to respond to data transfers (see USB 2.0 chapter 7.1.7.3 for
                    more details).
                    The device may ignore any data transfers during the recovery interval.

                    The default value is set to 30 ms to be safe.


            config USB_HOST_SET_ADDR_RECOVERY_MS
                int "SetAddress() recovery time in ms"
                default 10
                help
                    "After successful completion of the Status stage, the device is allowed a SetAddress()
                    recovery interval of 2 ms. At the end of this interval, the device must be able to accept
                    Setup packets addressed to the new address. Also, at the end of the recovery interval, the
                    device must not respond to tokens sent to the old address (unless, of course, the old and new
                    address is the same)." See USB 2.0 chapter 9.2.6.3 for more details.

                    The default value is set to 10 ms to be safe.

        endmenu #Root Hub configuration
    endmenu #Hub Driver Configuration
endmenu
```

## tools/test_apps/build_system/bootloader/sdkconfig.defaults
```kconfig
#
# Security feature
#
# Start secure boot
#
CONFIG_SECURE_SIGNED_ON_BOOT=y
CONFIG_SECURE_SIGNED_ON_UPDATE=y
CONFIG_SECURE_SIGNED_APPS=y
CONFIG_SECURE_BOOT=y
CONFIG_SECURE_BOOT_V2_ENABLED=y
CONFIG_SECURE_BOOT_BUILD_SIGNED_BINARIES=n

#
# Start flash incryption
#
CONFIG_SECURE_FLASH_ENC_ENABLED=y
CONFIG_SECURE_FLASH_ENCRYPTION_MODE_DEVELOPMENT=y

#
# Increase partition table offset
#
CONFIG_PARTITION_TABLE_OFFSET=0xe000
CONFIG_ESPTOOLPY_FLASHSIZE_8MB=y
```
