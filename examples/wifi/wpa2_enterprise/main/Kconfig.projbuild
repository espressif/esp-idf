## examples/wifi/wpa2_enterprise/main/Kconfig.projbuild
```kconfig
menu "Example Configuration"

    config EXAMPLE_WIFI_SSID
        string "WiFi SSID"
        default "wpa2_test"
        help
            SSID (network name) for the example to connect to.

    config EXAMPLE_VALIDATE_SERVER_CERT
        bool "Validate server"
        default y
        help
            Validate the servers' certificate using CA cert.

    choice
        prompt "EAP method for the example to use"
        default EXAMPLE_EAP_METHOD_PEAP
        config EXAMPLE_EAP_METHOD_TLS
            bool "TLS"
        config EXAMPLE_EAP_METHOD_PEAP
            bool "PEAP"
        config EXAMPLE_EAP_METHOD_TTLS
            bool "TTLS"
    endchoice

    config EXAMPLE_EAP_METHOD
        int
        default 0 if EXAMPLE_EAP_METHOD_TLS
        default 1 if EXAMPLE_EAP_METHOD_PEAP
        default 2 if EXAMPLE_EAP_METHOD_TTLS

    config EXAMPLE_EAP_ID
        string "EAP ID"
        default "example@espressif.com"
        help
            Identity in phase 1 of EAP procedure.

    config EXAMPLE_EAP_USERNAME
        string "EAP USERNAME"
        depends on EXAMPLE_EAP_METHOD_PEAP || EXAMPLE_EAP_METHOD_TTLS
        default "espressif"
        help
            Username for EAP method (PEAP and TTLS).

    config EXAMPLE_EAP_PASSWORD
        string "EAP PASSWORD"
        depends on EXAMPLE_EAP_METHOD_PEAP || EXAMPLE_EAP_METHOD_TTLS
        default "test11"
        help
            Password for EAP method (PEAP and TTLS).

endmenu
```

## examples/wifi/wps/main/Kconfig.projbuild
```kconfig
menu "Example Configuration"

    choice EXAMPLE_WPS_TYPE
        prompt "WPS mode"
        default EXAMPLE_WPS_TYPE_PBC
        help
            WPS type for the esp32 to use.

        config EXAMPLE_WPS_TYPE_PBC
            bool "PBC"
        config EXAMPLE_WPS_TYPE_PIN
            bool "PIN"
        config EXAMPLE_WPS_TYPE_DISABLE
            bool "disable"
    endchoice

endmenu
```

## examples/wifi/wps_softap_registrar/main/Kconfig.projbuild
```kconfig
menu "Example Configuration"

    config EXAMPLE_WIFI_SSID
        string "WiFi SSID"
        default "myssid"
        help
            SSID (network name) for the example to connect to.

    config EXAMPLE_WIFI_PASSWORD
        string "WiFi Password"
        default "mypassword"
        help
            WiFi password (WPA or WPA2) for the example to use.

    config EXAMPLE_WIFI_CHANNEL
        int "WiFi Channel"
        range 1 13
        default 1
        help
            WiFi channel (network channel) for the example to use.

    config EXAMPLE_MAX_STA_CONN
        int "Maximal STA connections"
        default 4
        help
            Max number of the STA connects to AP.

    choice EXAMPLE_WPS_TYPE
        prompt "WPS mode"
        default EXAMPLE_WPS_TYPE_PBC
        help
            WPS type for the esp32 to use.

        config EXAMPLE_WPS_TYPE_PBC
            bool "PBC"
        config EXAMPLE_WPS_TYPE_PIN
            bool "PIN"
        config EXAMPLE_WPS_TYPE_DISABLE
            bool "disable"
    endchoice

    if EXAMPLE_WPS_TYPE_PIN
        config EXAMPLE_WPS_PIN_VALUE
            int "WPS PIN"
            default 0
            help
                WPS PIN to be used for the connection, incase its not give, AP will derive a new one.
    endif

endmenu
```

## examples/zigbee/esp_zigbee_rcp/sdkconfig.defaults
```kconfig
#
# Partition Table
#
CONFIG_PARTITION_TABLE_CUSTOM=y
CONFIG_PARTITION_TABLE_CUSTOM_FILENAME="partitions.csv"
CONFIG_PARTITION_TABLE_FILENAME="partitions.csv"
CONFIG_PARTITION_TABLE_OFFSET=0x8000
CONFIG_PARTITION_TABLE_MD5=y
# end of Partition Table

#
# ZBOSS Source
#
CONFIG_ZB_ENABLED=y
CONFIG_ZB_RCP=y
# end of ZBOSS Source
# end of Component config
```

## examples/zigbee/light_sample/HA_on_off_light/sdkconfig.defaults
```kconfig
#
# Partition Table
#
CONFIG_PARTITION_TABLE_CUSTOM=y
CONFIG_PARTITION_TABLE_CUSTOM_FILENAME="partitions.csv"
CONFIG_PARTITION_TABLE_FILENAME="partitions.csv"
CONFIG_PARTITION_TABLE_OFFSET=0x8000
CONFIG_PARTITION_TABLE_MD5=y
# end of Partition Table

#
# Zboss
#
CONFIG_ZB_ENABLED=y
CONFIG_ZB_ZED=y
# end of Zboss
# end of Component config
```

## examples/zigbee/light_sample/HA_on_off_switch/sdkconfig.defaults
```kconfig
#
# Partition Table
#
CONFIG_PARTITION_TABLE_CUSTOM=y
CONFIG_PARTITION_TABLE_CUSTOM_FILENAME="partitions.csv"
# end of Partition Table

#
# Zigbee
#
CONFIG_ZB_ENABLED=y
CONFIG_ZB_ZED=y
# end of Zigbee
```

## examples/zigbee/light_sample/light_bulb/sdkconfig.defaults
```kconfig
# Defaults for generating a new "sdkconfig" file (project settings).
# https://docs.espressif.com/projects/esp-idf/en/latest/esp32/api-guides/build-system.html#custom-sdkconfig-defaults
#
# NOTE - if this file changes, to get new defaults, you must erase any existing
# "sdkconfig" file (this will undo manual settings from "idf.py menuconfig").

CONFIG_IDF_TARGET="esp32h2"

#
# Partition Table
#
CONFIG_PARTITION_TABLE_CUSTOM=y
CONFIG_PARTITION_TABLE_CUSTOM_FILENAME="partitions.csv"
CONFIG_PARTITION_TABLE_FILENAME="partitions.csv"
CONFIG_PARTITION_TABLE_OFFSET=0x8000
CONFIG_PARTITION_TABLE_MD5=y
# end of Partition Table

#
# mbedTLS
#
CONFIG_MBEDTLS_HARDWARE_AES=n
CONFIG_MBEDTLS_HARDWARE_MPI=n
CONFIG_MBEDTLS_HARDWARE_SHA=n
CONFIG_MBEDTLS_CMAC_C=y
CONFIG_MBEDTLS_SSL_PROTO_DTLS=y
CONFIG_MBEDTLS_KEY_EXCHANGE_ECJPAKE=y
# end of TLS Key Exchange Methods

CONFIG_MBEDTLS_ECJPAKE_C=y
# end of mbedTLS

CONFIG_ESP_TASK_WDT_CHECK_IDLE_TASK_CPU0=n
CONFIG_TASK_WDT_CHECK_IDLE_TASK_CPU0=n

#
# Zboss
#
CONFIG_ZB_ENABLED=y
CONFIG_ZB_ZED=y
# end of Zboss
# end of Component config
```

## examples/zigbee/zb_common_components/light_driver/Kconfig
```kconfig
menu "ESP Zigbee DevKit LED Configuration"

    config GPIO_LED_ON_DEVKIT
        int "LED GPIO on devkit"
        default 8 if IDF_TARGET_ESP32H2
        default 8 if IDF_TARGET_ESP32C6
        default 27 if IDF_TARGET_ESP32C5
        default 8

        help
            The GPIO connected to the LED on the devkits

endmenu
```

## examples/zigbee/zb_common_components/switch_driver/Kconfig
```kconfig
menu "ESP Zigbee DevKit GPIO Configuration"
    config GPIO_BOOT_ON_DEVKIT
        int "BOOT GPIO on devkit"
        default 9 if IDF_TARGET_ESP32H2
        default 9 if IDF_TARGET_ESP32C6
        default 28 if IDF_TARGET_ESP32C5
        default 9

        help
            The GPIO connected to the BOOT button on the devkits

    config GPIO_EXT1_WAKEUP_SOURCE
        int "External wakeup GPIO"
        default 9 if IDF_TARGET_ESP32H2
        default 7 if IDF_TARGET_ESP32C6
        default 7 if IDF_TARGET_ESP32S31
        default 6 if IDF_TARGET_ESP32C5
        range 7 14 if IDF_TARGET_ESP32H2
        range 0 7 if IDF_TARGET_ESP32C6
        range 0 7 if IDF_TARGET_ESP32S31
        range 0 6 if IDF_TARGET_ESP32C5
        default 9

        help
            The GPIO can be used as external wake up source for sleep device

endmenu
```

## tools/cmakev2/test/components/component1/Kconfig
```kconfig
menu "component1 configuration"
    config COMPONENT1_OPTION
        prompt "component1 option"
        bool
endmenu
```

## tools/cmakev2/test/components/component2/Kconfig
```kconfig
menu "component2 configuration"
    config COMPONENT2_OPTION
        prompt "component2 option"
        bool
endmenu
```

## tools/kconfig_new/test/Kconfig
```kconfig
menu "Test config"

    config TEST_BOOL
        bool "Test boolean"
        default n

    config TEST_CHILD_BOOL
        bool "Test boolean"
        depends on TEST_BOOL
        default y

    config TEST_CHILD_STR
        string "Test str"
        depends on TEST_BOOL
        default "OHAI!"

    choice TEST_CHOICE
        prompt "Some choice"
        default CHOICE_A

        config CHOICE_A
            bool "A"

        config CHOICE_B
            bool "B"

    endchoice

    config DEPENDS_ON_CHOICE
        string "Depends on choice"
        default "Depends on A" if CHOICE_A
        default "Depends on B" if CHOICE_B
        default "WAT"

    config SOME_UNRELATED_THING
        bool "Some unrelated thing"

    config TEST_CONDITIONAL_RANGES
        int "Something with a range"
        range 0 100 if TEST_BOOL
        range 0 10
        default 1

endmenu
```

## tools/kconfig_new/test/confserver/Kconfig
```kconfig
menu "Test config"

    config TEST_BOOL
        bool "Test boolean"
        default n

    config TEST_CHILD_BOOL
        bool "Test boolean"
        depends on TEST_BOOL
        default y

    config TEST_CHILD_STR
        string "Test str"
        depends on TEST_BOOL
        default "OHAI!"

    choice TEST_CHOICE
        prompt "Some choice"
        default CHOICE_A

        config CHOICE_A
            bool "A"

        config CHOICE_B
            bool "B"

    endchoice

    config DEPENDS_ON_CHOICE
        string "Depends on choice"
        default "Depends on A" if CHOICE_A
        default "Depends on B" if CHOICE_B
        default "WAT"

    config SOME_UNRELATED_THING
        bool "Some unrelated thing"

    config TEST_CONDITIONAL_RANGES
        int "Something with a range"
        range 0 100 if TEST_BOOL
        range 0 10
        default 1

    config TEST_CONDITIONAL_HEX_RANGES
        hex "Something with a hex range"
        range 0x00 0xaf if TEST_BOOL
        range 0x10 0xaf
        default 0xa0

    config SUBMENU_TRIGGER
        bool "I enable/disable some submenu items"
        default y

    menu "Submenu"

        config SUBMENU_ITEM_A
            int "I am a submenu item"
            depends on SUBMENU_TRIGGER
            default 77

        config SUBMENU_ITEM_B
            bool "I am also submenu item"
            depends on SUBMENU_TRIGGER

    endmenu  # Submenu

    menuconfig SUBMENU_CONFIG
        bool "Submenuconfig"
        default y
        help
            I am a submenu which is also a config item.

    config SUBMENU_CONFIG_ITEM
        bool "Depends on submenuconfig"
        depends on SUBMENU_CONFIG
        default y

endmenu  # Test config
```

## tools/kconfig_new/test/gen_kconfig_doc/Kconfig
```kconfig
config IDF_TARGET
    string
    default "$IDF_TARGET"

config IDF_TARGET_CHIPA
    bool
    default "y" if IDF_TARGET="chipa"

config IDF_TARGET_CHIPB
    bool
    default "y" if IDF_TARGET="chipb"

config ALWAYS_VISIBLE
    bool "Always visible option"

choice ALWAYS_VISIBLE_CHOICE
    prompt "Always visible choice"
    default ALWAYS_VISIBLE_CHOICE_OP1

    config ALWAYS_VISIBLE_CHOICE_OP1
        bool "op1"

    config ALWAYS_VISIBLE_CHOICE_OP2
        bool "op2"
endchoice

config CONFIG_FOR_CHIPA
    bool "Config for chip A"
    depends on IDF_TARGET_CHIPA
    default n

config CONFIG_FOR_CHIPB
    bool "Config for chip B"
    depends on IDF_TARGET_CHIPB

choice CHOICE_FOR_CHIPA
    prompt "Always visible choice"
    default CHOICE_FOR_CHIPA_OP1
    depends on IDF_TARGET_CHIPA

    config CHOICE_FOR_CHIPA_OP1
        bool "op1"

    config CHOICE_FOR_CHIPA_OP2
        bool "op2"
endchoice

choice CHOICE_FOR_CHIPB
    prompt "Always visible choice"
    default CHOICE_FOR_CHIPB_OP1
    depends on IDF_TARGET_CHIPB

    config CHOICE_FOR_CHIPB_OP1
        bool "op1"

    config CHOICE_FOR_CHIPB_OP2
        bool "op2"
endchoice

source "Kconfig.chipa"
source "Kconfig.chipb"

config DEEP_DEPENDENT_CONFIG
    bool "Config depends on another config with default no value"
    depends on CONFIG_FOR_CHIPA

config DEEP_DEPENDENT_CONFIG_INV
    bool "Config depends on the inverted value of another config"
    depends on !CONFIG_FOR_CHIPA

choice DEEP_DEPENDENT_CHOICE
    prompt "depends on target-specific config"
    default DEEP_DEPENDENT_CHOICE_OP1
    depends on DEEP_DEPENDENT_CONFIG

    config DEEP_DEPENDENT_CHOICE_OP1
        bool "op1"

    config DEEP_DEPENDENT_CHOICE_OP2
        bool "op2"
endchoice

config INVISIBLE1
    bool "depends on cannot be satified at the same time"
    depends on CONFIG_FOR_CHIPA && IDF_TARGET_CHIPB

config VISIBLE1
    bool "makes no sense, just for testing OR dependencies"
    depends on CONFIG_FOR_CHIPA || IDF_TARGET_CHIPB

config CONFIG_FOR_CHIPA_DEPENDS_VAR1
    bool "redundant AND in depends on"
    depends on CONFIG_FOR_CHIPA && IDF_TARGET_CHIPA

config CONFIG_FOR_CHIPA_DEPENDS_VAR2
    bool "test AND + NOT"
    depends on CONFIG_FOR_CHIPA && !IDF_TARGET_CHIPB

config CONFIG_FOR_CHIPA_DEPENDS_VAR3
    bool "test NOT"
    depends on !IDF_TARGET_CHIPB

config CONFIG_DEPENDS_ENV_VAR1
    bool "test other environment variable (should be visible because only IDF_TARGET should make something invisible)"
    depends on IDF_XYZ

config CONFIG_DEPENDS_ENV_VAR2
    bool "test other environment variable (should be visible because only IDF_TARGET should make something invisible)"
    depends on !IDF_XYZ

choice CHIPA_VERSION
    prompt "CHIPA version"
    default CHIPA_VERSION2
    depends on CONFIG_FOR_CHIPA

    config CHIPA_VERSION1
        bool "Version 1"
    config CHIPA_VERSION2
        bool "Version 2"
    config CHIPA_VERSION3
        bool "Version 3"
endchoice

config CHIPA_REV_MIN
    int
    default 1 if CHIPA_VERSION1
    default 2 if CHIPA_VERSION2
    default 3 if CHIPA_VERSION3

config CHIPA_FEATURE_FROM_V1
    depends on CONFIG_FOR_CHIPA && (CHIPA_REV_MIN <= 1)
    bool "Feature available from version 1"

config CHIPA_FEATURE_FROM_V3
    depends on CONFIG_FOR_CHIPA && (CHIPA_REV_MIN <= 3)
    bool "Feature available from version 3"

config CHIPA_OPTION
    int "option with default value depending on the chip version"
    depends on IDF_TARGET_CHIPA
    default 5 if CHIPA_REV_MIN < 2
    default 4 if CHIPA_VERSION = 2
    default 9 if CHIPA_REV_MIN = 3

config COMPILER
    string "compiler prefix"
    default "ca" if IDF_TARGET_CHIPA
    default "cb" if IDF_TARGET_CHIPB

config BOOL_OPTION
    bool "bool option"
    default y

config BOOL_OPTION2
    bool "bool option 2"
    default BOOL_OPTION

config HEX_OPTION
    hex "bool option"
    default 0xce if IDF_TARGET_CHIPA
    default 0xff if IDF_TARGET_CHIPB
    range 0xf 0xce if IDF_TARGET_CHIPA
    range 0xfe 0xff if IDF_TARGET_CHIPB

config INT_OPTION
    int "int option"
    range 1 10 if IDF_TARGET_CHIPA
    range 100 200 if IDF_TARGET_CHIPB
```

## tools/kconfig_new/test/gen_kconfig_doc/Kconfig.chipa
```kconfig
menu "Menu for CHIPA"
    visible if IDF_TARGET_CHIPA

    config EXT_CONFIG1_FOR_CHIPA_MENU
        bool "Config for chip A"
        depends on IDF_TARGET_CHIPA

    config EXT_CONFIG2_FOR_CHIPA_MENU
        bool "Config for chip A (depend on the visibility of the menu)"

    config EXT_CONFIG3_FOR_CHIPA_MENU
        int "integer"
        default 5
endmenu

config EXT_CONFIG3_FOR_CHIPA
    bool "Config for chip A"
    depends on IDF_TARGET_CHIPA

config EXT_CONFIG4
    bool "Config for every chip (note that the config is defined at multiple places)"
    depends on IDF_TARGET_CHIPA
```

## tools/kconfig_new/test/gen_kconfig_doc/Kconfig.chipb
```kconfig
menu "Menu for CHIPB"
    visible if IDF_TARGET_CHIPB

    config EXT_CONFIG1_FOR_CHIPB_MENU
        bool "Config for chip B"
        depends on IDF_TARGET_CHIPB

    config EXT_CONFIG2_FOR_CHIPB_MENU
        bool "Config for chip B (depend on the visibility of the menu)"

endmenu

config EXT_CONFIG3_FOR_CHIPB
    bool "Config for chip B"
    depends on IDF_TARGET_CHIPB

config EXT_CONFIG4
    bool "Config for every chip (note that the config is defined at multiple places)"
    depends on IDF_TARGET_CHIPB
```

## tools/ldgen/test/data/Kconfig
```kconfig
menu "Test config"

    config PERFORMANCE_LEVEL
        int
        range 0 3
        prompt "Performance level"

    config PERFORMANCE_A
        bool
        default "y"

    config PERFORMANCE_B
        bool
        default "n"

    config PERFORMANCE_C
        bool
        default "y"
endmenu # Test config
```

## tools/mocks/esp-tls/Kconfig
```kconfig
menu "ESP-TLS"
    config ESP_TLS_USING_MBEDTLS
        bool "mbedTLS"
        default y
endmenu
```
