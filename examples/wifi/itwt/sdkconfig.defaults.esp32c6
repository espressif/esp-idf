## examples/wifi/wifi_aware/usd_publisher/main/Kconfig.projbuild
```kconfig
menu "Example Configuration"

    config ESP_WIFI_USD_PUB_SVC_NAME
        string "USD publish service name"
        default "ESP-USD-TEST"

    config ESP_WIFI_USD_PUB_TTL
        int "Time to live (in seconds)"
        range 0 1000
        default 100
        help
            Time to live of the Publish instance, in seconds. If TTL = 0, only one publish message is transmitted.

    config ESP_WIFI_USD_SVC_SPECIFIC_INFO
        string "Service specific info to be transmitted in a followup message"
        default "Welcome"
        help
            SSI to be transmitted in a followup frame

endmenu
```

## examples/wifi/wifi_aware/usd_subscriber/main/Kconfig.projbuild
```kconfig
menu "Example Configuration"

    config ESP_WIFI_USD_SUB_SVC_NAME
        string "USD subscribe service name"
        default "ESP-USD-TEST"

    config ESP_WIFI_USD_SUB_TTL
        int "Time to live (in seconds)"
        range 0 1000
        default 100
        help
            Time to live of the Subscribe instance, in seconds. If TTL = 0,
            the subscriber listens until the first service match is reported.

    config ESP_WIFI_USD_DEFAULT_CHAN
        int "Default Subscribe channel"
        range 1 13
        default 6
        help
            Default channel of subscriber

    config ESP_WIFI_USD_SVC_SPECIFIC_INFO
        string "Service specific info to be transmitted in a followup message"
        default "Hello"
        help
            SSI to be transmitted in a followup frame

endmenu
```

## examples/wifi/wifi_eap_fast/main/Kconfig.projbuild
```kconfig
menu "Example Configuration"

    config EXAMPLE_WIFI_SSID
        string "WiFi SSID"
        default "ESP_EAP_FAST_AP"
        help
            SSID (network name) for the example to connect to.

    choice
        prompt "Enterprise configuration to be used"
        default EXAMPLE_WPA3_ENTERPRISE
        config EXAMPLE_WPA2_ENTERPRISE
            bool "WPA2_ENT"
        config EXAMPLE_WPA3_ENTERPRISE
            bool "WPA3_ENT"
    endchoice

    if EXAMPLE_WPA2_ENTERPRISE
        config EXAMPLE_VALIDATE_SERVER_CERT
            bool "Validate server"
            default y
            help
                Validate the servers' certificate using CA cert.
    endif

    if !EXAMPLE_WPA2_ENTERPRISE
        config EXAMPLE_VALIDATE_SERVER_CERT
            default y
    endif

    config EXAMPLE_EAP_ID
        string "EAP ID"
        default "example@espressif.com"
        help
            Identity in phase 1 of EAP procedure.

    config EXAMPLE_EAP_USERNAME
        string "EAP USERNAME"
        default "espressif"
        help
            Username for EAP method.

    config EXAMPLE_EAP_PASSWORD
        string "EAP PASSWORD"
        default "test11"
        help
            Password for EAP method.

endmenu
```

## examples/wifi/wifi_easy_connect/dpp-enrollee/main/Kconfig.projbuild
```kconfig
menu "Example Configuration"
    config ESP_DPP_LISTEN_CHANNEL_LIST
        string "DPP Listen channel list"
        default "6"
        help
            DPP Bootstrapping listen channels separated by commas.

    config ESP_DPP_BOOTSTRAPPING_KEY
        string "Bootstrapping key"
        help
            64 hex digits (or 32 bytes) of raw private key for DPP Bootstrapping.

    config ESP_DPP_DEVICE_INFO
        string "Additional Device Info"
        help
            Additional ancillary information to be included in QR Code.
endmenu
```

## examples/wifi/wifi_enterprise/main/Kconfig.projbuild
```kconfig
menu "Example Configuration"

    config EXAMPLE_WIFI_SSID
        string "WiFi SSID"
        default "ESP_ENTERPRISE_AP"
        help
            SSID (network name) for the example to connect to.

    choice
        prompt "Enterprise configuration to be used"
        default EXAMPLE_WPA3_ENTERPRISE
        config EXAMPLE_WPA2_ENTERPRISE
            bool "WPA2_ENT"
        config EXAMPLE_WPA3_ENTERPRISE
            bool "WPA3_ENT"
        config EXAMPLE_WPA3_192BIT_ENTERPRISE
            bool "WPA3_192BIT_ENT"
            depends on SOC_WIFI_GCMP_SUPPORT
            select ESP_WIFI_GCMP_SUPPORT
            select ESP_WIFI_GMAC_SUPPORT
            select ESP_WIFI_SUITE_B_192
    endchoice

    if EXAMPLE_WPA2_ENTERPRISE
        config EXAMPLE_VALIDATE_SERVER_CERT
            bool "Validate server"
            default y
            help
                Validate the servers' certificate using CA cert.
    endif

    if !EXAMPLE_WPA2_ENTERPRISE
        config EXAMPLE_VALIDATE_SERVER_CERT
            default y
    endif

    choice
        prompt "EAP method for the example to use"
        default EXAMPLE_EAP_METHOD_TLS
        config EXAMPLE_EAP_METHOD_TLS
            bool "TLS"
        config EXAMPLE_EAP_METHOD_PEAP
            bool "PEAP"
        config EXAMPLE_EAP_METHOD_TTLS
            bool "TTLS"
    endchoice

    config EXAMPLE_EAP_METHOD
        int
        default 0 if EXAMPLE_EAP_METHOD_TLS
        default 1 if EXAMPLE_EAP_METHOD_PEAP
        default 2 if EXAMPLE_EAP_METHOD_TTLS

    choice
        prompt "Phase2 method for TTLS"
        depends on EXAMPLE_EAP_METHOD_TTLS
        default EXAMPLE_EAP_METHOD_TTLS_PHASE2_MSCHAPV2
        config EXAMPLE_EAP_METHOD_TTLS_PHASE2_MSCHAPV2
            bool "MSCHAPV2"
        config EXAMPLE_EAP_METHOD_TTLS_PHASE2_MSCHAP
            bool "MSCHAP"
        config EXAMPLE_EAP_METHOD_TTLS_PHASE2_PAP
            bool "PAP"
        config EXAMPLE_EAP_METHOD_TTLS_PHASE2_CHAP
            bool "CHAP"
    endchoice

    config EXAMPLE_EAP_METHOD_TTLS_PHASE_2
        int
        default 1 if EXAMPLE_EAP_METHOD_TTLS_PHASE2_MSCHAPV2
        default 2 if EXAMPLE_EAP_METHOD_TTLS_PHASE2_MSCHAP
        default 3 if EXAMPLE_EAP_METHOD_TTLS_PHASE2_PAP
        default 4 if EXAMPLE_EAP_METHOD_TTLS_PHASE2_CHAP

    config EXAMPLE_EAP_ID
        string "EAP ID"
        default "example@espressif.com"
        help
            Identity in phase 1 of EAP procedure.

    config EXAMPLE_EAP_USERNAME
        string "EAP USERNAME"
        depends on EXAMPLE_EAP_METHOD_PEAP || EXAMPLE_EAP_METHOD_TTLS
        default "espressif"
        help
            Username for EAP method (valid for PEAP and TTLS).

    config EXAMPLE_EAP_PASSWORD
        string "EAP PASSWORD"
        depends on EXAMPLE_EAP_METHOD_PEAP || EXAMPLE_EAP_METHOD_TTLS
        default "test11"
        help
            Password for EAP method (valid for PEAP and TTLS).

    config EXAMPLE_USE_DEFAULT_CERT_BUNDLE
        bool "Use default cert bundle"
        depends on EXAMPLE_VALIDATE_SERVER_CERT
        default n
        help
            Use default CA certificate bundle for WiFi enterprise connection
endmenu
```
