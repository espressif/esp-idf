## examples/wifi/itwt/sdkconfig.defaults.esp32c6
```kconfig
#
# ESP32C6-Specific
#
CONFIG_ESP_WIFI_STATIC_RX_BUFFER_NUM=20
CONFIG_ESP_WIFI_DYNAMIC_RX_BUFFER_NUM=38
CONFIG_ESP_WIFI_DYNAMIC_TX_BUFFER_NUM=35
CONFIG_ESP_WIFI_AMPDU_TX_ENABLED=y
CONFIG_ESP_WIFI_TX_BA_WIN=20
CONFIG_ESP_WIFI_AMPDU_RX_ENABLED=y
CONFIG_ESP_WIFI_RX_BA_WIN=20
CONFIG_ESP_WIFI_NVS_ENABLED=n

CONFIG_LWIP_TCP_SND_BUF_DEFAULT=30000
CONFIG_LWIP_TCP_WND_DEFAULT=34000
CONFIG_LWIP_TCP_RECVMBOX_SIZE=64
CONFIG_LWIP_UDP_RECVMBOX_SIZE=64
CONFIG_LWIP_TCPIP_RECVMBOX_SIZE=64

CONFIG_ESP_WIFI_ENABLE_WIFI_RX_STATS=n
CONFIG_ESP_WIFI_ENABLE_WIFI_TX_STATS=n

CONFIG_LWIP_IPV6=n

CONFIG_LWIP_DHCP_COARSE_TIMER_SECS=10
CONFIG_PM_POWER_DOWN_CPU_IN_LIGHT_SLEEP=y
CONFIG_PM_POWER_DOWN_PERIPHERAL_IN_LIGHT_SLEEP=y
CONFIG_ESP_SLEEP_POWER_DOWN_FLASH=y
CONFIG_ESP_MODEM_CLOCK_ENABLE_CHECKING=y
CONFIG_ESP_PHY_MAC_BB_PD=y
#CONFIG_ESP_WIFI_ENHANCED_LIGHT_SLEEP=y
```

## examples/wifi/power_save/main/Kconfig.projbuild
```kconfig
menu "Example Configuration"

    config EXAMPLE_GET_AP_INFO_FROM_STDIN
        bool "Get AP info from console"
        default n
        help
            If enabled, the example will prompt the user to enter the SSID and Password of the AP to be connected
            via the console.

    config EXAMPLE_WIFI_SSID
        string "WiFi SSID"
        default "myssid"
        depends on !EXAMPLE_GET_AP_INFO_FROM_STDIN
        help
            SSID (network name) for the example to connect to.

    config EXAMPLE_WIFI_PASSWORD
        string "WiFi Password"
        default "mypassword"
        depends on !EXAMPLE_GET_AP_INFO_FROM_STDIN
        help
            WiFi password (WPA or WPA2) for the example to use.

    config EXAMPLE_WIFI_LISTEN_INTERVAL
        int "WiFi listen interval"
        default 3
        help
            Interval for station to listen to beacon from AP. The unit of listen interval is one beacon interval.
            For example, if beacon interval is 100 ms and listen interval is 3, the interval for station to listen
            to beacon is 300 ms.

    config EXAMPLE_WIFI_BEACON_TIMEOUT
        int "WiFi beacon timeout"
        default 6
        range 6 30
        help
            For Station, If the station does not receive a beacon frame from the connected SoftAP during the
            inactive time, disconnect from SoftAP. Default 6s.

    choice EXAMPLE_POWER_SAVE_MODE
        prompt "power save mode"
        default EXAMPLE_POWER_SAVE_MIN_MODEM
        help
            Power save mode for the esp32 to use. Modem sleep mode includes minimum and maximum power save modes.
            In minimum power save mode, station wakes up every DTIM to receive beacon. Broadcast data will not be
            lost because it is transmitted after DTIM. However, it can not save much more power if DTIM is short
            for DTIM is determined by AP.
            In maximum power save mode, station wakes up every listen interval to receive beacon. Broadcast data
            may be lost because station may be in sleep state at DTIM time. If listen interval is longer, more power
            is saved but broadcast data is more easy to lose.

        config EXAMPLE_POWER_SAVE_NONE
            bool "none"
        config EXAMPLE_POWER_SAVE_MIN_MODEM
            bool "minimum modem"
        config EXAMPLE_POWER_SAVE_MAX_MODEM
            bool "maximum modem"
    endchoice

    choice EXAMPLE_MAX_CPU_FREQ
        prompt "Maximum CPU frequency"
        default EXAMPLE_MAX_CPU_FREQ_80
        depends on PM_ENABLE
        help
            Maximum CPU frequency to use for dynamic frequency scaling.

        config EXAMPLE_MAX_CPU_FREQ_80
            bool "80 MHz"
        config EXAMPLE_MAX_CPU_FREQ_120
            bool "120 MHz"
            depends on IDF_TARGET_ESP32C2
        config EXAMPLE_MAX_CPU_FREQ_160
            bool "160 MHz"
            depends on !IDF_TARGET_ESP32C2
        config EXAMPLE_MAX_CPU_FREQ_240
            bool "240 MHz"
            depends on IDF_TARGET_ESP32 || IDF_TARGET_ESP32S2 || IDF_TARGET_ESP32S3
    endchoice

    config EXAMPLE_MAX_CPU_FREQ_MHZ
        int
        default 80 if EXAMPLE_MAX_CPU_FREQ_80
        default 120 if EXAMPLE_MAX_CPU_FREQ_120
        default 160 if EXAMPLE_MAX_CPU_FREQ_160
        default 240 if EXAMPLE_MAX_CPU_FREQ_240

    choice EXAMPLE_MIN_CPU_FREQ
        prompt "Minimum CPU frequency"
        default EXAMPLE_MIN_CPU_FREQ_10M
        depends on PM_ENABLE
        help
            Minimum CPU frequency to use for dynamic frequency scaling.
            Should be set to XTAL frequency or XTAL frequency divided by integer.

        config EXAMPLE_MIN_CPU_FREQ_40M
            bool "40 MHz (use with 40MHz XTAL)"
            depends on XTAL_FREQ_40 || XTAL_FREQ_AUTO
        config EXAMPLE_MIN_CPU_FREQ_20M
            bool "20 MHz (use with 40MHz XTAL)"
            depends on XTAL_FREQ_40 || XTAL_FREQ_AUTO
        config EXAMPLE_MIN_CPU_FREQ_10M
            bool "10 MHz (use with 40MHz XTAL)"
            depends on XTAL_FREQ_40 || XTAL_FREQ_AUTO
        config EXAMPLE_MIN_CPU_FREQ_26M
            bool "26 MHz (use with 26MHz XTAL)"
            depends on XTAL_FREQ_26 || XTAL_FREQ_AUTO
        config EXAMPLE_MIN_CPU_FREQ_13M
            bool "13 MHz (use with 26MHz XTAL)"
            depends on XTAL_FREQ_26 || XTAL_FREQ_AUTO
    endchoice

    config EXAMPLE_MIN_CPU_FREQ_MHZ
        int
        default 40 if EXAMPLE_MIN_CPU_FREQ_40M
        default 20 if EXAMPLE_MIN_CPU_FREQ_20M
        default 10 if EXAMPLE_MIN_CPU_FREQ_10M
        default 26 if EXAMPLE_MIN_CPU_FREQ_26M
        default 13 if EXAMPLE_MIN_CPU_FREQ_13M

endmenu
```

## examples/wifi/power_save/sdkconfig.defaults
```kconfig
# Use lower CPU frequency
CONFIG_ESP_DEFAULT_CPU_FREQ_MHZ_80=y
# Enable support for power management
CONFIG_PM_ENABLE=y
# Enable tickless idle mode
CONFIG_FREERTOS_USE_TICKLESS_IDLE=y
# Put related source code in IRAM
CONFIG_PM_SLP_IRAM_OPT=y
CONFIG_PM_RTOS_IDLE_OPT=y
# Disable all GPIO at light sleep
CONFIG_GPIO_ESP32_SUPPORT_SWITCH_SLP_PULL=y
CONFIG_PM_SLP_DISABLE_GPIO=y
# Enable wifi sleep iram optimization
CONFIG_ESP_WIFI_SLP_IRAM_OPT=y
# Use 1000Hz freertos tick to lower sleep time threshold
CONFIG_FREERTOS_HZ=1000
```

## examples/wifi/power_save/sdkconfig.defaults.esp32s31
```kconfig
# ESP32-S31 does not support 80 MHz; use the lowest available CPU frequency
CONFIG_ESP_DEFAULT_CPU_FREQ_MHZ_240=y
```

## examples/wifi/roaming/roaming_11kvr/main/Kconfig.projbuild
```kconfig
menu "Example Configuration"

    config EXAMPLE_WIFI_SSID
        string "WiFi SSID"
        default "roaming_test"
        help
            SSID (network name) for the example to connect to.

    config EXAMPLE_WIFI_PASSWORD
        string "WiFi Password"
        default "password"
        help
            WiFi password (WPA or WPA2) for the example to use.

    config EXAMPLE_WIFI_RSSI_THRESHOLD
        int "WiFi RSSI threshold to trigger roaming"
        default 0
        help
            WiFi RSSI threshold to trigger roaming value in dbm (-100 to 0). 0 denotes feature is disabled.

endmenu
```

## examples/wifi/roaming/roaming_app/sdkconfig.defaults
```kconfig
CONFIG_IDF_EXPERIMENTAL_FEATURES=y


CONFIG_ESP_WIFI_SOFTAP_SUPPORT=n
CONFIG_ESP_WIFI_11KV_SUPPORT=y
CONFIG_ESP_WIFI_SCAN_CACHE=y
CONFIG_ESP_WIFI_MBO_SUPPORT=y
CONFIG_ESP_WIFI_ENABLE_ROAMING_APP=y
CONFIG_ESP_WIFI_11R_SUPPORT=y
```

## examples/wifi/roaming/sdkconfig.defaults
```kconfig
CONFIG_ESP_WIFI_11KV_SUPPORT=y
CONFIG_ESP_WIFI_SCAN_CACHE=y
CONFIG_ESP_WIFI_MBO_SUPPORT=y
CONFIG_ESP_WIFI_11R_SUPPORT=y
```

## examples/wifi/scan/main/Kconfig.projbuild
```kconfig
menu "Example Configuration"

    config EXAMPLE_SCAN_LIST_SIZE
        int "Max size of scan list"
        range 0 20
        default 10
        help
            The size of array that will be used to retrieve the list of access points.

    config EXAMPLE_USE_SCAN_CHANNEL_BITMAP
        bool "Scan only non overlapping channels using Channel bitmap"
        default 0
        help
            Enable this to scan only the non overlapping channels i.e 1,6,11 by mentioning a channel bitmap
            in scan config. If you wish to scan a different set of specific channels, please edit the channel_list
            array in scan.c. Channels for a 2.4 ghz network range should range from 1-14.
endmenu
```

## examples/wifi/simple_sniffer/main/Kconfig.projbuild
```kconfig
menu "Example Configuration"

config STORE_HISTORY
    bool "Store command history in flash"
    default y
    help
        Linenoise line editing library provides functions to save and load
        command history. If this option is enabled, initalizes a FAT filesystem
        and uses it to store command history.

config SNIFFER_MOUNT_POINT
    string "Mount Point in your filesystem to store pcap files"
    default "/sdcard"
    help
        Here you need to specify the mount point in the VFS (Virtual File System) where the pcap would be saved.

config SNIFFER_WORK_QUEUE_LENGTH
    int "Length of sniffer work queue"
    default 128
    help
        The sniffer callback function should not do heavy work, so we put all heavy IO operation to another task.
        The task gets some basic info of sniffer packet via queue.
        Here you should specify the length of queue.

config SNIFFER_TASK_STACK_SIZE
    int "Stack size of sniffer task"
    default 2560
    help
        The stack size of sniffer task.

config SNIFFER_TASK_PRIORITY
    int "Priority of sniffer task"
    default 2
    help
        Priority of sniffer task.

config PCAP_FILE_MAX_PACKETS
    int "Max packets in a pcap file"
    default 2000
    help
        To avoid the pcap file being very large, we should save packets into multiple fiiles.
        Here you should specify the max number of packets that should be save in one pcap file.

endmenu
```

## examples/wifi/simple_wifi/main/Kconfig.projbuild
```kconfig
menu "Example Configuration"

choice ESP_WIFI_MODE
    prompt "AP or STA"
    default ESP_WIFI_IS_STATION
    help
        Whether the esp32 is softAP or station.

config ESP_WIFI_IS_SOFTAP
    bool "SoftAP"
config ESP_WIFI_IS_STATION
    bool "Station"
endchoice

config ESP_WIFI_MODE_AP
    bool
    default y if ESP_WIFI_IS_SOFTAP
    default n if ESP_WIFI_IS_STATION

config ESP_WIFI_SSID
    string "WiFi SSID"
    default "myssid"
    help
	SSID (network name) for the example to connect to.

config ESP_WIFI_PASSWORD
    string "WiFi Password"
    default "mypassword"
    help
	WiFi password (WPA or WPA2) for the example to use.
		
config MAX_STA_CONN
    int "Max STA conn"
    default 4
    help
	Max number of the STA connects to AP.
endmenu
```

## examples/wifi/smart_config/main/Kconfig.projbuild
```kconfig
menu "Example Configuration"

    config SET_MAC_ADDRESS_OF_TARGET_AP
        bool "whether set MAC address of target AP or not"
        default y

endmenu
```

## examples/wifi/wifi_aware/nan_publisher/main/Kconfig.projbuild
```kconfig
menu "Example Configuration"

    config ESP_WIFI_NAN_SVC_NAME
        string "NAN Service Name"
        default "test"

    choice
        prompt "Publish Type"
        default EXAMPLE_NAN_PUBLISH_UNSOLICITED
        config EXAMPLE_NAN_PUBLISH_UNSOLICITED
            bool "UNSOLICITED"
        config EXAMPLE_NAN_PUBLISH_SOLICITED
            bool "SOLICITED"
    endchoice

    config ESP_WIFI_NAN_MATCHING_FILTER
        string "Matching Filter"
        default ""

    config ESP_WIFI_NAN_SERVICE_MESSAGE
        string "Reply message"
        default "Welcome"
        help
            Send a reply to the Follow Up sent by a Subscriber

    menu "Security Configuration"
        config EXAMPLE_NAN_SECURITY_ENABLED
            bool "Enable NAN Security"
            depends on ESP_WIFI_NAN_SECURITY
            default y
            help
                Enable encrypted NAN datapath (NDP Security) for this example.
                When enabled the publisher advertises a secured service and
                accepts only encrypted NDP setups from subscribers that share
                the same credential (passphrase or PMK).
                Disable to advertise an open (unencrypted) service.

        choice EXAMPLE_NAN_SECURITY_METHOD
            prompt "Security Method"
            depends on EXAMPLE_NAN_SECURITY_ENABLED
            default EXAMPLE_NAN_SEC_METHOD_PASSPHRASE
            help
                Choose the method for NAN discovery security.

            config EXAMPLE_NAN_SEC_METHOD_PASSPHRASE
                bool "Passphrase-based (Password)"
            config EXAMPLE_NAN_SEC_METHOD_PMK
                bool "Direct PMK (32-byte hex)"
        endchoice

        config EXAMPLE_NAN_PASSPHRASE
            string "Passphrase"
            depends on EXAMPLE_NAN_SEC_METHOD_PASSPHRASE
            default "password"
            help
                Passphrase for NAN Discovery security.

        config EXAMPLE_NAN_PMK
            string "Direct PMK (Hex)"
            depends on EXAMPLE_NAN_SEC_METHOD_PMK
            default "ee3585063056d164d15454ad39010d4e2640b0d82fb24a2d6899862d273c68bf"
            help
                32-byte hex string representing the PMK.
    endmenu

endmenu
```

## examples/wifi/wifi_aware/nan_subscriber/main/Kconfig.projbuild
```kconfig
menu "Example Configuration"

    config ESP_WIFI_NAN_SVC_NAME
        string "NAN Service Name"
        default "test"

    choice
        prompt "Subscribe Type"
        default EXAMPLE_NAN_SUBSCRIBE_PASSIVE
        config EXAMPLE_NAN_SUBSCRIBE_PASSIVE
            bool "PASSIVE"
        config EXAMPLE_NAN_SUBSCRIBE_ACTIVE
            bool "ACTIVE"
    endchoice

    config ESP_WIFI_NAN_MATCHING_FILTER
        string "Matching Filter"
        default ""

    choice
        prompt "Communication Type"
        default EXAMPLE_NAN_SEND_MESSAGE
        config EXAMPLE_NAN_SEND_MESSAGE
            bool "Send Message"
        config EXAMPLE_NAN_SEND_PING
            bool "IPv6 Ping"
    endchoice

    config ESP_WIFI_NAN_SERVICE_MESSAGE
        depends on EXAMPLE_NAN_SEND_MESSAGE
        string "Message"
        default "Hello"
        help
            Send a message to the Publisher using NAN Follow Up

    menu "Security Configuration"
        config EXAMPLE_NAN_SECURITY_ENABLED
            bool "Enable NAN Security"
            depends on ESP_WIFI_NAN_SECURITY
            default y
            help
                Enable encrypted NAN datapath (NDP Security) for this example.
                When enabled the subscriber only matches secured Publish SDFs
                whose PMKID is derivable from the credential configured below
                (passphrase or PMK) and sets up an encrypted NDP.
                Disable to discover open (unencrypted) services.

        choice EXAMPLE_NAN_SECURITY_METHOD
            prompt "Security Method"
            depends on EXAMPLE_NAN_SECURITY_ENABLED
            default EXAMPLE_NAN_SEC_METHOD_PASSPHRASE
            help
                Choose the method for NAN discovery security.

            config EXAMPLE_NAN_SEC_METHOD_PASSPHRASE
                bool "Passphrase-based (Password)"
            config EXAMPLE_NAN_SEC_METHOD_PMK
                bool "Direct PMK (32-byte hex)"
        endchoice

        config EXAMPLE_NAN_PASSPHRASE
            string "Passphrase"
            depends on EXAMPLE_NAN_SEC_METHOD_PASSPHRASE
            default "password"
            help
                Passphrase for NAN Discovery security. Must match the publisher.

        config EXAMPLE_NAN_PMK
            string "Direct PMK (Hex)"
            depends on EXAMPLE_NAN_SEC_METHOD_PMK
            default "ee3585063056d164d15454ad39010d4e2640b0d82fb24a2d6899862d273c68bf"
            help
                32-byte hex string representing the PMK. Must match the publisher.
    endmenu

endmenu
```
