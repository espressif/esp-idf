## examples/protocols/coap_client/sdkconfig.defaults
```kconfig
CONFIG_MBEDTLS_SSL_PROTO_DTLS=y
CONFIG_MBEDTLS_PSK_MODES=y
CONFIG_MBEDTLS_KEY_EXCHANGE_PSK=y
CONFIG_LWIP_NETBUF_RECVINFO=y
CONFIG_COAP_CLIENT_SUPPORT=y
```

## examples/protocols/coap_server/main/Kconfig.projbuild
```kconfig
menu "Example CoAP Server Configuration"

    # Hidden option that selects IPv4
    config EXAMPLE_COAP_NEEDS_IPV4
        bool
        default true
        select LWIP_IPV4

    config EXAMPLE_COAP_PSK_KEY
        string "Preshared Key (PSK) to used in the connection from the CoAP client"
        depends on COAP_MBEDTLS_PSK
        default "secret-key"
        help
            The Preshared Key to use to encrypt the communicatons. The same key must be
            used at both ends of the CoAP connection, and the CoaP client must request
            an URI prefixed with coaps:// instead of coap:// for DTLS to be used.

    choice EXAMPLE_COAP_MCAST_IP_MODE
        prompt "Receive Multicast IP type"
        help
            Example can receive multicast IPV4, IPV6, both or none.

        config EXAMPLE_COAP_MCAST_NONE
            bool "None"

        config EXAMPLE_COAP_MCAST_IPV4_V6
            bool "IPV4 & IPV6"
            select EXAMPLE_COAP_MCAST_IPV4
            select EXAMPLE_COAP_MCAST_IPV6

        config EXAMPLE_COAP_MCAST_IPV4_ONLY
            bool "IPV4"
            select EXAMPLE_COAP_MCAST_IPV4

        config EXAMPLE_COAP_MCAST_IPV6_ONLY
            bool "IPV6"
            select EXAMPLE_COAP_MCAST_IPV6

    endchoice

    config EXAMPLE_COAP_MCAST_IPV4
        bool
    config EXAMPLE_COAP_MCAST_IPV6
        bool
        select EXAMPLE_CONNECT_IPV6 if IDF_TARGET_ESP32

    config EXAMPLE_COAP_MULTICAST_IPV4_ADDR
        string "CoAP Multicast IPV4 Address (receive)"
        default "224.0.1.187"
        depends on EXAMPLE_COAP_MCAST_IPV4
        help
            IPV4 multicast address to receive multicast traffic on.

            The default CoAP IPV4 address is 224.0.1.187.

    config EXAMPLE_COAP_MULTICAST_IPV6_ADDR
        string "CoAP Multicast IPV6 Address (receive)"
        default "FF02::FD"
        depends on EXAMPLE_COAP_MCAST_IPV6
        help
            IPV6 multicast address to receive multicast traffic on.

            The default CoAP FF02::FD address is a link-local multicast address.
            Consult IPV6 specifications or documentation for information about
            meaning of different IPV6 multicast ranges.

endmenu
```

## examples/protocols/dns_over_https/components/dns_over_https/Kconfig
```kconfig
menu "DNS-over-HTTPS Configuration"

    config HTTPS_DNS_HTTP_VERSION
        string
        prompt "DNS-over-HTTPS Server HTTP version"
        default "1.1"
        help
            HTTP version of DNS-over-HTTPS server.

endmenu
```

## examples/protocols/dns_over_https/components/time_sync/Kconfig
```kconfig
menu "Time Sync Configuration"

    config TIME_SYNC_NTP_SERVER
        string "NTP Server"
        default "pool.ntp.org"
        help
            Configure the NTP server for time synchronization.
            The default is set to "pool.ntp.org".

    config TIME_SYNC_NTP_UPDATE_PERIOD
        int "NTP Time Update Interval (in hours)"
        default 24
        range 1 24
        help
            The time interval in hours for updating the system time using the NTP server.
            For example, if set to 12, the system will update the time from the NTP server every 12 hours.

endmenu
```

## examples/protocols/dns_over_https/main/Kconfig.projbuild
```kconfig
menu "Example DNS-over-HTTPS Configuration"

    choice HTTPS_DNS_SERVER
        prompt "Choose DNS-over-HTTPS Server"
        default HTTPS_DNS_SERVER_GOOGLE

        config HTTPS_DNS_SERVER_GOOGLE
            bool "Google DNS (dns.google)"
            help
                Use Google's DNS-over-HTTPS server (dns.google) with its corresponding root certificate.

        config HTTPS_DNS_SERVER_CLOUDFLARE
            bool "Cloudflare DNS (cloudflare-dns.com)"
            help
                Use Cloudflare's DNS-over-HTTPS server (cloudflare-dns.com) with its corresponding root certificate.

        config HTTPS_DNS_SERVER_CUSTOM
            bool "Custom DNS-over-HTTPS Server"
            help
                Use a custom DNS-over-HTTPS server. You must specify both the server URL and certificate manually.
    endchoice

    config HTTPS_DNS_SERVER_URL_GOOGLE
        string
        prompt "Google DNS-over-HTTPS Server URL"
        default "dns.google"
        depends on HTTPS_DNS_SERVER_GOOGLE
        help
            Google DNS-over-HTTPS server URL.

    config HTTPS_DNS_SERVICE_PATH_GOOGLE
        string
        prompt "Path to Google DNS-over-HTTPS Service"
        default "dns-query"
        depends on HTTPS_DNS_SERVER_GOOGLE
        help
            Path to Google DNS-over-HTTPS Service.

    config HTTPS_DNS_SERVER_URL_CLOUDFLARE
        string
        prompt "Cloudflare DNS-over-HTTPS Server URL"
        default "cloudflare-dns.com"
        depends on HTTPS_DNS_SERVER_CLOUDFLARE
        help
            Cloudflare DNS-over-HTTPS server URL.

    config HTTPS_DNS_SERVICE_PATH_CLOUDFLARE
        string
        prompt "Path to Cloudflare DNS-over-HTTPS Service"
        default "dns-query"
        depends on HTTPS_DNS_SERVER_CLOUDFLARE
        help
            Path to Cloudflare DNS-over-HTTPS Service.

    config HTTPS_DNS_SERVER_URL_CUSTOM
        string
        prompt "Custom DNS-over-HTTPS Server URL"
        depends on HTTPS_DNS_SERVER_CUSTOM
        help
            Specify your custom DNS-over-HTTPS server URL here.

    config HTTPS_DNS_SERVICE_PATH_CUSTOM
        string
        prompt "Path to the Custom DNS-over-HTTPS Service"
        default "dns-query"
        depends on HTTPS_DNS_SERVER_CUSTOM
        help
            Path to the Custom DNS-over-HTTPS Service.

    config HTTPS_DNS_ESP_CERT_BUNDLE
        bool "Use internal certificate bundle"
        default y
        help
            Enable this option to use the internal certificate bundle for DNS-over-HTTPS.

    config HTTPS_DNS_CERT_GOOGLE_HIDDEN
        string
        default "cert_google_root.pem"
        depends on HTTPS_DNS_SERVER_GOOGLE && !HTTPS_DNS_ESP_CERT_BUNDLE

    config HTTPS_DNS_CERT_GOOGLE
        string
        prompt "Google DNS Certificate (readonly)"
        default HTTPS_DNS_CERT_GOOGLE_HIDDEN
        depends on HTTPS_DNS_SERVER_GOOGLE && !HTTPS_DNS_ESP_CERT_BUNDLE
        help
            Google DNS root certificate in PEM format. This option is read-only.

    config HTTPS_DNS_CERT_CUSTOM_HIDDEN
        string
        default "cert_custom_root.pem"
        depends on HTTPS_DNS_SERVER_CUSTOM && !HTTPS_DNS_ESP_CERT_BUNDLE

    config HTTPS_DNS_CERT_CUSTOM
        string
        prompt "Custom DNS Certificate (readonly)"
        default HTTPS_DNS_CERT_CUSTOM_HIDDEN
        depends on HTTPS_DNS_SERVER_CUSTOM && !HTTPS_DNS_ESP_CERT_BUNDLE
        help
            Specify the certificate file for the custom DNS server in PEM format. This option is read-only.

endmenu
```
