## examples/power_save/auto_light_sleep/main/Kconfig.projbuild
```kconfig
menu "Example Configuration"

    menu "GPIO wakeup configuration"

        config EXAMPLE_GPIO_WAKEUP_SLEEP_NUM
            int "Enable wakeup from GPIO"
            default 6  if IDF_TARGET_ESP32S3 || IDF_TARGET_ESP32C3 || IDF_TARGET_ESP32C2 || IDF_TARGET_ESP32C6
            default 5  if IDF_TARGET_ESP32S2
            default 4  if IDF_TARGET_ESP32
            default 10  if IDF_TARGET_ESP32H2
            default 0
            range 0 7  if PM_POWER_DOWN_PERIPHERAL_IN_LIGHT_SLEEP && IDF_TARGET_ESP32C6
            range 7 14 if PM_POWER_DOWN_PERIPHERAL_IN_LIGHT_SLEEP && IDF_TARGET_ESP32H2
            range 0 40
            help
                This option is used to set the wakeup and sleep pin.
        
        config EXAMPLE_USE_PULSE_WAKEUP
            bool "Enable GPIO pulse wakeup"
            default n
            help
                This option set the gpio wakeup mode. If this option is enabled, it is a pulse wakeup mode, otherwise it is a level wakeup mode.

        config EXAMPLE_GPIO_WAKEUP_HIGH_LEVEL
            bool "Enable GPIO high-level wakeup"
            default n
            help
                This option set the gpio wake-up trigger signal, In light sleep, only high or low level wake-up is
                supported. If this option is enabled, it is a high level wake up, otherwise it is a low level wake up.

        config EXAMPLE_USE_INTERNAL_PU_PD
            bool "Use internal pull up and pull down"
            default y
            help
                This option set the pull-down mode of the gpio. If this option is enabled, 
                then the internal pull-down is used, otherwise the external access pull-down is used.
    endmenu

    menu "event configuration"

        config EXAMPLE_EVENT_QUEUE_LEN
            int "Event queue length"
            default 5
            range 1 15
            help
                This option is used to set the length of the queue in which events are stored.
                It is recommended to set it to between 5 and 10. 
                Because if it is too small, it is easy to cause the system to crash; too big is also useless.

        config EXAMPLE_EVENT_TASK_STACK_SIZE
            int "Event task`s stack size"
            default 4096
            range 1 8192
            help
                This option is used to set the stack size of the task that handles the event.
                When there is extra heap space requested in the task, it should be set larger.

        config EXAMPLE_EVENT_TASK_PRIORITY
            int "Event task`s priority"
            default 10
            range 1 15
            help
                This option is used to set the priority of the task.
                The higher the value, the higher the priority. A value of 10 is usually sufficient.
    endmenu

    menu "power manager configuration"

        choice EXAMPLE_PM_LOCK_TYPE
            prompt "Set pm lock"
            default EXAMPLE_PM_LOCK_TYPE_NO_LIGHT_SLEEP
            help
                set lock in pm config.

            config EXAMPLE_PM_LOCK_TYPE_CPU_FREQ_MAX
                bool "CPU_FREQ_MAX lock"
            config EXAMPLE_PM_LOCK_TYPE_APB_FREQ_MAX
                bool "APB_FREQ_MAX lock"
            config EXAMPLE_PM_LOCK_TYPE_NO_LIGHT_SLEEP
                bool "NO_LIGHT_SLEEP lock"
        endchoice

        config EXAMPLE_PM_LOCK_TYPE
            int
            default 0 if EXAMPLE_PM_LOCK_TYPE_CPU_FREQ_MAX
            default 1 if EXAMPLE_PM_LOCK_TYPE_APB_FREQ_MAX
            default 2 if EXAMPLE_PM_LOCK_TYPE_NO_LIGHT_SLEEP

        choice EXAMPLE_PM_MAX_FREQ_MHZ
            prompt "Set max freq in pm config"
            default EXAMPLE_PM_MAX_FREQ_MHZ_96 if IDF_TARGET_ESP32H2
            default EXAMPLE_PM_MAX_FREQ_MHZ_120 if IDF_TARGET_ESP32C2
            default EXAMPLE_PM_MAX_FREQ_MHZ_160 if IDF_TARGET_ESP32C3 || IDF_TARGET_ESP32C6
            default EXAMPLE_PM_MAX_FREQ_MHZ_240
            help
                set max freq in pm config.

            config EXAMPLE_PM_MAX_FREQ_MHZ_80
                bool "80 MHz" if !IDF_TARGET_ESP32H2
            config EXAMPLE_PM_MAX_FREQ_MHZ_120
                bool "120 MHz" if IDF_TARGET_ESP32C2
            config EXAMPLE_PM_MAX_FREQ_MHZ_160
                bool "160 MHz" if !IDF_TARGET_ESP32H2 && !IDF_TARGET_ESP32C2
            config EXAMPLE_PM_MAX_FREQ_MHZ_240
                bool "240 MHz" if !IDF_TARGET_ESP32H2 && !IDF_TARGET_ESP32C2 && !IDF_TARGET_ESP32C3 && !IDF_TARGET_ESP32C6

            config EXAMPLE_PM_MAX_FREQ_MHZ_96
                bool "96 MHz" if IDF_TARGET_ESP32H2
            config EXAMPLE_PM_MAX_FREQ_MHZ_64
                bool "64 MHz" if IDF_TARGET_ESP32H2
            config EXAMPLE_PM_MAX_FREQ_MHZ_48
                bool "48 MHz" if IDF_TARGET_ESP32H2
        endchoice

        config EXAMPLE_PM_MAX_FREQ_MHZ
            int
            default 80 if EXAMPLE_PM_MAX_FREQ_MHZ_80
            default 120 if EXAMPLE_PM_MAX_FREQ_MHZ_120
            default 160 if EXAMPLE_PM_MAX_FREQ_MHZ_160
            default 240 if EXAMPLE_PM_MAX_FREQ_MHZ_240
            default 96 if EXAMPLE_PM_MAX_FREQ_MHZ_96
            default 64 if EXAMPLE_PM_MAX_FREQ_MHZ_64
            default 48 if EXAMPLE_PM_MAX_FREQ_MHZ_48

        choice EXAMPLE_PM_MIN_FREQ_MHZ
            prompt "Set min freq in pm config"
            default EXAMPLE_PM_MIN_FREQ_MHZ_32 if IDF_TARGET_ESP32H2
            default EXAMPLE_PM_MIN_FREQ_MHZ_40
            help
                set min freq in pm config.

            config EXAMPLE_PM_MIN_FREQ_MHZ_40
                bool "40 MHz" if !IDF_TARGET_ESP32H2
            config EXAMPLE_PM_MIN_FREQ_MHZ_80
                bool "80 MHz" if !IDF_TARGET_ESP32H2
            config EXAMPLE_PM_MIN_FREQ_MHZ_32
                bool "32 MHz" if IDF_TARGET_ESP32H2
            config EXAMPLE_PM_MIN_FREQ_MHZ_48
                bool "48 MHz" if IDF_TARGET_ESP32H2
            config EXAMPLE_PM_MIN_FREQ_MHZ_64
                bool "64 MHz" if IDF_TARGET_ESP32H2
        endchoice

        config EXAMPLE_PM_MIN_FREQ_MHZ
            int
            default 40 if EXAMPLE_PM_MIN_FREQ_MHZ_40
            default 80 if EXAMPLE_PM_MIN_FREQ_MHZ_80
            default 32 if EXAMPLE_PM_MIN_FREQ_MHZ_32
            default 48 if EXAMPLE_PM_MIN_FREQ_MHZ_48
            default 64 if EXAMPLE_PM_MIN_FREQ_MHZ_64

        endmenu

endmenu
```

## examples/protocols/asio/asio_chat/main/Kconfig.projbuild
```kconfig
menu "Example Configuration"

    config EXAMPLE_CHAT_SERVER
        bool "Asio example chat server"
        default n
        help
            This example will setup a chat server, binds it to the specified address
            and starts listening.

    if EXAMPLE_CHAT_SERVER
        config EXAMPLE_CHAT_SERVER_BIND_PORT
            string "Asio example server bind port"
            default "3344"
            help
                Server listener's socket would be bound to this port.
    endif

    config EXAMPLE_CHAT_CLIENT
        bool "Asio example chat client"
        default y
        help
            This example will setup an asio chat client.
            and sends the data.

    if EXAMPLE_CHAT_CLIENT
        config EXAMPLE_CHAT_CLIENT_CONNECT_ADDRESS
            string "Client connection address"
            default "192.168.0.1"
            help
                Client's socket would connect to this address/host.

        config EXAMPLE_CHAT_CLIENT_CONNECT_PORT
            string "Client connection port"
            default "3344"
            help
                Client's connection port.
    endif

endmenu
```

## examples/protocols/asio/chat_client/main/Kconfig.projbuild
```kconfig
menu "Example Configuration"

    config EXAMPLE_PORT
        string "Asio example server port number"
        default "2222"
        help
            Port number used by Asio example.

    config EXAMPLE_SERVER_IP
        string "Asio example server ip"
        default "FROM_STDIN"
        help
            Asio example server ip for this client to connect to.
            Leave default "FROM_STDIN" to enter the server address via serial terminal.

endmenu
```

## examples/protocols/asio/chat_client/sdkconfig.defaults
```kconfig
CONFIG_ESP_MAIN_TASK_STACK_SIZE=8192

#
# Partition Table
#
# Leave some room for larger apps without needing to reduce other features
CONFIG_PARTITION_TABLE_SINGLE_APP_LARGE=y
```

## examples/protocols/asio/chat_server/main/Kconfig.projbuild
```kconfig
menu "Example Configuration"

    config EXAMPLE_PORT
        string "Asio example server port number"
        default "2222"
        help
            Port number used by Asio example

endmenu
```

## examples/protocols/asio/socks4/main/Kconfig.projbuild
```kconfig
menu "Example Configuration"

    config EXAMPLE_PROXY_ADDRESS
        string "Proxy address"
        default "myproxy"
        help
            Address of the proxy to be used.

    config EXAMPLE_PROXY_SERVICE
        string "Proxy Service Type"
        default "myport"
        help
            Service type. Due to a limitation of lwip, must
            be the port number e.g. "1080".

endmenu
```

## examples/protocols/asio/socks4/sdkconfig.defaults
```kconfig
CONFIG_COMPILER_CXX_EXCEPTIONS=y
CONFIG_COMPILER_CXX_RTTI=y
CONFIG_COMPILER_CXX_EXCEPTIONS_EMG_POOL_SIZE=0
```

## examples/protocols/asio/ssl_client_server/main/Kconfig.projbuild
```kconfig
menu "Example Configuration"

    config EXAMPLE_CLIENT
        bool "Enable TLS client"
        default y
        help
            Choose this option to use ASIO TLS/SSL client functionality

    config EXAMPLE_PORT
        string "ASIO port number"
        default "443"
        help
            Port number used by ASIO example.

    config EXAMPLE_SERVER
        bool "Enable TLS server"
        default n
        help
            Choose this option to use ASIO TLS/SSL server functionality

    config EXAMPLE_SERVER_NAME
        string "ASIO server name or IP"
        default "www.google.com"
        depends on EXAMPLE_CLIENT
        help
            Asio example server ip for the ASIO client to connect to.

    config EXAMPLE_CLIENT_VERIFY_PEER
        bool "Client to verify peer"
        default n
        depends on EXAMPLE_CLIENT
        help
            This option sets client's mode to verify peer, default is
            verify-none

endmenu
```

## examples/protocols/asio/ssl_client_server/sdkconfig.defaults
```kconfig
CONFIG_ASIO_SSL_SUPPORT=y
CONFIG_PARTITION_TABLE_CUSTOM=y
CONFIG_PARTITION_TABLE_CUSTOM_FILENAME="partitions.csv"
CONFIG_PARTITION_TABLE_FILENAME="partitions.csv"

#
# Partition Table
#
# Leave some room for larger apps without needing to reduce other features
CONFIG_PARTITION_TABLE_SINGLE_APP_LARGE=y
```

## examples/protocols/asio/tcp_echo_server/main/Kconfig.projbuild
```kconfig
menu "Example Configuration"

    config ESP_WIFI_SSID
        string "WiFi SSID"
        default "myssid"
        help
            SSID (network name) for the example to connect to.

    config ESP_WIFI_PASSWORD
        string "WiFi Password"
        default "mypassword"
        help
            WiFi password (WPA or WPA2) for the example to use.

    config EXAMPLE_PORT
        string "asio example port number"
        default "80"
        help
            Port number used by ASIO example

endmenu
```

## examples/protocols/asio/udp_echo_server/main/Kconfig.projbuild
```kconfig
menu "Example Configuration"

    config EXAMPLE_PORT
        string "Asio example port number"
        default "2222"
        help
            Port number used by Asio example.

endmenu
```

## examples/protocols/aws_iot/thing_shadow/main/Kconfig.projbuild
```kconfig
menu "Example Configuration"

    config WIFI_SSID
        string "WiFi SSID"
        default "myssid"
        help
            SSID (network name) for the example to connect to.

    config WIFI_PASSWORD
        string "WiFi Password"
        default "mypassword"
        help
            WiFi password (WPA or WPA2) for the example to use.

            Can be left blank if the network has no security set.

    config AWS_EXAMPLE_CLIENT_ID
        string "AWS IoT Client ID"
        default "myesp32"
        help
            AWS IoT Client ID for the example. Should be unique for every device.

    config AWS_EXAMPLE_THING_NAME
        string "AWS IoT Thing Name"
        default "myesp32"
        help
            AWS IoT Thing Name for the example. Should be unique for every device.

    choice EXAMPLE_CERT_SOURCE
        prompt "AWS IoT Certificate Source"
        default EXAMPLE_EMBEDDED_CERTS
        help
            AWS IoT requires loading of a device-specific certificate and private key,
            and a common Root CA Certificate. These can be compiled into the example
            app, or they can be loaded via the filesystem from an SD card.

        config EXAMPLE_EMBEDDED_CERTS
            bool "Embed into app"
        config EXAMPLE_SDCARD_CERTS
            bool "Load from SD card"
            select EXAMPLE_FILESYSTEM_CERTS
    endchoice

    # Currently this is equivalent to EXAMPLE_SDCARD_CERTS,
    # however eventually we want to support more filesystem
    # sources (SPIFFS, etc.) So this hidden config item
    # is selected whenever the item should load from filesystem.
    config EXAMPLE_FILESYSTEM_CERTS
        bool

    config EXAMPLE_CERTIFICATE_PATH
        string "Device Certificate Path"
        depends on EXAMPLE_FILESYSTEM_CERTS
        default "/sdcard/certificate.pem.crt"

    config EXAMPLE_PRIVATE_KEY_PATH
        string "Device Private Key Path"
        depends on EXAMPLE_FILESYSTEM_CERTS
        default "/sdcard/private.pem.key"

    config EXAMPLE_ROOT_CA_PATH
        string "Root CA Certificate Path"
        depends on EXAMPLE_FILESYSTEM_CERTS
        default "/sdcard/aws-root-ca.pem"

endmenu
```

## examples/protocols/aws_iot/thing_shadow/sdkconfig.defaults
```kconfig
# Enable AWS IoT SDK support
CONFIG_AWS_IOT_SDK=y

# Enable FATFS read only with long filename support
# for loading Cert/CA/etc from filesystem
# (if enabled in config)
CONFIG_FATFS_CODEPAGE_437=y
CONFIG_FATFS_LFN_HEAP=y

# Enable TLS asymmetric in/out content length
CONFIG_MBEDTLS_ASYMMETRIC_CONTENT_LEN=y
```

## examples/protocols/cbor/sdkconfig.defaults
```kconfig
# This example is not supported with newlib nano:
#   - First 64-bit integers are not supported in newlib nano
#   - There is also issue with `PRIu8` format specifier with newlib nano (observed on ESP32-C2, see IDFCI-1375)
CONFIG_NEWLIB_NANO_FORMAT=n
```

## examples/protocols/coap_client/main/Kconfig.projbuild
```kconfig
menu "Example CoAP Client Configuration"

    # Hidden option that selects IPv4
    config EXAMPLE_COAP_NEEDS_IPV4
        bool
        default true
        select LWIP_IPV4

    config EXAMPLE_TARGET_DOMAIN_URI
        string "Target Uri"
        default "coaps://californium.eclipseprojects.io"
        help
            Target uri for the example to use. Use coaps:// prefix for encrypted traffic
            using Pre-Shared Key (PSK) or Public Key Infrastructure (PKI).

    config EXAMPLE_COAP_PSK_KEY
        string "Preshared Key (PSK) to used in the connection to the CoAP server"
        depends on COAP_MBEDTLS_PSK
        default "sesame"
        help
            The Preshared Key to use to encrypt the communicatons. The same key must be
            used at both ends of the CoAP connection, and the CoaP client must request
            an URI prefixed with coaps:// instead of coap:// for DTLS to be used.

    config EXAMPLE_COAP_PSK_IDENTITY
        string "PSK Client identity (username)"
        depends on COAP_MBEDTLS_PSK
        default "password"
        help
            The identity (or username) to use to identify to the CoAP server which
            PSK key to use.

endmenu
```
