## examples/bluetooth/ble_mesh/ble_mesh_node/main/Kconfig.projbuild
```kconfig
menu "Example Configuration"

choice ESP32_BOARD
    prompt "Board selection for BLE Mesh"
    default ESP_WROOM_32_BOARD
    help
        Select this option to choose the board for BLE Mesh. The default is ESP32-WROOM-32

config ESP_WROOM_32_BOARD
    bool "ESP32-WROOM-32"

config ESP_WROVER_BOARD
    bool "ESP32-WROVER"

endchoice

config HCI_5_0_VERSION
    bool "This option facilitates sending with 20ms non-connectable interval even if the controller is not HCI 5.0"
	default y
    help
         It is a temporary solution and needs further modifications

config PATCH_FOR_SILICONLAB_APP_1_1_0
    bool "This option fixes the bug of Silicon Lab Android App 1.1.0 when reconnection will cause the sequence number to recount from 0"
	default y
    help
         It is an ad hoc solution and needs further modifications

endmenu
```

## examples/bluetooth/ble_mesh/ble_mesh_node/sdkconfig.defaults
```kconfig
# Override some defaults so BT stack is enabled
# by default in this example
CONFIG_CONSOLE_UART_BAUDRATE=921600
CONFIG_ESPTOOLPY_BAUD_921600B=y
CONFIG_MONITOR_BAUD_921600B=y
CONFIG_BT_ENABLED=y
CONFIG_BT_MESH=y
CONFIG_BT_MESH_NODE=y
CONFIG_BT_MESH_PROV=y
CONFIG_NET_BUF_POOL_USAGE=y
CONFIG_BT_MESH_PROXY=y
CONFIG_BT_MESH_PB_GATT=y
CONFIG_BT_MESH_GATT_PROXY=y
CONFIG_BT_MESH_NODE_ID_TIMEOUT=60
CONFIG_BT_MESH_PROXY_FILTER_SIZE=1
CONFIG_BT_MESH_SUBNET_COUNT=1
CONFIG_BT_MESH_APP_KEY_COUNT=1
CONFIG_BT_MESH_MODEL_KEY_COUNT=1
CONFIG_BT_MESH_MODEL_GROUP_COUNT=1
CONFIG_BT_MESH_LABEL_COUNT=1
CONFIG_BT_MESH_CRPL=10
CONFIG_BT_MESH_MSG_CACHE_SIZE=10
CONFIG_BT_MESH_ADV_BUF_COUNT=20
CONFIG_BT_MESH_TX_SEG_MSG_COUNT=6
CONFIG_BT_MESH_RX_SEG_MSG_COUNT=1
CONFIG_BT_MESH_RX_SDU_MAX=384
CONFIG_BT_MESH_RELAY=y
CONFIG_BT_MESH_LOW_POWER=
CONFIG_BT_MESH_FRIEND=
CONFIG_BT_MESH_CFG_CLI=y
CONFIG_BT_MESH_HEALTH_CLI=y
CONFIG_BTU_TASK_STACK_SIZE=4512
```

## examples/bluetooth/ble_mesh/ble_mesh_provisioner/main/Kconfig.projbuild
```kconfig
menu "Example Configuration"

choice ESP32_BOARD
    prompt "Board selection for BLE Mesh"
    default ESP_WROOM_32_BOARD
    help
        Select this option to choose the board for BLE Mesh. The default is ESP32-WROOM-32

config ESP_WROOM_32_BOARD
    bool "ESP32-WROOM-32"

config ESP_WROVER_BOARD
    bool "ESP32-WROVER"

endchoice

config HCI_5_0_VERSION
    bool "This option facilitates sending with 20ms non-connectable interval even if the controller is not HCI 5.0"
	default y
    help
         It is a temporary solution and needs further modifications

endmenu
```

## examples/bluetooth/ble_mesh/ble_mesh_provisioner/sdkconfig.defaults
```kconfig
# Override some defaults so BT stack is enabled
# by default in this example
CONFIG_BT_ENABLED=y
CONFIG_BT_MESH=y
CONFIG_BT_MESH_PROV=y
CONFIG_BT_MESH_PROVISIONER=y
CONFIG_BT_MESH_UNPROV_DEV_ADD=20
CONFIG_BT_MESH_MAX_PROV_NODES=20
CONFIG_BT_MESH_PBA_SAME_TIME=10
CONFIG_BT_MESH_PBG_SAME_TIME=4
CONFIG_BT_MESH_PROVISIONER_SUBNET_COUNT=3
CONFIG_BT_MESH_PROVISIONER_APP_KEY_COUNT=9
CONFIG_BT_MESH_PROVISIONER_LPN_PER_FRIEND=3
CONFIG_BT_MESH_PB_ADV=y
CONFIG_NET_BUF_POOL_USAGE=y
CONFIG_BT_MESH_PB_GATT=y
CONFIG_BT_MESH_GATT_PROXY=y
CONFIG_BT_MESH_RELAY=y
CONFIG_BT_MESH_LOW_POWER=
CONFIG_BT_MESH_FRIEND=
CONFIG_BTU_TASK_STACK_SIZE=4512
CONFIG_BT_MESH_CFG_CLI=y
CONFIG_BT_MESH_HEALTH_CLI=y
CONFIG_BT_MESH_GENERIC_ONOFF_CLI=y
```

## examples/bluetooth/ble_spp_server/sdkconfig.defaults
```kconfig
# Override some defaults so BT stack is enabled
# in this example

#
# BT config
#
CONFIG_BT_ENABLED=y
CONFIG_BTDM_CONTROLLER_MODE_BLE_ONLY=y
CONFIG_BTDM_CONTROLLER_MODE_BR_EDR_ONLY=
CONFIG_BTDM_CONTROLLER_MODE_BTDM=
#
# ESP32-specific config
#
CONFIG_ESP32_ENABLE_STACK_BT=y
# CONFIG_ESP32_ENABLE_STACK_NONE is not set
CONFIG_MEMMAP_BT=y
```

## examples/bluetooth/ble_throughput/throughput_client/main/Kconfig
```kconfig
menu "Example 'GATT CLIENT THROUGHPUT' Config"

    config GATTS_NOTIFY_THROUGHPUT
        bool "test the gatts notify throughput"
        help
            If this config item is set, then the 'GATTC_WRITE_THROUGHPUT' config should be close, it can't test both
            write or notify at the same time at this demo

    config GATTC_WRITE_THROUGHPUT
        bool "test the gattc write throughput"
        help
            If this config item is set, then the 'GATTS_NOTIFY_THROUGHPUT' config should be close, it can't test both
            write or notify at the same time at this demo
endmenu
```

## examples/bluetooth/ble_throughput/throughput_client/sdkconfig.defaults
```kconfig
# Override some defaults so BT stack is enabled
# by default in this example
CONFIG_BT_ENABLED=y
CONFIG_GATTS_NOTIFY_THROUGHPUT=y
```

## examples/bluetooth/ble_throughput/throughput_server/main/Kconfig
```kconfig
menu "Example 'GATT SERVER THROUGHPUT' Config"

    config SET_RAW_ADV_DATA
        bool "Use raw data for advertising packets and scan response data"
        help
            If this config item is set, raw binary data will be used to generate advertising & scan response data.
            This option uses the esp_ble_gap_config_adv_data_raw() and esp_ble_gap_config_scan_rsp_data_raw()
            functions.

            If this config item is unset, advertising & scan response data is provided via a higher-level
            esp_ble_adv_data_t structure. The lower layer will generate the BLE packets. This option has higher
            overhead at runtime.

    config GATTS_NOTIFY_THROUGHPUT
        bool "test the gatts notify throughput"
        help
            If this config item is set, then the 'GATTC_WRITE_THROUGHPUT' config should be close, it can't test both
            write or notify at the same time at this demo

    config GATTC_WRITE_THROUGHPUT
        bool "test the gattc write throughput"
        help
            If this config item is set, then the 'GATTS_NOTIFY_THROUGHPUT' config should be close, it can't test both
            write or notify at the same time at this demo
endmenu
```

## examples/bluetooth/ble_uart_service/main/Kconfig.projbuild
```kconfig
menu "BLE UART service example"

    config EXAMPLE_CUSTOM_ADV_DATA
        bool "Use custom advertising data"
        default n
        help
            Demonstrates `ble_uart_config_t::adv_data` — the field that
            lets the application fully control the advertising payload
            instead of relying on the library default.

            When enabled, the example passes a static byte array
            (`example_adv_payload[]` defined at the top of `main.c`) to
            `ble_uart_install()`. Edit that array to broadcast anything
            you want: a different Local Name, Manufacturer Specific
            Data, custom Service Data, multiple Service UUIDs, etc.

            Format
                The array is a sequence of standard Bluetooth Core "AD
                structure" triplets:

                    [length(1)] [AD type(1)] [value(length-1)]

                See the Bluetooth Assigned Numbers (Generic Access
                Profile) document for the full type list.

            Length budget
                Total bytes in the array must be
                ≤ BLE_UART_ADV_DATA_MAX (28). The 3-byte mandatory
                Flags AD element is prepended automatically by
                ble_uart and does NOT count against this budget. An
                oversized buffer makes `ble_uart_install()` fail with
                BLE_UART_EINVAL.

            Scope
                Only affects the over-the-air advertising payload.
                The GAP-service Device Name (UUID 0x2A00, set via
                `device_name` in the same struct) is independent and
                stays whatever the application configured — connected
                centrals read that name regardless of what is in
                `adv_data`.

            Default value
                Off. The library default is used (Complete Local Name
                in the primary packet, 128-bit Service UUID in the
                scan response).

endmenu
```

## examples/bluetooth/ble_uart_service/sdkconfig.defaults
```kconfig
# Bluetooth controller in BLE-only mode + NimBLE host stack.
# CONFIG_BTDM_CTRL_MODE_* are ESP32-classic-only knobs; on C2/C3/C5/C6/
# C61/H2/H4/S3 they may emit an "unknown symbol" warning at configure
# time but are otherwise harmless, so this single sdkconfig.defaults
# stays valid for every supported target.
CONFIG_BT_ENABLED=y
CONFIG_BTDM_CTRL_MODE_BLE_ONLY=y
CONFIG_BTDM_CTRL_MODE_BR_EDR_ONLY=n
CONFIG_BTDM_CTRL_MODE_BTDM=n
CONFIG_BT_BLUEDROID_ENABLED=n
CONFIG_BT_NIMBLE_ENABLED=y

# Negotiate the largest ATT MTU we can; ble_uart_tx auto-fragments to
# the live MTU so smaller-MTU centrals still work.
CONFIG_BT_NIMBLE_ATT_PREFERRED_MTU=512

# LE Secure Connections + persistent bond store. The example defaults to
# encrypted operation (ble_uart_config_t::encrypted=true) and stores LTK
# in NVS so a previously-paired peer reconnects without re-prompting for
# the passkey.
CONFIG_BT_NIMBLE_SM_SC=y
CONFIG_BT_NIMBLE_NVS_PERSIST=y
```

## examples/bluetooth/bluedroid/ble/ble_compatibility_test/sdkconfig.defaults
```kconfig
# Defaults for generating a new "sdkconfig" file (project settings).
# https://docs.espressif.com/projects/esp-idf/en/latest/esp32/api-guides/build-system.html#custom-sdkconfig-defaults
#
# NOTE - if this file changes, to get new defaults, you must erase any existing
# "sdkconfig" file (this will undo manual settings from "idf.py menuconfig").

# Override some defaults so BT stack is enabled
# in this example

#
# BT config
#
CONFIG_BT_ENABLED=y

#
# ESP32-specific config
#
CONFIG_ESP32_ENABLE_STACK_BT=y
# CONFIG_ESP32_ENABLE_STACK_NONE is not set
CONFIG_MEMMAP_BT=y
```

## examples/bluetooth/bluedroid/ble/ble_eddystone_sender/main/Kconfig.projbuild
```kconfig
menu "Example 'EDDYSTONE SENDER' Config"

    choice EXMAPLE_EDDYSTONE_SEND
        prompt "Eddystone frame type"
        default EXMAPLE_EDDYSTONE_SEND_UID
        help
            The type of Eddystone frame to be sent
        config EXMAPLE_EDDYSTONE_SEND_UID
            bool "Frame type UID"
        config EXMAPLE_EDDYSTONE_SEND_URL
            bool "Frame type URL"
        config EXMAPLE_EDDYSTONE_SEND_TLM
            bool "Frame type TLM"
    endchoice

    config EXMAPLE_EDDYSTONE_SEND
        int
        default 0 if EXMAPLE_EDDYSTONE_SEND_UID
        default 1 if EXMAPLE_EDDYSTONE_SEND_URL
        default 2 if EXMAPLE_EDDYSTONE_SEND_TLM

endmenu
```

## examples/bluetooth/bluedroid/ble/ble_enc_adv_data/enc_adv_data_cent/main/Kconfig.projbuild
```kconfig
menu "Example Configuration"

    choice EXAMPLE_MODE
        prompt "Central Mode"
        default EXAMPLE_MODE_WITH_CONNECTION
        help
            Select the central operation mode.

        config EXAMPLE_MODE_WITH_CONNECTION
            bool "With Connection (read key from peripheral)"
            help
                Connect to peripheral to read Key Material characteristic.
                This is the standard way when key is not pre-shared.

        config EXAMPLE_MODE_NO_CONNECTION
            bool "No Connection (use pre-shared key)"
            help
                Use pre-configured key to decrypt without connecting.
                Key must match the peripheral's key.
    endchoice

endmenu
```

## examples/bluetooth/bluedroid/ble/ble_enc_adv_data/enc_adv_data_cent/sdkconfig.defaults
```kconfig
# Enable BLE
CONFIG_BT_ENABLED=y
CONFIG_BT_BLUEDROID_ENABLED=y
CONFIG_BT_BLE_ENABLED=y
CONFIG_BT_BLE_42_FEATURES_SUPPORTED=y
# CONFIG_BT_BLE_50_FEATURES_SUPPORTED is not set

# Enable SMP for security
CONFIG_BT_BLE_SMP_ENABLE=y

# Select crypto library for EAD (Encrypted Advertising Data)
# Options: CONFIG_BT_SMP_CRYPTO_STACK_TINYCRYPT or CONFIG_BT_SMP_CRYPTO_STACK_MBEDTLS
CONFIG_BT_SMP_CRYPTO_STACK_TINYCRYPT=y
CONFIG_PARTITION_TABLE_SINGLE_APP_LARGE=y

# Disable unused Bluedroid host features for encrypted adv data central (client with SMP)
# CONFIG_BT_GATTS_ENABLE is not set
# CONFIG_BT_BLE_42_ADV_EN is not set
# CONFIG_BT_BLE_42_DTM_TEST_EN is not set
```

## examples/bluetooth/bluedroid/ble/ble_hid_device_demo/sdkconfig.defaults
```kconfig
# Override some defaults so BT stack is enabled
# by default in this example
CONFIG_BT_ENABLED=y
CONFIG_BTDM_CTRL_MODE_BLE_ONLY=y
CONFIG_BTDM_CTRL_MODE_BR_EDR_ONLY=n
CONFIG_BTDM_CTRL_MODE_BTDM=n
```

## examples/bluetooth/bluedroid/ble/ble_ibeacon/main/Kconfig.projbuild
```kconfig
menu "iBeacon Example Configuration"

    choice IBEACON_MODE
        bool "iBeacon Mode"
        default IBEACON_SENDER
        help
            Select the iBeacon Mode.

        config IBEACON_SENDER
            bool "iBeacon Sender Mode"
            help
                Select the iBeacon Sender Mode.

        config IBEACON_RECEIVER
            bool "iBeacon Receiver Mode"
            help
                Select the iBeacon Receiver Mode.

    endchoice

    config IBEACON_MODE
        int
        default 0 if IBEACON_SENDER
        default 1 if IBEACON_RECEIVER

endmenu
```

## examples/bluetooth/bluedroid/ble/ble_multi_conn/ble_multi_conn_prph/main/Kconfig.projbuild
```kconfig
menu "Example Configuration"

    config EXAMPLE_RESTART_ADV_AFTER_CONNECTED
        bool
        default y
        prompt "Restart advertisement when connected"
        help
            To simulate multiple connections with only one device,
            restart the advertisement once a connection has been established.

endmenu
```
