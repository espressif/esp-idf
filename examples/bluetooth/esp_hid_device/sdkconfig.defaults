## examples/bluetooth/esp_hid_device/sdkconfig.defaults
```kconfig
CONFIG_BT_ENABLED=y
CONFIG_BTDM_CTRL_MODE_BTDM=y
CONFIG_BT_BLUEDROID_ENABLED=y
CONFIG_BT_CLASSIC_ENABLED=y
CONFIG_BT_BLE_ENABLED=y
CONFIG_BT_HID_ENABLED=y
CONFIG_BT_HID_DEVICE_ENABLED=y
CONFIG_BT_SDP_COMMON_ENABLED=y
CONFIG_BT_BLE_42_FEATURES_SUPPORTED=y
CONFIG_PARTITION_TABLE_SINGLE_APP_LARGE=y
```

## examples/bluetooth/esp_hid_device/sdkconfig.defaults.esp32c6
```kconfig
CONFIG_BT_ENABLED=y
CONFIG_BT_BLUEDROID_ENABLED=y
CONFIG_BT_BLE_ENABLED=y
CONFIG_BT_BLE_42_FEATURES_SUPPORTED=y
CONFIG_BT_LE_50_FEATURE_SUPPORT=n
```

## examples/bluetooth/esp_hid_host/main/Kconfig.projbuild
```kconfig
menu "HID Example Configuration"
    config EXAMPLE_SSP_ENABLED
        bool "Secure Simple Pairing"
        depends on BT_CLASSIC_ENABLED
        default y
        help
            This enables the Secure Simple Pairing. If disable this option,
            Bluedroid will only support Legacy Pairing

    config EXAMPLE_HID_HOST_ENABLED
        bool "Enable Example HID Host"
        depends on BT_NIMBLE_ENABLED
        default y
        select BT_NIMBLE_HID_SERVICE
        help
            This enables Nimble HID Host

    config EXAMPLE_PEER_DEVICE_NAME
        string "Target Device Name"
        default "HID Mouse Example"
        help
            Use this option to set target device name to connect.
endmenu
```

## examples/bluetooth/esp_hid_host/sdkconfig.defaults
```kconfig
CONFIG_BT_ENABLED=y
CONFIG_BTDM_CTRL_MODE_BTDM=y
CONFIG_BT_BLUEDROID_ENABLED=y
CONFIG_BT_CLASSIC_ENABLED=y
CONFIG_BT_BLE_ENABLED=y
CONFIG_BT_HID_ENABLED=y
CONFIG_BT_HID_HOST_ENABLED=y
CONFIG_BT_BLE_42_FEATURES_SUPPORTED=y
CONFIG_BT_GATTC_NOTIF_REG_MAX=16
CONFIG_PARTITION_TABLE_SINGLE_APP_LARGE=y
```

## examples/bluetooth/esp_hid_host/sdkconfig.defaults.esp32s3
```kconfig
CONFIG_BT_ENABLED=y
CONFIG_BT_BLUEDROID_ENABLED=y
CONFIG_BT_BLE_ENABLED=y
CONFIG_BT_BLE_42_FEATURES_SUPPORTED=y
```

## examples/bluetooth/gatt_server/main/Kconfig
```kconfig
menu "Example 'GATT SERVER' Config"

config SET_RAW_ADV_DATA
    bool "adv data or scan_rsp data use raw data or structure"
    default "y"
    help
        Set raw advertising data/scan response data by self or use adv_data/scan_rsp_data structure to
        set advertising data/scan response data. If use structure, lower layer will encapsulate the packets.

endmenu
```

## examples/bluetooth/gatt_server/sdkconfig.defaults
```kconfig
# Override some defaults so BT stack is enabled
# by default in this example
CONFIG_BT_ENABLED=y
```

## examples/bluetooth/gatt_server_service_table/sdkconfig.defaults
```kconfig
# Override some defaults so BT stack is enabled
# in this example

#
# BT config
#
CONFIG_BT_ENABLED=y

#
# ESP32-specific config
#
CONFIG_ESP32_ENABLE_STACK_BT=y
# CONFIG_ESP32_ENABLE_STACK_NONE is not set
CONFIG_MEMMAP_BT=y
```

## examples/bluetooth/gattc_multi_connect/sdkconfig.defaults
```kconfig
# Override some defaults so BT stack is enabled
# and WiFi disabled by default in this example
CONFIG_BT_ENABLED=y
CONFIG_BTDM_CONTROLLER_MODE_BLE_ONLY=y
CONFIG_BTDM_CONTROLLER_MODE_BR_EDR_ONLY=
CONFIG_BTDM_CONTROLLER_MODE_BTDM=
CONFIG_BTDM_CONTROLLER_BLE_MAX_CONN=9
```

## examples/bluetooth/hci/controller_hci_uart_esp32/sdkconfig.defaults
```kconfig
# Defaults for generating a new "sdkconfig" file (project settings).
# https://docs.espressif.com/projects/esp-idf/en/latest/esp32/api-guides/build-system.html#custom-sdkconfig-defaults
#
# NOTE - if this file changes, to get new defaults, you must erase any existing
# "sdkconfig" file (this will undo manual settings from "idf.py menuconfig").

# Override some defaults so BT stack is enabled
# in this example

#
# BT config
#
CONFIG_BT_ENABLED=y
CONFIG_BTDM_CTRL_MODE_BLE_ONLY=n
CONFIG_BTDM_CTRL_MODE_BR_EDR_ONLY=n
CONFIG_BTDM_CTRL_MODE_BTDM=y
CONFIG_BTDM_CTRL_BLE_MAX_CONN=9
CONFIG_BTDM_CTRL_BR_EDR_MAX_ACL_CONN=7
CONFIG_BTDM_CTRL_BR_EDR_MAX_SYNC_CONN=3
CONFIG_BT_BLUEDROID_ENABLED=n
CONFIG_BT_CONTROLLER_ONLY=y
CONFIG_BTDM_CTRL_HCI_MODE_UART_H4=y
CONFIG_BTDM_CTRL_HCI_UART_NO=1
CONFIG_BTDM_CTRL_HCI_UART_BAUDRATE=921600
CONFIG_BTDM_CTRL_MODEM_SLEEP=n
```

## examples/bluetooth/hci/controller_hci_uart_esp32c3/main/Kconfig.projbuild
```kconfig
menu "Example Configuration"

    config EXAMPLE_HCI_UART_BAUDRATE
        int "UART Baudrate for HCI"
        range 115200 921600
        default 115200
        help
            UART Baudrate for HCI. Please use standard baudrate.

endmenu
```

## examples/bluetooth/hci/controller_hci_uart_esp32c3_and_esp32s3/main/Kconfig.projbuild
```kconfig
menu "Example Configuration"

    config EXAMPLE_HCI_UART_BAUDRATE
        int "UART Baudrate for HCI"
        range 115200 921600
        default 115200
        help
            UART Baudrate for HCI. Please use standard baudrate.

    config EXAMPLE_HCI_UART_FLOW_CTRL_ENABLE
        bool "Enable HCI UART flow control"
        default y
        help
            Enable/disable HCI UART flow control

endmenu
```

## examples/bluetooth/hid_mouse_demo/sdkconfig.defaults
```kconfig
CONFIG_BT_ENABLED=y
CONFIG_BTDM_CONTROLLER_MODE_BR_EDR_ONLY=y
CONFIG_BLUEDROID_ENABLED=y
CONFIG_CLASSIC_BT_ENABLED=y
CONFIG_BT_HID_DEV_ENABLED=y
```

## examples/bluetooth/nimble/ble_chan_sound_initiator/sdkconfig.defaults
```kconfig
# Override some defaults so BT stack is enabled
# in this example

#
# BT config
#
CONFIG_BT_ENABLED=y
CONFIG_BTDM_CTRL_MODE_BLE_ONLY=y
CONFIG_BTDM_CTRL_MODE_BR_EDR_ONLY=n
CONFIG_BTDM_CTRL_MODE_BTDM=n
CONFIG_BT_BLUEDROID_ENABLED=n
CONFIG_BT_CONTROLLER_DISABLED=y
CONFIG_BT_NIMBLE_60_FEATURE_SUPPORT=y
CONFIG_BT_NIMBLE_ENABLED=y
CONFIG_BT_NIMBLE_EXT_ADV=y
CONFIG_BT_NIMBLE_CHANNEL_SOUNDING=y
CONFIG_BT_NIMBLE_TRANSPORT_EVT_SIZE=78
CONFIG_BT_NIMBLE_ATT_PREFERRED_MTU=498
CONFIG_BT_NIMBLE_GATT_MAX_PROCS=6
```

## examples/bluetooth/nimble/ble_cte/ble_periodic_adv_with_cte/main/Kconfig.projbuild
```kconfig
menu "Example Configuration"

    choice
        prompt "Direction Finding Mode"
        default EXAMPLE_ADV_DIRECTION_FINDING_AOA
        help
            Select the direction finding technology for periodic advertising.

        config EXAMPLE_ADV_DIRECTION_FINDING_AOA
            bool "AoA (Constant Tone Only)"
            help
                Select this option for Angle of Arrival (AoA) mode.
                The advertiser will send CTE with constant tone only,
                no antenna switching required on the advertiser side.

        config EXAMPLE_ADV_DIRECTION_FINDING_AOD
            bool "AoD (Antenna Switching with GPIO Encoding)"
            help
                Select this option for Angle of Departure (AoD) mode.
                The advertiser will send CTE with antenna switching pattern.
                GPIOs are used as encoded bits to control multiple antennas.
                For example: 2 GPIOs can control 4 antennas (00, 01, 10, 11).

    endchoice

    if EXAMPLE_ADV_DIRECTION_FINDING_AOD

        config EXAMPLE_ANT_GPIO_BIT_COUNT
            int "Number of GPIO bits for antenna encoding"
            range 1 4
            default 2
            help
                Select the number of GPIO pins used as encoded bits for antenna switching.
                Each additional GPIO bit doubles the number of controllable antennas.
                Example:
                1 bit -> 2 antennas (0, 1)
                2 bits -> 4 antennas (00, 01, 10, 11)
                3 bits -> 8 antennas
                4 bits -> 16 antennas

        config EXAMPLE_ANT_GPIO_0
            int "GPIO Bit 0 (LSB)"
            range 0 39
            default 0
            help
                GPIO pin number for the least significant bit (LSB) of antenna encoding.

        config EXAMPLE_ANT_GPIO_1
            int "GPIO Bit 1"
            range 0 39
            default 1
            depends on EXAMPLE_ANT_GPIO_BIT_COUNT > 1
            help
                GPIO pin number for bit 1 of antenna encoding.

        config EXAMPLE_ANT_GPIO_2
            int "GPIO Bit 2"
            range 0 39
            default 2
            depends on EXAMPLE_ANT_GPIO_BIT_COUNT > 2
            help
                GPIO pin number for bit 2 of antenna encoding.

        config EXAMPLE_ANT_GPIO_3
            int "GPIO Bit 3 (MSB)"
            range 0 39
            default 3
            depends on EXAMPLE_ANT_GPIO_BIT_COUNT > 3
            help
                GPIO pin number for the most significant bit (MSB) of antenna encoding.

    endif # EXAMPLE_DIRECTION_FINDING_CTE

    config EXAMPLE_RANDOM_ADDR
        bool
        prompt "Advertise RANDOM Address"
        help
            Use this option to advertise a random address instead of public address

endmenu
```

## examples/bluetooth/nimble/ble_cte/ble_periodic_adv_with_cte/sdkconfig.defaults
```kconfig
# Minimal NimBLE config for periodic advertising with CTE (requires BLE 5.0).
#
# Supported targets: ESP32-H2, ESP32-C5, ESP32-C61, etc. (see README.md).
# Run: idf.py set-target <chip> before building.

CONFIG_BT_ENABLED=y
CONFIG_BT_NIMBLE_ENABLED=y
CONFIG_BT_NIMBLE_50_FEATURE_SUPPORT=y
CONFIG_BT_NIMBLE_EXT_ADV=y
CONFIG_BT_NIMBLE_ENABLE_PERIODIC_ADV=y
CONFIG_BT_NIMBLE_AOA_AOD=y
```

## examples/bluetooth/nimble/ble_cte/ble_periodic_adv_with_cte/sdkconfig.defaults.esp32h2
```kconfig
CONFIG_IDF_TARGET="esp32h2"
CONFIG_BT_NIMBLE_SECURITY_ENABLE=n
CONFIG_BT_NIMBLE_50_FEATURE_SUPPORT=y
CONFIG_BT_NIMBLE_EXT_ADV=y
CONFIG_BT_NIMBLE_ENABLE_PERIODIC_ADV=y
CONFIG_BT_NIMBLE_AOA_AOD=y
```

## examples/bluetooth/nimble/ble_cte/ble_periodic_sync_with_cte/main/Kconfig.projbuild
```kconfig
menu "Example Configuration"

    choice
        prompt "Periodic Sync Matching Method"
        default EXAMPLE_SYNC_BY_SID

        config EXAMPLE_SYNC_BY_SID
            bool "Sync by Advertising SID"

        config EXAMPLE_SYNC_BY_NAME
            bool "Sync by Device Name"

    endchoice

    config EXAMPLE_SYNC_TARGET_SID
        int "Target SID for periodic sync"
        depends on EXAMPLE_SYNC_BY_SID
        default 2

    config EXAMPLE_SYNC_TARGET_DEVNAME
        string "Target Device Name for sync"
        depends on EXAMPLE_SYNC_BY_NAME
        default "CTE_Periodic_Adv"


    config EXAMPLE_ANT_GPIO_BIT_COUNT
        int "Number of GPIO bits for antenna encoding"
        range 1 4
        default 2
        help
            Select the number of GPIO pins used as encoded bits for antenna switching.
            Each additional GPIO bit doubles the number of controllable antennas.
            Example:
            1 bit -> 2 antennas (0, 1)
            2 bits -> 4 antennas (00, 01, 10, 11)
            3 bits -> 8 antennas
            4 bits -> 16 antennas

    config EXAMPLE_ANT_GPIO_0
        int "GPIO Bit 0 (LSB)"
        range 0 39
        default 0
        help
            GPIO pin number for the least significant bit (LSB) of antenna encoding.

    config EXAMPLE_ANT_GPIO_1
        int "GPIO Bit 1"
        range 0 39
        default 1
        depends on EXAMPLE_ANT_GPIO_BIT_COUNT > 1
        help
            GPIO pin number for bit 1 of antenna encoding.

    config EXAMPLE_ANT_GPIO_2
        int "GPIO Bit 2"
        range 0 39
        default 2
        depends on EXAMPLE_ANT_GPIO_BIT_COUNT > 2
        help
            GPIO pin number for bit 2 of antenna encoding.

    config EXAMPLE_ANT_GPIO_3
        int "GPIO Bit 3 (MSB)"
        range 0 39
        default 3
        depends on EXAMPLE_ANT_GPIO_BIT_COUNT > 3
        help
            GPIO pin number for the most significant bit (MSB) of antenna encoding.

endmenu
```

## examples/bluetooth/nimble/ble_cts/cts_prph/main/Kconfig.projbuild
```kconfig
menu "Example Configuration"

    config EXAMPLE_EXTENDED_ADV
        bool
        depends on SOC_BLE_50_SUPPORTED
        default y if SOC_ESP_NIMBLE_CONTROLLER
        select BT_NIMBLE_EXT_ADV
        prompt "Enable Extended Adv"
        help
            Use this option to enable extended advertising in the example.
            If this option is disabled, ensure config BT_NIMBLE_EXT_ADV is
            also disabled from Nimble stack menuconfig

endmenu
```

## examples/bluetooth/nimble/ble_enc_adv_data/enc_adv_data_cent/main/Kconfig.projbuild
```kconfig
menu "Example Configuration"

    config EXAMPLE_PEER_ADDR
        string "Peer Address"
        default "ADDR_ANY"
        help
            Enter the peer address in aa:bb:cc:dd:ee:ff form to connect to a specific peripheral

    config EXAMPLE_ENC_ADV_DATA
        bool
        prompt "Enable encrypted advertising data feature support"
        default y
        select BT_NIMBLE_ENC_ADV_DATA
        help
            This option enables support of encrypted advertising data.
endmenu
```
