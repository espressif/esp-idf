## examples/bluetooth/nimble/throughput_app/gatt/bleprph_throughput/sdkconfig.defaults
```kconfig
# Override some defaults so BT stack is enabled
# in this example and some example specific misc sizes are increased.

#
# BT config (universal across all ESP32 variants)
#
CONFIG_BT_ENABLED=y
CONFIG_BT_BLUEDROID_ENABLED=n
CONFIG_BT_NIMBLE_ENABLED=y

# === BT 5.0 / 2M PHY support ===
# Ignored automatically on classic ESP32 which lacks BT 5.0
CONFIG_BT_NIMBLE_EXT_ADV=n
CONFIG_BT_NIMBLE_50_FEATURE_SUPPORT=y
CONFIG_EXAMPLE_EXTENDED_ADV=n

# === ATT / GATT ===
CONFIG_BT_NIMBLE_ATT_PREFERRED_MTU=512

# === Memory Pool Tuning ===
CONFIG_BT_NIMBLE_MAX_CONNECTIONS=1
CONFIG_BT_NIMBLE_MSYS_1_BLOCK_COUNT=80
CONFIG_BT_NIMBLE_MSYS_2_BLOCK_SIZE=592
CONFIG_BT_NIMBLE_MSYS_2_BLOCK_COUNT=80

# Increase controller-to-host buffers
CONFIG_BT_NIMBLE_TRANSPORT_ACL_FROM_LL_COUNT=40
CONFIG_BT_NIMBLE_TRANSPORT_ACL_SIZE=255
CONFIG_BT_NIMBLE_TRANSPORT_EVT_SIZE=255

# Disable NimBLE INFO logging for throughput tests
CONFIG_BT_NIMBLE_LOG_LEVEL_WARNING=y
CONFIG_BT_NIMBLE_LOG_LEVEL=2
```

## examples/bluetooth/nimble/throughput_app/l2cap_coc/l2cap_coc_cent/main/Kconfig.projbuild
```kconfig
menu "L2CAP COC Throughput Configuration"

    config EXAMPLE_L2CAP_COC_MTU
        int "L2CAP CoC MTU size in bytes"
        default 2048
        range 512 65511
        help
            L2CAP CoC SDU MTU size used by the central device.
            Note: memory pool allocates 6 buffers of this size; total pool
            memory = MTU x 6. On chips without PSRAM ensure sufficient heap
            is available before increasing this value.
            Use idf.py size-components to verify.

    config EXAMPLE_EXTENDED_ADV
        bool
        depends on SOC_BLE_50_SUPPORTED && BT_NIMBLE_50_FEATURE_SUPPORT
        default y if SOC_ESP_NIMBLE_CONTROLLER
        select BT_NIMBLE_EXT_ADV
        prompt "Enable Extended Scanning"
        help
            Use extended scanning on chips that support BLE 5.0

    config EXAMPLE_TEST_PHY_1M
        bool "Test on 1M PHY"
        default y if !SOC_BLE_50_SUPPORTED
        default n

    config EXAMPLE_TEST_PHY_2M
        bool "Test on 2M PHY"
        default y
        depends on SOC_BLE_50_SUPPORTED

    config EXAMPLE_TEST_PHY_CODED_S2
        bool "Test on Coded PHY S2"
        default n
        depends on SOC_BLE_50_SUPPORTED

    config EXAMPLE_TEST_PHY_CODED_S8
        bool "Test on Coded PHY S8"
        default n
        depends on SOC_BLE_50_SUPPORTED

    config EXAMPLE_TEST_DURATION_1M
        int "Test duration for 1M PHY (sec)"
        default 8
        range 1 3600
        depends on EXAMPLE_TEST_PHY_1M

    config EXAMPLE_TEST_DURATION_2M
        int "Test duration for 2M PHY (sec)"
        default 8
        range 1 3600
        depends on EXAMPLE_TEST_PHY_2M

    config EXAMPLE_TEST_DURATION_CODED_S2
        int "Test duration for Coded S2 PHY (sec)"
        default 8
        range 1 3600
        depends on EXAMPLE_TEST_PHY_CODED_S2

    config EXAMPLE_TEST_DURATION_CODED_S8
        int "Test duration for Coded S8 PHY (sec)"
        default 8
        range 1 3600
        depends on EXAMPLE_TEST_PHY_CODED_S8

endmenu
```

## examples/bluetooth/nimble/throughput_app/l2cap_coc/l2cap_coc_cent/sdkconfig.defaults.esp32
```kconfig
CONFIG_EXAMPLE_L2CAP_COC_MTU=2048
CONFIG_BT_NIMBLE_MSYS_1_BLOCK_COUNT=96
CONFIG_BT_NIMBLE_MSYS_2_BLOCK_COUNT=48
CONFIG_BT_NIMBLE_TRANSPORT_ACL_FROM_LL_COUNT=10
```

## examples/bluetooth/nimble/throughput_app/l2cap_coc/l2cap_coc_cent/sdkconfig.defaults.esp32c2
```kconfig
# ACL_FROM_LL_COUNT kept at 67 (not reduced like MSYS pools) to avoid 0 kbps
# throughput after Coded S2 <-> S8 PHY switches on this RAM-limited target.
CONFIG_BT_NIMBLE_MSYS_1_BLOCK_COUNT=12
CONFIG_BT_NIMBLE_MSYS_1_BLOCK_SIZE=292
CONFIG_BT_NIMBLE_MSYS_2_BLOCK_COUNT=0
CONFIG_BT_NIMBLE_TRANSPORT_ACL_FROM_LL_COUNT=67
```

## examples/bluetooth/nimble/throughput_app/l2cap_coc/l2cap_coc_cent/sdkconfig.defaults.esp32c3
```kconfig
CONFIG_BT_NIMBLE_MSYS_1_BLOCK_COUNT=160
CONFIG_BT_NIMBLE_MSYS_2_BLOCK_COUNT=48
CONFIG_BT_NIMBLE_TRANSPORT_ACL_FROM_LL_COUNT=24
CONFIG_BT_CTRL_BLE_STATIC_ACL_TX_BUF_NB=8
```

## examples/bluetooth/nimble/throughput_app/l2cap_coc/l2cap_coc_cent/sdkconfig.defaults.esp32h2
```kconfig
CONFIG_BT_NIMBLE_MSYS_1_BLOCK_COUNT=120
CONFIG_BT_NIMBLE_MSYS_2_BLOCK_COUNT=48
CONFIG_BT_NIMBLE_TRANSPORT_ACL_FROM_LL_COUNT=67
```

## examples/bluetooth/nimble/throughput_app/l2cap_coc/l2cap_coc_prph/main/Kconfig.projbuild
```kconfig
menu "L2CAP COC Throughput Configuration"

    config EXAMPLE_L2CAP_COC_MTU
        int "L2CAP CoC MTU size in bytes"
        default 16384
        range 512 65511
        help
            L2CAP CoC SDU MTU size in bytes.
            Note: memory pool allocates 6 buffers of this size; total pool
            memory = MTU x 6. On chips without PSRAM ensure sufficient heap
            is available before increasing this value.
            Use idf.py size-components to verify.

    config EXAMPLE_EXTENDED_ADV
        bool
        depends on SOC_BLE_50_SUPPORTED && BT_NIMBLE_50_FEATURE_SUPPORT
        default y if SOC_ESP_NIMBLE_CONTROLLER
        select BT_NIMBLE_EXT_ADV
        prompt "Enable Extended Advertising"
        help
            Enable BLE 5.0 extended advertising.

endmenu
```

## examples/bluetooth/nimble/throughput_app/l2cap_coc/l2cap_coc_prph/sdkconfig.defaults
```kconfig
CONFIG_BT_ENABLED=y
CONFIG_BT_NIMBLE_ENABLED=y
CONFIG_BT_NIMBLE_ATT_PREFERRED_MTU=512
CONFIG_BT_NIMBLE_TRANSPORT_EVT_SIZE=255
CONFIG_BT_NIMBLE_LOG_LEVEL=4
CONFIG_BT_NIMBLE_LOG_LEVEL_NONE=y
CONFIG_BT_NIMBLE_MSYS_1_BLOCK_COUNT=400
CONFIG_BT_NIMBLE_MSYS_1_BLOCK_SIZE=255
CONFIG_BT_NIMBLE_MSYS_2_BLOCK_COUNT=50
CONFIG_BT_NIMBLE_MSYS_2_BLOCK_SIZE=260
CONFIG_BT_NIMBLE_L2CAP_COC_MAX_NUM=1
CONFIG_BT_NIMBLE_L2CAP_COC_SDU_BUFF_COUNT=12
CONFIG_BT_NIMBLE_TRANSPORT_ACL_FROM_LL_COUNT=24
CONFIG_FREERTOS_HZ=1000
CONFIG_ESP_TASK_WDT_TIMEOUT_S=30
```

## examples/bluetooth/nimble/throughput_app/l2cap_coc/l2cap_coc_prph/sdkconfig.defaults.esp32
```kconfig
CONFIG_EXAMPLE_L2CAP_COC_MTU=8192
CONFIG_BT_NIMBLE_MSYS_1_BLOCK_COUNT=20
CONFIG_BT_NIMBLE_MSYS_2_BLOCK_COUNT=20
CONFIG_BT_NIMBLE_TRANSPORT_ACL_FROM_LL_COUNT=10
```
