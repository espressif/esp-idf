## examples/bluetooth/nimble/bleprph_host_only/sdkconfig.defaults
```kconfig
# Override some defaults so BT stack is enabled
# in this example

#
# BT config
#
CONFIG_BT_ENABLED=y
CONFIG_BT_CONTROLLER_DISABLED=y
CONFIG_BT_BLUEDROID_ENABLED=n
CONFIG_BT_NIMBLE_ENABLED=y
CONFIG_BT_NIMBLE_TRANSPORT_UART=n
```

## examples/bluetooth/nimble/bleprph_wifi_coex/main/Kconfig.projbuild
```kconfig
menu "Example Configuration"

    config EXAMPLE_ESP_WIFI_SSID
        string "WiFi SSID"
        default "myssid"
        help
            SSID (network name) for the example to connect to.

    config EXAMPLE_ESP_WIFI_PASSWORD
        string "WiFi Password"
        default "mypassword"
        help
            WiFi password (WPA or WPA2) for the example to use.

    config EXAMPLE_ESP_MAXIMUM_RETRY
        int "WIFI Connect Maximum retry"
        default 5
        help
            Set the Maximum retry to avoid station reconnecting to the AP unlimited when the AP is really inexistent.

    config EXAMPLE_ESP_PING_IP
        string "Ping IP Address"
        default "93.184.216.34"
        help
            Set IP address to ping.

    config EXAMPLE_ESP_PING_COUNT
        int "Count of pings"
        default 10000
        help
            Set number of pings to be sent.
endmenu
```

## examples/bluetooth/nimble/hci/main/Kconfig.projbuild
```kconfig
menu "Example Configuration"
    config ENABLE_DTM_CONFIGURATION_COMMAND
        bool
        prompt "Enable DTM Configuration command"
        default n
        help
            Use this option to enable DTM configuration command.

endmenu
```

## examples/bluetooth/nimble/hci/sdkconfig.defaults.esp32h2
```kconfig
# Override some defaults so BT stack is enabled
# by default in this example
CONFIG_BT_LE_HCI_INTERFACE_USE_UART=y
CONFIG_BT_LE_HCI_UART_TX_PIN=8
CONFIG_BT_LE_HCI_UART_RX_PIN=9
CONFIG_BT_LE_HCI_UART_BAUD=115200
```

## examples/bluetooth/nimble/power_save/main/Kconfig.projbuild
```kconfig
menu "Example Configuration"

    choice EXAMPLE_MAX_CPU_FREQ
        prompt "Maximum CPU frequency"
        default EXAMPLE_MAX_CPU_FREQ_160 if !IDF_TARGET_ESP32H2 && !IDF_TARGET_ESP32C2
        default EXAMPLE_MAX_CPU_FREQ_96 if IDF_TARGET_ESP32H2
        default EXAMPLE_MAX_CPU_FREQ_120 if IDF_TARGET_ESP32C2
        depends on PM_ENABLE
        help
            Maximum CPU frequency to use for dynamic frequency scaling.

        config EXAMPLE_MAX_CPU_FREQ_80
            bool "80 MHz"
        config EXAMPLE_MAX_CPU_FREQ_96
            bool "96 MHz"
            depends on IDF_TARGET_ESP32H2
        config EXAMPLE_MAX_CPU_FREQ_160
            bool "160 MHz"
        config EXAMPLE_MAX_CPU_FREQ_120
            bool "120 MHz"
            depends on IDF_TARGET_ESP32C2
        config EXAMPLE_MAX_CPU_FREQ_240
            bool "240 MHz"
            depends on IDF_TARGET_ESP32 || IDF_TARGET_ESP32S3
    endchoice

    config EXAMPLE_MAX_CPU_FREQ_MHZ
        int
        default 80 if EXAMPLE_MAX_CPU_FREQ_80
        default 96 if EXAMPLE_MAX_CPU_FREQ_96
        default 120 if EXAMPLE_MAX_CPU_FREQ_120
        default 160 if EXAMPLE_MAX_CPU_FREQ_160
        default 240 if EXAMPLE_MAX_CPU_FREQ_240

    choice EXAMPLE_MIN_CPU_FREQ
        prompt "Minimum CPU frequency"
        default EXAMPLE_MIN_CPU_FREQ_40M if !IDF_TARGET_ESP32H2 && !IDF_TARGET_ESP32C2
        default EXAMPLE_MIN_CPU_FREQ_32M if IDF_TARGET_ESP32H2
        default EXAMPLE_MIN_CPU_FREQ_26M if IDF_TARGET_ESP32C2
        depends on PM_ENABLE
        help
            Minimum CPU frequency to use for dynamic frequency scaling.
            Should be set to XTAL frequency or XTAL frequency divided by integer.

        config EXAMPLE_MIN_CPU_FREQ_80M
            bool "80 MHz"
            depends on !(IDF_TARGET_ESP32 && EXAMPLE_MAX_CPU_FREQ_240)
            help
                ESP32 does not support switching between 240M and 80M.The root cause
                is that when switching between 240M and 80M, we need to disable
                BBPLL and then re-enable it with a different frequency.Since the
                Bluetooth baseband works from PLL frequency, it will temporarily
                lose its 80 MHz clock, while the BBPLL is disabled.
        config EXAMPLE_MIN_CPU_FREQ_40M
            bool "40 MHz (use with 40MHz XTAL)"
            depends on XTAL_FREQ_40 || XTAL_FREQ_AUTO
        config EXAMPLE_MIN_CPU_FREQ_32M
            bool "32 MHz (use with 32MHz XTAL)"
            depends on IDF_TARGET_ESP32H2
            depends on XTAL_FREQ_32 || XTAL_FREQ_AUTO
        config EXAMPLE_MIN_CPU_FREQ_26M
            bool "26 MHz (use with 26MHz XTAL)"
            depends on IDF_TARGET_ESP32C2
            depends on XTAL_FREQ_26 || XTAL_FREQ_AUTO
        config EXAMPLE_MIN_CPU_FREQ_20M
            bool "20 MHz (use with 40MHz XTAL)"
            depends on XTAL_FREQ_40 || XTAL_FREQ_AUTO
        config EXAMPLE_MIN_CPU_FREQ_10M
            bool "10 MHz (use with 40MHz XTAL)"
            depends on XTAL_FREQ_40 || XTAL_FREQ_AUTO
    endchoice

    config EXAMPLE_MIN_CPU_FREQ_MHZ
        int
        default 80 if EXAMPLE_MIN_CPU_FREQ_80M
        default 40 if EXAMPLE_MIN_CPU_FREQ_40M
        default 32 if EXAMPLE_MIN_CPU_FREQ_32M
        default 26 if EXAMPLE_MIN_CPU_FREQ_26M
        default 20 if EXAMPLE_MIN_CPU_FREQ_20M
        default 10 if EXAMPLE_MIN_CPU_FREQ_10M

    choice EXAMPLE_USE_IO_TYPE
        prompt "I/O Capability"
        default BLE_SM_IO_CAP_NO_IO
        help
            I/O capability of device.

        config BLE_SM_IO_CAP_DISP_ONLY
            bool "DISPLAY ONLY"
        config BLE_SM_IO_CAP_DISP_YES_NO
            bool "DISPLAY YESNO"
        config BLE_SM_IO_CAP_KEYBOARD_ONLY
            bool "KEYBOARD ONLY"
        config BLE_SM_IO_CAP_NO_IO
            bool "Just works"
        config BLE_SM_IO_CAP_KEYBOARD_DISP
            bool "Both KEYBOARD & DISPLAY"
    endchoice

    config EXAMPLE_IO_TYPE
        int
        default 0 if BLE_SM_IO_CAP_DISP_ONLY
        default 1 if BLE_SM_IO_CAP_DISP_YES_NO
        default 2 if BLE_SM_IO_CAP_KEYBOARD_ONLY
        default 3 if BLE_SM_IO_CAP_NO_IO
        default 4 if BLE_SM_IO_CAP_KEYBOARD_DISP

    config EXAMPLE_BONDING
        bool
        default n
        prompt "Use Bonding"
        help
            Use this option to enable/disable bonding.

    config EXAMPLE_MITM
        bool
        default n
        prompt "MITM security"
        help
            Use this option to enable/disable MITM security.

    config EXAMPLE_USE_SC
        bool
        depends on BT_NIMBLE_SM_SC
        default n
        prompt "Use Secure Connection feature"
        help
            Use this option to enable/disable Security Manager Secure Connection 4.2 feature.

    config EXAMPLE_EXTENDED_ADV
        bool
        depends on SOC_BLE_50_SUPPORTED
        default y if SOC_ESP_NIMBLE_CONTROLLER
        select BT_NIMBLE_EXT_ADV
        prompt "Enable Extended Adv"
        help
            Use this option to enable extended advertising in the example.
            If this option is disabled, ensure config BT_NIMBLE_EXT_ADV is
            also disabled from Nimble stack menuconfig

    config EXAMPLE_RANDOM_ADDR
        bool
        prompt "Advertise RANDOM Address"
        help
            Use this option to advertise a random address instead of public address

    config EXAMPLE_ENCRYPTION
        bool
        prompt "Enable Link Encryption"
        help
            This adds Encrypted Read and Write permissions in the custom GATT server.

    config EXAMPLE_RESOLVE_PEER_ADDR
        bool
        prompt "Enable resolving peer address"
        help
            Use this option to enable resolving peer's address.

    config EXAMPLE_USE_CI_ADDRESS
        bool
        default n
        prompt "Advertise using Test address(Internal Test ONLY)"
        help
            Used for internal test ONLY.
            Use this option to advertise in a specific random address.

    config EXAMPLE_CI_ADDRESS_OFFSET
        string
        prompt "Advertise using Test address(Internal Test ONLY)"
        depends on EXAMPLE_USE_CI_ADDRESS
        help
            Used for internal test ONLY.
            Use this option to advertise in a specific random address.
endmenu
```

## examples/bluetooth/nimble/power_save/sdkconfig.defaults.esp32
```kconfig
CONFIG_IDF_TARGET="esp32"

# MODEM SLEEP Options
CONFIG_BTDM_CTRL_MODEM_SLEEP=y
CONFIG_BTDM_CTRL_MODEM_SLEEP_MODE_ORIG=y
# Bluetooth low power clock
CONFIG_BTDM_CTRL_LPCLK_SEL_EXT_32K_XTAL=y

# RTC clock source
CONFIG_RTC_CLK_SRC_EXT_CRYS=y

# Run FreeRTOS only on first core
CONFIG_FREERTOS_UNICORE=y
```

## examples/bluetooth/nimble/power_save/sdkconfig.defaults.esp32c3
```kconfig
CONFIG_IDF_TARGET="esp32c3"

# MODEM SLEEP Options
CONFIG_BT_CTRL_MODEM_SLEEP=y
CONFIG_BT_CTRL_MODEM_SLEEP_MODE_1=y
# Bluetooth low power clock
CONFIG_BT_CTRL_LPCLK_SEL_EXT_32K_XTAL=y
# Power up main XTAL during light sleep
CONFIG_BT_CTRL_MAIN_XTAL_PU_DURING_LIGHT_SLEEP=y

# RTC clock source
CONFIG_RTC_CLK_SRC_EXT_CRYS=y

# Enable power down of MAC and baseband in light sleep mode
CONFIG_ESP_PHY_MAC_BB_PD=y
```

## examples/bluetooth/nimble/power_save/sdkconfig.defaults.esp32c61
```kconfig
CONFIG_IDF_TARGET="esp32c61"

# Bluetooth Low Power Config
CONFIG_BT_LE_SLEEP_ENABLE=y
CONFIG_BT_LE_LP_CLK_SRC_DEFAULT=y

#
# Power Management
#
CONFIG_PM_ENABLE=y
CONFIG_PM_DFS_INIT_AUTO=y
CONFIG_PM_POWER_DOWN_CPU_IN_LIGHT_SLEEP=y
CONFIG_PM_POWER_DOWN_PERIPHERAL_IN_LIGHT_SLEEP=y
# end of Power Management

CONFIG_FREERTOS_USE_TICKLESS_IDLE=y
CONFIG_ESP_MODEM_CLOCK_ENABLE_CHECKING=y

#
# Sleep Config
#
CONFIG_ESP_SLEEP_POWER_DOWN_FLASH=y
CONFIG_ESP_SLEEP_CACHE_SAFE_ASSERTION=y
# end of Sleep Config

#
# RTC Clock Config
#
CONFIG_RTC_CLK_SRC_EXT_CRYS=y
# end of RTC Clock Config
```

## examples/bluetooth/nimble/power_save/sdkconfig.defaults.esp32h2
```kconfig
CONFIG_IDF_TARGET="esp32h2"

# Bluetooth Low Power Config
CONFIG_BT_LE_SLEEP_ENABLE=y
# CONFIG_BT_LE_WAKEUP_SOURCE_CPU_RTC_TIMER is not set
# CONFIG_BT_LE_LP_CLK_SRC_MAIN_XTAL is not set
CONFIG_BT_LE_LP_CLK_SRC_DEFAULT=y

#
# Power Management
#
CONFIG_PM_ENABLE=y
CONFIG_PM_DFS_INIT_AUTO=y
CONFIG_PM_POWER_DOWN_CPU_IN_LIGHT_SLEEP=y
CONFIG_PM_POWER_DOWN_PERIPHERAL_IN_LIGHT_SLEEP=y
# end of Power Management

#
# Sleep Config
#
CONFIG_ESP_SLEEP_POWER_DOWN_FLASH=y
CONFIG_ESP_SLEEP_CACHE_SAFE_ASSERTION=y
# end of Sleep Config

#
# RTC Clock Config
#
# CONFIG_RTC_CLK_SRC_INT_RC is not set
CONFIG_RTC_CLK_SRC_EXT_CRYS=y
# CONFIG_RTC_CLK_SRC_EXT_OSC is not set
# CONFIG_RTC_CLK_SRC_INT_RC32K is not set
# end of RTC Clock Config
```

## examples/bluetooth/nimble/power_save/sdkconfig.defaults.esp32s3
```kconfig
CONFIG_IDF_TARGET="esp32s3"

# MODEM SLEEP Options
CONFIG_BT_CTRL_MODEM_SLEEP=y
CONFIG_BT_CTRL_MODEM_SLEEP_MODE_1=y
# Bluetooth low power clock
CONFIG_BT_CTRL_LPCLK_SEL_EXT_32K_XTAL=y
# Power up main XTAL during light sleep
CONFIG_BT_CTRL_MAIN_XTAL_PU_DURING_LIGHT_SLEEP=y

# RTC clock source
CONFIG_RTC_CLK_SRC_EXT_CRYS=y

# Run FreeRTOS only on first core
CONFIG_FREERTOS_UNICORE=y
# Enable power down of MAC and baseband in light sleep mode
CONFIG_ESP_PHY_MAC_BB_PD=y
```

## examples/bluetooth/nimble/throughput_app/blecent_throughput/main/Kconfig.projbuild
```kconfig
menu "Example Configuration"

    config EXAMPLE_PEER_ADDR
        string "Peer Address"
        default "ADDR_ANY"
        help
            Enter the peer address in aa:bb:cc:dd:ee:ff form to connect to a specific peripheral

    config EXAMPLE_CONN_ITVL_MIN
        int "Minimum connection itvl"
        default 6
        help
            Set the minimum connection interval in 1.25msec units.

    config EXAMPLE_CONN_ITVL_MAX
        int "Maximum connection itvl"
        default 6
        help
            Set the maximum connection interval in 1.25msec units.

    config EXAMPLE_CONN_LATENCY
        int "Connection latency"
        default 0
        help
            Set the connection latency.

    config EXAMPLE_CONN_TIMEOUT
        int "Supervision timeout"
        default 500
        help
            Set the supervision timeout in 10msec units.

    config EXAMPLE_CONN_CE_LEN_MIN
        int "Minimum connection event length"
        default 12
        help
            Set the minimum connection event length in 0.625msec units.

    config EXAMPLE_CONN_CE_LEN_MAX
        int "Maximum connection event length"
        default 12
        help
            Set the maximum connection event length in 0.625msec units.
endmenu
```

## examples/bluetooth/nimble/throughput_app/blecent_throughput/sdkconfig.defaults
```kconfig
# Override some defaults so BT stack is enabled
# in this example and some misc buffer sizes are increased

#
# BT config (universal across all ESP32 variants)
#
CONFIG_BT_ENABLED=y
CONFIG_BTDM_CTRL_MODE_BLE_ONLY=y
CONFIG_BTDM_CTRL_MODE_BR_EDR_ONLY=n
CONFIG_BTDM_CTRL_MODE_BTDM=n
CONFIG_BT_BLUEDROID_ENABLED=n
CONFIG_BT_NIMBLE_ENABLED=y

# === BT 5.0 / 2M PHY support ===
# Ignored automatically on classic ESP32 which lacks BT 5.0
CONFIG_BT_NIMBLE_EXT_ADV=n
CONFIG_BT_NIMBLE_50_FEATURE_SUPPORT=y
CONFIG_EXAMPLE_EXTENDED_ADV=n

# === ATT / GATT ===
CONFIG_BT_NIMBLE_ATT_PREFERRED_MTU=512

# === Memory Pool Tuning ===
CONFIG_BT_NIMBLE_MAX_CONNECTIONS=1
CONFIG_BT_NIMBLE_MSYS_1_BLOCK_COUNT=50
CONFIG_BT_NIMBLE_MSYS_2_BLOCK_SIZE=592
CONFIG_BT_NIMBLE_MSYS_2_BLOCK_COUNT=40

# Increase controller-to-host buffers
CONFIG_BT_NIMBLE_TRANSPORT_ACL_FROM_LL_COUNT=40
CONFIG_BT_NIMBLE_TRANSPORT_EVT_SIZE=255

# === Connection Parameters (write/notify optimal; code switches dynamically for reads) ===
CONFIG_EXAMPLE_CONN_ITVL_MIN=24
CONFIG_EXAMPLE_CONN_ITVL_MAX=40

# Disable NimBLE INFO logging for throughput tests
CONFIG_BT_NIMBLE_LOG_LEVEL_WARNING=y
CONFIG_BT_NIMBLE_LOG_LEVEL=2
```

## examples/bluetooth/nimble/throughput_app/bleprph_throughput/sdkconfig.defaults
```kconfig
# Defaults for generating a new "sdkconfig" file (project settings).
# https://docs.espressif.com/projects/esp-idf/en/latest/esp32/api-guides/build-system.html#custom-sdkconfig-defaults
#
# NOTE - if this file changes, to get new defaults, you must erase any existing
# "sdkconfig" file (this will undo manual settings from "idf.py menuconfig").

# Override some defaults so BT stack is enabled
# in this example and some example specific misc sizes are increased.

#
# BT config
#
CONFIG_BT_ENABLED=y
CONFIG_BTDM_CTRL_MODE_BLE_ONLY=y
CONFIG_BTDM_CTRL_MODE_BR_EDR_ONLY=n
CONFIG_BTDM_CTRL_MODE_BTDM=n
CONFIG_BT_BLUEDROID_ENABLED=n
CONFIG_BT_NIMBLE_ENABLED=y
CONFIG_BT_NIMBLE_ATT_PREFERRED_MTU=512
CONFIG_BT_NIMBLE_ACL_BUF_COUNT=20
CONFIG_BT_NIMBLE_HCI_EVT_BUF_SIZE=255
CONFIG_BT_NIMBLE_MSYS1_BLOCK_COUNT=50
```

## examples/bluetooth/nimble/throughput_app/gatt/blecent_throughput/sdkconfig.defaults.esp32c6
```kconfig
# === High-Performance Tuning ===
# This config is only applied when building for the ESP32-C6 target
# It is necessary for the C6 to reach 750+ kbps and 1.3+ Mbps throughput.
CONFIG_COMPILER_OPTIMIZATION_PERF=y
CONFIG_FREERTOS_HZ=1000
```
