## examples/bluetooth/nimble/ble_enc_adv_data/enc_adv_data_cent/sdkconfig.defaults.mini
```kconfig
# Override some defaults so BT stack is enabled
# in this example

#
# BT config
#
CONFIG_BT_ENABLED=y
CONFIG_BTDM_CTRL_MODE_BLE_ONLY=y
CONFIG_BTDM_CTRL_MODE_BR_EDR_ONLY=n
CONFIG_BTDM_CTRL_MODE_BTDM=n
CONFIG_BT_BLUEDROID_ENABLED=n
CONFIG_BT_NIMBLE_ENABLED=y
CONFIG_BT_NIMBLE_EXT_ADV=n
CONFIG_BT_NIMBLE_50_FEATURE_SUPPORT=n
CONFIG_BT_NIMBLE_MAX_CONNECTIONS=1
CONFIG_BT_NIMBLE_MAX_BONDS=1
CONFIG_BT_NIMBLE_MAX_CCCDS=1
CONFIG_BT_NIMBLE_ROLE_PERIPHERAL=n
CONFIG_BT_NIMBLE_ROLE_BROADCASTER=n
CONFIG_BT_NIMBLE_SM_SC=n
CONFIG_BT_NIMBLE_ENABLE_CONN_REATTEMPT=n
CONFIG_BT_NIMBLE_50_FEATURE_SUPPORT=n
CONFIG_BT_NIMBLE_MSYS_1_BLOCK_COUNT=6
CONFIG_BT_NIMBLE_MSYS_2_BLOCK_COUNT=0
CONFIG_BT_NIMBLE_TRANSPORT_ACL_FROM_LL_COUNT=12
CONFIG_BT_NIMBLE_TRANSPORT_EVT_COUNT=15
CONFIG_BT_NIMBLE_ATT_MAX_PREP_ENTRIES=15
CONFIG_BT_NIMBLE_GATT_SERVER=n
CONFIG_BT_NIMBLE_PRINT_ERR_NAME=n
CONFIG_BT_ALARM_MAX_NUM=15

CONFIG_BT_NIMBLE_ATT_PREFERRED_MTU=23
CONFIG_PM_ENABLE=n
CONFIG_HEAP_POISONING_DISABLED=y

CONFIG_BOOTLOADER_LOG_LEVEL_NONE=y
CONFIG_BOOTLOADER_COMPILER_OPTIMIZATION_SIZE=y

CONFIG_VFS_SUPPORT_TERMIOS=n
CONFIG_VFS_SUPPORT_DIR=n
CONFIG_VFS_SUPPORT_IO=n
CONFIG_BT_NIMBLE_HOST_TASK_STACK_SIZE=3152

# FreeRTOS
CONFIG_FREERTOS_HZ=100
CONFIG_FREERTOS_IDLE_TASK_STACKSIZE=1024
CONFIG_FREERTOS_ISR_STACKSIZE=1024
CONFIG_FREERTOS_TIMER_TASK_STACK_DEPTH=2048

# C Library
CONFIG_LIBC_NEWLIB_NANO_FORMAT=y
CONFIG_LIBC_STDIN_LINE_ENDING_CRLF=n
CONFIG_LIBC_STDOUT_LINE_ENDING_CRLF=n

# Optimization
CONFIG_COMPILER_OPTIMIZATION_SIZE=y
CONFIG_COMPILER_OPTIMIZATION_ASSERTIONS_DISABLE=y
CONFIG_COMPILER_CXX_EXCEPTIONS=n

# Heap
CONFIG_HEAP_POISONING_DISABLED=y
CONFIG_HEAP_TRACING=n

# Power Management
CONFIG_PM_ENABLE=n

# No networking
CONFIG_ESP_WIFI_ENABLED=n

# Application
CONFIG_APP_COMPILE_TIME_DATE=n


CONFIG_ESP_COEX_SW_COEXIST_ENABLE=n
CONFIG_ESP_ERR_TO_NAME_LOOKUP=n
CONFIG_SPI_MASTER_ISR_IN_IRAM=n
CONFIG_SPI_SLAVE_ISR_IN_IRAM=n
CONFIG_ESP_GDBSTUB_SUPPORT_TASKS=n
CONFIG_ESP_NETIF_REPORT_DATA_TRAFFIC=n
CONFIG_PM_POWER_DOWN_CPU_IN_LIGHT_SLEEP=n
CONFIG_SPI_FLASH_ROM_DRIVER_PATCH=n
CONFIG_SPI_FLASH_YIELD_DURING_ERASE=n
CONFIG_SPI_FLASH_ENABLE_ENCRYPTED_READ_WRITE=n

#Uncomment below, if security needs to be disabled
#CONFIG_BT_NIMBLE_SECURITY_ENABLE=n


#Uncomment below, if logging needs to be disabled
#CONFIG_LOG_DEFAULT_LEVEL_NONE=y
#CONFIG_LOG_DEFAULT_LEVEL=0

#
# Controller Options
#

CONFIG_BT_CTRL_BLE_MAX_ACT=2
CONFIG_BT_CTRL_ADV_DUP_FILT_MAX=1
CONFIG_BT_CTRL_BLE_ADV_REPORT_FLOW_CTRL_SUPP=n
CONFIG_BT_CTRL_BLE_SCAN_DUPL=n
```

## examples/bluetooth/nimble/ble_enc_adv_data/enc_adv_data_prph/main/Kconfig.projbuild
```kconfig
menu "Example Configuration"

    choice EXAMPLE_USE_IO_TYPE
        prompt "I/O Capability"
        default BLE_SM_IO_CAP_NO_IO
        help
            I/O capability of device.

        config BLE_SM_IO_CAP_DISP_ONLY
            bool "DISPLAY ONLY"
        config BLE_SM_IO_CAP_DISP_YES_NO
            bool "DISPLAY YESNO"
        config BLE_SM_IO_CAP_KEYBOARD_ONLY
            bool "KEYBOARD ONLY"
        config BLE_SM_IO_CAP_NO_IO
            bool "Just works"
        config BLE_SM_IO_CAP_KEYBOARD_DISP
            bool "Both KEYBOARD & DISPLAY"
    endchoice

    config EXAMPLE_IO_TYPE
        int
        default 0 if BLE_SM_IO_CAP_DISP_ONLY
        default 1 if BLE_SM_IO_CAP_DISP_YES_NO
        default 2 if BLE_SM_IO_CAP_KEYBOARD_ONLY
        default 3 if BLE_SM_IO_CAP_NO_IO
        default 4 if BLE_SM_IO_CAP_KEYBOARD_DISP

    config EXAMPLE_BONDING
        bool
        default n
        prompt "Use Bonding"
        help
            Use this option to enable/disable bonding.

    config EXAMPLE_USE_SC
        bool
        depends on BT_NIMBLE_SM_SC
        default n
        prompt "Use Secure Connection feature"
        help
            Use this option to enable/disable Security Manager Secure Connection 4.2 feature.

    config EXAMPLE_RANDOM_ADDR
        bool
        prompt "Advertise RANDOM Address"
        help
            Use this option to advertise a random address instead of public address

    config EXAMPLE_RESOLVE_PEER_ADDR
        bool
        prompt "Enable resolving peer address"
        help
            Use this option to enable resolving peer's address.

    config EXAMPLE_ENC_ADV_DATA
        bool
        prompt "Enable encrypted advertising data feature support"
        default y
        select BT_NIMBLE_ENC_ADV_DATA
        help
            This option enables support of encrypted advertising data.

endmenu
```

## examples/bluetooth/nimble/ble_htp/htp_prph/main/Kconfig.projbuild
```kconfig
menu "Example Configuration"

    config EXAMPLE_EXTENDED_ADV
        bool
        depends on SOC_BLE_50_SUPPORTED
        default y if SOC_ESP_NIMBLE_CONTROLLER
        select BT_NIMBLE_EXT_ADV
        prompt "Enable Extended Adv"
        help
            Use this option to enable extended advertising in the example
endmenu
```

## examples/bluetooth/nimble/ble_l2cap_coc/coc_blecent/main/Kconfig.projbuild
```kconfig
menu "Example Configuration"

    config EXAMPLE_PEER_ADDR
        string "Peer Address"
        default "ADDR_ANY"
        help
            Enter the peer address in aa:bb:cc:dd:ee:ff form to connect to a specific peripheral

    config EXAMPLE_EXTENDED_ADV
        bool
        default y if SOC_ESP_NIMBLE_CONTROLLER
        prompt "Enable Extended Adv"
        help
            Use this option to enable extended advertising in the example
endmenu
```

## examples/bluetooth/nimble/ble_l2cap_coc/coc_blecent/sdkconfig.defaults
```kconfig
# Override some defaults so BT stack is enabled
# in this example

#
# BT config
#
CONFIG_BT_ENABLED=y
CONFIG_BTDM_CTRL_MODE_BLE_ONLY=y
CONFIG_BTDM_CTRL_MODE_BR_EDR_ONLY=n
CONFIG_BTDM_CTRL_MODE_BTDM=n
CONFIG_BT_BLUEDROID_ENABLED=n
CONFIG_BT_NIMBLE_ENABLED=y
CONFIG_BT_NIMBLE_L2CAP_COC_MAX_NUM=1
CONFIG_BT_NIMBLE_MSYS_1_BLOCK_COUNT=30
CONFIG_BT_NIMBLE_MSYS_1_BLOCK_SIZE=512
```

## examples/bluetooth/nimble/ble_multi_conn/ble_multi_conn_prph/main/Kconfig.projbuild
```kconfig
menu "Example Configuration"

    config EXAMPLE_EXTENDED_ADV
        bool
        depends on SOC_BLE_50_SUPPORTED
        default y if SOC_ESP_NIMBLE_CONTROLLER
        select BT_NIMBLE_EXT_ADV
        prompt "Enable Extended Adv"
        help
            Use this option to enable extended advertising in the example

    config EXAMPLE_RESTART_ADV_AFTER_CONNECTED
        bool
        default y
        prompt "Restart advertisement when connected"
        help
            To simulate multiple connections with only one device,
            restart the advertisement once a connection has been established.

endmenu
```

## examples/bluetooth/nimble/ble_multi_conn/ble_multi_conn_prph/sdkconfig.defaults
```kconfig
# Minimal NimBLE config for multi-connection peripheral (requires BLE 5.0 ext adv).
# Supported targets: ESP32-C5, ESP32-C6, ESP32-C61, ESP32-H2, etc. (see README.md).

CONFIG_BT_ENABLED=y
CONFIG_BT_NIMBLE_ENABLED=y
CONFIG_BT_NIMBLE_50_FEATURE_SUPPORT=y
CONFIG_BT_NIMBLE_EXT_ADV=y
CONFIG_BT_NIMBLE_TRANSPORT_EVT_SIZE=70
CONFIG_BT_NIMBLE_MAX_CONNECTIONS=69
CONFIG_BT_NIMBLE_MSYS_1_BLOCK_COUNT=100
CONFIG_BT_NIMBLE_LOG_LEVEL_WARNING=y
CONFIG_BT_NIMBLE_BLE_POWER_CONTROL=y
```

## examples/bluetooth/nimble/ble_pawr_adv/ble_pawr_adv/sdkconfig.defaults
```kconfig
# Override some defaults so BT stack is enabled
# in this example

#
# BT config
#
CONFIG_BT_ENABLED=y
CONFIG_BT_BLUEDROID_ENABLED=n
CONFIG_BT_NIMBLE_ENABLED=y
CONFIG_BT_NIMBLE_EXT_ADV=y
CONFIG_BT_NIMBLE_PERIODIC_ADV_WITH_RESPONSES=y
CONFIG_BT_NIMBLE_MAX_PERIODIC_SYNCS=1
CONFIG_BT_NIMBLE_ROLE_CENTRAL=y
CONFIG_BT_NIMBLE_ROLE_OBSERVER=n

CONFIG_BT_CONTROLLER_DISABLED=y

#
# Host-controller Transport
#
CONFIG_BT_NIMBLE_TRANSPORT_UART_PORT=1
CONFIG_UART_BAUDRATE_115200=y
CONFIG_BT_NIMBLE_UART_TX_PIN=20
CONFIG_BT_NIMBLE_UART_RX_PIN=21
CONFIG_UART_HW_FLOWCTRL_CTS_RTS=n
# CONFIG_BT_NIMBLE_HCI_UART_RTS_PIN=22
# CONFIG_BT_NIMBLE_HCI_UART_CTS_PIN=23
# end of Host-controller Transport
# end of NimBLE Options

#    C6          Nordic
#  TX:  20  ----   RX
#  RX:  21  ----   TX
#  RTS: 22  ----  CTS
#  CTS: 23  ----  RTS
```

## examples/bluetooth/nimble/ble_pawr_adv/ble_pawr_sync/sdkconfig.defaults
```kconfig
# Override some defaults so BT stack is enabled
# in this example

#
# BT config
#
CONFIG_BT_ENABLED=y
CONFIG_BT_BLUEDROID_ENABLED=n
CONFIG_BT_NIMBLE_ENABLED=y
CONFIG_BT_NIMBLE_EXT_ADV=n
CONFIG_BT_NIMBLE_PERIODIC_ADV_WITH_RESPONSES=y
CONFIG_BT_NIMBLE_MAX_PERIODIC_SYNCS=1
CONFIG_BT_NIMBLE_ROLE_CENTRAL=n
CONFIG_BT_NIMBLE_ROLE_OBSERVER=y

CONFIG_BT_CONTROLLER_ENABLED=y
```

## examples/bluetooth/nimble/ble_pawr_adv_conn/ble_pawr_adv_conn/sdkconfig.defaults
```kconfig
# Override some defaults so BT stack is enabled
# in this example

#
# BT config
#
CONFIG_BT_ENABLED=y
CONFIG_BT_BLUEDROID_ENABLED=n
CONFIG_BT_NIMBLE_ENABLED=y
CONFIG_BT_NIMBLE_EXT_ADV=y
CONFIG_BT_NIMBLE_PERIODIC_ADV_WITH_RESPONSES=y
CONFIG_BT_NIMBLE_MAX_PERIODIC_SYNCS=1
CONFIG_BT_NIMBLE_ROLE_CENTRAL=y
CONFIG_BT_NIMBLE_ROLE_OBSERVER=n

CONFIG_BT_CONTROLLER_ENABLED=y
```

## examples/bluetooth/nimble/ble_periodic_adv/main/Kconfig.projbuild
```kconfig
menu "Example Configuration"

    config EXAMPLE_RANDOM_ADDR
        bool
        prompt "Advertise RANDOM Address"
        help
            Use this option to advertise a random address instead of public address

    config EXAMPLE_PERIODIC_ADV_ENH
        bool
        prompt "Enable Periodic Adv Enhancements"
        depends on SOC_BLE_50_SUPPORTED && SOC_BLE_PERIODIC_ADV_ENH_SUPPORTED
        select BT_NIMBLE_PERIODIC_ADV_ENH
        help
            Use this option to enable periodic advertising enhancements
endmenu
```

## examples/bluetooth/nimble/ble_phy/phy_prph/main/Kconfig.projbuild
```kconfig
menu "Example Configuration"

    choice EXAMPLE_USE_IO_TYPE
        prompt "I/O Capability"
        default BLE_SM_IO_CAP_NO_IO
        help
            I/O capability of device.

        config BLE_SM_IO_CAP_DISP_ONLY
            bool "DISPLAY ONLY"
        config BLE_SM_IO_CAP_DISP_YES_NO
            bool "DISPLAY YESNO"
        config BLE_SM_IO_CAP_KEYBOARD_ONLY
            bool "KEYBOARD ONLY"
        config BLE_SM_IO_CAP_NO_IO
            bool "Just works"
        config BLE_SM_IO_CAP_KEYBOARD_DISP
            bool "Both KEYBOARD & DISPLAY"
    endchoice

    config EXAMPLE_IO_TYPE
        int
        default 0 if BLE_SM_IO_CAP_DISP_ONLY
        default 1 if BLE_SM_IO_CAP_DISP_YES_NO
        default 2 if BLE_SM_IO_CAP_KEYBOARD_ONLY
        default 3 if BLE_SM_IO_CAP_NO_IO
        default 4 if BLE_SM_IO_CAP_KEYBOARD_DISP

    config EXAMPLE_BONDING
        bool
        prompt "Use Bonding"
        help
            Use this option to enable/disable bonding.

    config EXAMPLE_MITM
        bool
        prompt "MITM security"
        help
            Use this option to enable/disable MITM security.

    config EXAMPLE_USE_SC
        bool
        depends on BT_NIMBLE_SM_SC
        prompt "Use Secure Connection feature"
        help
            Use this option to enable/disable Security Manager Secure Connection 4.2 feature.
endmenu
```

## examples/bluetooth/nimble/ble_proximity_sensor/proximity_sensor_cent/sdkconfig.defaults
```kconfig
# Override some defaults so BT stack is enabled
# in this example

#
# BT config
#
CONFIG_BT_ENABLED=y
CONFIG_BT_BLUEDROID_ENABLED=n
CONFIG_BT_NIMBLE_ENABLED=y
```

## examples/bluetooth/nimble/ble_spp/spp_client/sdkconfig.defaults.dram_optimised
```kconfig
# Override some defaults so BT stack is enabled
# in this example

#
# BT config
#
CONFIG_BT_ENABLED=y
CONFIG_BTDM_CTRL_MODE_BLE_ONLY=y
CONFIG_BTDM_CTRL_MODE_BR_EDR_ONLY=n
CONFIG_BTDM_CTRL_MODE_BTDM=n
CONFIG_BT_BLUEDROID_ENABLED=n
CONFIG_BT_NIMBLE_ENABLED=y

CONFIG_BT_NIMBLE_SM_SC=n
CONFIG_BT_NIMBLE_LL_CFG_FEAT_LE_ENCRYPTION=n
CONFIG_BT_NIMBLE_GATT_MAX_PROCS=3
CONFIG_BT_NIMBLE_MAX_CONNECTIONS=1
CONFIG_BT_NIMBLE_MAX_BONDS=1
CONFIG_BT_NIMBLE_MAX_CCCDS=1
CONFIG_BT_NIMBLE_ENABLE_CONN_REATTEMPT=n
CONFIG_BT_NIMBLE_TRANSPORT_EVT_COUNT=15

#Uncomment below, if security needs to be disabled
#CONFIG_BT_NIMBLE_SECURITY_ENABLE=n

CONFIG_SPI_FLASH_ROM_IMPL=y
CONFIG_SPI_FLASH_SUPPORT_ISSI_CHIP=n
CONFIG_SPI_FLASH_SUPPORT_MXIC_CHIP=n
CONFIG_SPI_FLASH_SUPPORT_GD_CHIP=n
CONFIG_SPI_FLASH_SUPPORT_WINBOND_CHIP=n
CONFIG_SPI_FLASH_SUPPORT_BOYA_CHIP=n
CONFIG_SPI_FLASH_SUPPORT_TH_CHIP=n
CONFIG_SPI_FLASH_ENABLE_ENCRYPTED_READ_WRITE=n

CONFIG_VFS_SUPPORT_TERMIOS=n
CONFIG_VFS_SUPPORT_IO=n

CONFIG_COMPILER_OPTIMIZATION_SIZE=y
CONFIG_COMPILER_OPTIMIZATION_ASSERTIONS_DISABLE=y

CONFIG_ESP_COEX_SW_COEXIST_ENABLE=n

CONFIG_ESP_TASK_WDT_EN=n

#Uncomment below, if logging needs to be disabled
#CONFIG_LOG_DEFAULT_LEVEL_NONE=y
#CONFIG_LOG_DEFAULT_LEVEL=0
```

## examples/bluetooth/nimble/ble_spp/spp_server/main/Kconfig.projbuild
```kconfig
menu "Example Configuration"

    config EXAMPLE_IO_TYPE
        int "IO Type"
        default 3

endmenu
```

## examples/bluetooth/nimble/blecent/main/Kconfig.projbuild
```kconfig
menu "Example Configuration"

    config EXAMPLE_PEER_ADDR
        string "Peer Address"
        default "ADDR_ANY"
        help
            Enter the peer address in aa:bb:cc:dd:ee:ff form to connect to a specific peripheral

    config EXAMPLE_EXTENDED_ADV
        bool
        depends on SOC_BLE_50_SUPPORTED
        default y if SOC_ESP_NIMBLE_CONTROLLER
        select BT_NIMBLE_EXT_ADV
        prompt "Enable Extended Adv"
        help
            Use this option to enable extended advertising in the example.
            If this option is disabled, ensure config BT_NIMBLE_EXT_ADV is
            also disabled from Nimble stack menuconfig

    config EXAMPLE_INIT_DEINIT_LOOP
        bool
        prompt "Perform init deinit of nimble stack in a loop"
        help
            Enable this flag, to perform only stack Init and Deinit in a loop.

    config EXAMPLE_ENCRYPTION
        bool
        prompt "Enable Link Encryption"
        help
            This enables bonding and encryption after connection has been established.

    config EXAMPLE_USE_CI_ADDRESS
        bool
        default n
        prompt "Advertise using Test address(Internal Test ONLY)"
        help
            Used for internal test ONLY.
            Use this option to advertise in a specific random address.
endmenu
```

## examples/bluetooth/nimble/blemesh/sdkconfig.defaults
```kconfig
# Defaults for generating a new "sdkconfig" file (project settings).
# https://docs.espressif.com/projects/esp-idf/en/latest/esp32/api-guides/build-system.html#custom-sdkconfig-defaults
#
# NOTE - if this file changes, to get new defaults, you must erase any existing
# "sdkconfig" file (this will undo manual settings from "idf.py menuconfig").

# Override some defaults so BT stack is enabled
# in this example

#
# BT config
#
CONFIG_BT_ENABLED=y
CONFIG_BTDM_CTRL_MODE_BLE_ONLY=y
CONFIG_BTDM_CTRL_MODE_BR_EDR_ONLY=n
CONFIG_BTDM_CTRL_MODE_BTDM=n
CONFIG_BT_BLUEDROID_ENABLED=n
CONFIG_BT_NIMBLE_ENABLED=y
CONFIG_BT_NIMBLE_MESH=y
CONFIG_BT_NIMBLE_MESH_FRIEND=y
```
