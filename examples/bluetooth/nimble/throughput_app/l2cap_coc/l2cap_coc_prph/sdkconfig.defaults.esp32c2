## examples/bluetooth/nimble/throughput_app/l2cap_coc/l2cap_coc_prph/sdkconfig.defaults.esp32c2
```kconfig
# MTU is intentionally left at the Kconfig default (16384) for throughput.
# Reducing to 2048 cuts credits from ~67 to ~9, dropping throughput ~8x.
# If the build fails due to RAM pressure (~96 KB static SDU pool), lower MTU here.
CONFIG_BT_NIMBLE_MSYS_1_BLOCK_COUNT=12
CONFIG_BT_NIMBLE_MSYS_1_BLOCK_SIZE=292
CONFIG_BT_NIMBLE_MSYS_2_BLOCK_COUNT=0
CONFIG_BT_NIMBLE_TRANSPORT_ACL_FROM_LL_COUNT=24
```

## examples/bluetooth/nimble/throughput_app/l2cap_coc/l2cap_coc_prph/sdkconfig.defaults.esp32c3
```kconfig
# MTU is intentionally left at the Kconfig default (16384) for throughput.
# Reducing MTU lowers L2CAP credit flow, which directly cuts throughput.
# If the build fails due to RAM pressure (~98 KB static SDU pool), lower MTU here.
CONFIG_BT_NIMBLE_MSYS_1_BLOCK_COUNT=20
CONFIG_BT_NIMBLE_TRANSPORT_ACL_FROM_LL_COUNT=24
CONFIG_BT_CTRL_BLE_STATIC_ACL_TX_BUF_NB=8
```

## examples/bluetooth/nimble/throughput_app/l2cap_coc/l2cap_coc_prph/sdkconfig.defaults.esp32h2
```kconfig
CONFIG_BT_NIMBLE_MSYS_1_BLOCK_COUNT=30
CONFIG_BT_NIMBLE_TRANSPORT_ACL_FROM_LL_COUNT=67
```

## examples/build_system/cmake/import_lib/sdkconfig.defaults
```kconfig
# Defaults for generating a new "sdkconfig" file (project settings).
# https://docs.espressif.com/projects/esp-idf/en/latest/esp32/api-guides/build-system.html#custom-sdkconfig-defaults
#
# NOTE - if this file changes, to get new defaults, you must erase any existing
# "sdkconfig" file (this will undo manual settings from "idf.py menuconfig").

CONFIG_PARTITION_TABLE_CUSTOM=y
CONFIG_PARTITION_TABLE_CUSTOM_FILENAME="partitions_example.csv"
CONFIG_PARTITION_TABLE_FILENAME="partitions_example.csv"
```

## examples/build_system/cmake/linux_host_app/sdkconfig.defaults
```kconfig
# Defaults for generating a new "sdkconfig" file (project settings).
# https://docs.espressif.com/projects/esp-idf/en/latest/esp32/api-guides/build-system.html#custom-sdkconfig-defaults
#
# NOTE - if this file changes, to get new defaults, you must erase any existing
# "sdkconfig" file (this will undo manual settings from "idf.py menuconfig").

CONFIG_UNITY_ENABLE_IDF_TEST_RUNNER=n
CONFIG_IDF_TARGET="linux"
CONFIG_COMPILER_CXX_EXCEPTIONS=y
```

## examples/build_system/cmake/multi_config/sdkconfig.defaults
```kconfig
# Defaults for generating a new "sdkconfig" file (project settings).
# https://docs.espressif.com/projects/esp-idf/en/latest/esp32/api-guides/build-system.html#custom-sdkconfig-defaults
#
# NOTE - if this file changes, to get new defaults, you must erase any existing
# "sdkconfig" file (this will undo manual settings from "idf.py menuconfig").

# In this example, the default build (obtained with 'idf.py build')
# targets a hypothetical development platform.
CONFIG_EXAMPLE_PRODUCT_NAME="Blinky Development Board"

# This selects 'func_dev.c' file to be compiled and linked, see CMakeLists.txt.
CONFIG_EXAMPLE_FUNC_IMPL_DEV=y
```

## examples/build_system/cmake/multi_config/sdkconfig.defaults.prod1
```kconfig
# This build configuration is for a specific product:
CONFIG_EXAMPLE_PRODUCT_NAME="Blinky Smart Light"
```

## examples/build_system/cmakev2/features/conditional_component/main/Kconfig.projbuild
```kconfig
menu "Conditional Component Example Configuration"

    config EXAMPLE_ENABLE_LOGGING
        bool "Enable Logging Utility Component"
        default y
        help
            Enable the logging_util component to demonstrate conditional
            component inclusion in Build System v2.

    config EXAMPLE_ENABLE_MATH
        bool "Enable Math Utility Component"
        default y
        help
            Enable the math_util component to demonstrate conditional
            component inclusion in Build System v2.

endmenu
```

## examples/build_system/cmakev2/features/multi_config/main/Kconfig.projbuild
```kconfig
menu "Example Product Configuration"

    config EXAMPLE_PRODUCT_NAME
        string "Product name"
        default "Not set"
        help
            Product name used in the example

    choice EXAMPLE_FUNC_IMPL
        prompt "Implementation of function 'func'"
        help
            Select one of the implementations of 'func' to be used in the app.
            This setting is used in component CMakeLists.txt.

        config EXAMPLE_FUNC_IMPL_DEV
            bool "Development (func_dev.c)"
        config EXAMPLE_FUNC_IMPL_PROD
            bool "Production (func_prod.c)"
    endchoice
endmenu
```

## examples/build_system/cmakev2/features/multi_config/sdkconfig.defaults.prod_common
```kconfig
# Common settings for production builds.
# For product-specific settings, see sdkconfig.defaults.prod1 and sdkconfig.defaults.prod2.

# This selects 'func_prod.c' file to be compiled and linked, see CMakeLists.txt.
CONFIG_EXAMPLE_FUNC_IMPL_PROD=y

# Optimize the binary size of a production build, and remove all log messages.
CONFIG_COMPILER_OPTIMIZATION_SIZE=y
CONFIG_BOOTLOADER_LOG_LEVEL_NONE=y
CONFIG_LOG_DEFAULT_LEVEL_NONE=y
```

## examples/common_components/env_caps/esp32c2/Kconfig.env_caps
```kconfig
config ENV_GPIO_RANGE_MIN
    int
    default 0

config ENV_GPIO_RANGE_MAX
    int
    default 18
    # GPIOs 19/20 are always used by UART in examples

config ENV_GPIO_IN_RANGE_MAX
    int
    default ENV_GPIO_RANGE_MAX

config ENV_GPIO_OUT_RANGE_MAX
    int
    default ENV_GPIO_RANGE_MAX
```

## examples/common_components/env_caps/esp32p4/Kconfig.env_caps
```kconfig
config ENV_GPIO_RANGE_MIN
    int
    default 0

config ENV_GPIO_RANGE_MAX
    int
    default 56

config ENV_GPIO_IN_RANGE_MAX
    int
    default ENV_GPIO_RANGE_MAX

config ENV_GPIO_OUT_RANGE_MAX
    int
    default ENV_GPIO_RANGE_MAX
```

## examples/common_components/iperf/Kconfig.projbuild
```kconfig
menu "Iperf Configuration"

    config IPERF_SOCKET_RX_TIMEOUT
        int "iperf socket TCP/UDP rx timeout in seconds"
        default 10
        help
            The value is used for iperf socket TCP/UDP rx timeout, iperf will be aborted
            and socket will be closed and shutdown.

    config IPERF_SOCKET_TCP_TX_TIMEOUT
        int "iperf socket TCP tx timeout in seconds"
        default 10
        help
            The value is used for iperf socket TCP tx timeout, iperf will be aborted
            and socket will be closed and shutdown.

    config IPERF_TRAFFIC_TASK_PRIORITY
        int "iperf traffic task priority"
        default 4
        range 1 24
        help
            The value is used for iperf traffic task priority.

    config IPERF_REPORT_TASK_PRIORITY
        int "iperf result report task priority"
        default 6
        range 1 24
        help
            The value is used for iperf result report task priority.

endmenu
```
