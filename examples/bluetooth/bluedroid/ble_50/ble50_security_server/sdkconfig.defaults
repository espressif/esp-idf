## examples/bluetooth/bluedroid/ble_50/ble50_throughput/throughput_server/main/Kconfig.projbuild
```kconfig
menu "Example 'GATT SERVER THROUGHPUT' Config"

    config EXAMPLE_GATTS_NOTIFY_THROUGHPUT
        bool "test the gatts notify throughput"
        help
            If this config item is set, then the 'EXAMPLE_GATTC_WRITE_THROUGHPUT' config should be close, it can't test
            both write or notify at the same time at this demo

    config EXAMPLE_GATTC_WRITE_THROUGHPUT
        bool "test the gattc write throughput"
        help
            If this config item is set, then the 'EXAMPLE_GATTS_NOTIFY_THROUGHPUT' config should be close, it can't
            test both write or notify at the same time at this demo

    choice EXAMPLE_THROUGHPUT_PHY
        prompt "BLE PHY mode"
        default EXAMPLE_THROUGHPUT_1M_PHY
        help
            Define BT BLE PHY mode

        config EXAMPLE_THROUGHPUT_1M_PHY
            bool "1M PHY"
        config EXAMPLE_THROUGHPUT_2M_PHY
            bool "2M PHY"
        config EXAMPLE_THROUGHPUT_CODED_PHY_S2
            bool "Coded PHY S2"
        config EXAMPLE_THROUGHPUT_CODED_PHY_S8
            bool "Coded PHY S8"
    endchoice

    config EXAMPLE_THROUGHPUT_PHY
        int
        default 0 if EXAMPLE_THROUGHPUT_1M_PHY
        default 1 if EXAMPLE_THROUGHPUT_2M_PHY
        default 2 if EXAMPLE_THROUGHPUT_CODED_PHY_S2
        default 3 if EXAMPLE_THROUGHPUT_CODED_PHY_S8
endmenu
```

## examples/bluetooth/bluedroid/ble_50/ble_pawr_synchronizer/sdkconfig.defaults
```kconfig
CONFIG_BT_ENABLED=y
CONFIG_BT_BLUEDROID_ENABLED=y
CONFIG_BT_BLE_50_FEATURES_SUPPORTED=y
CONFIG_BT_BLE_42_FEATURES_SUPPORTED=n
CONFIG_BT_BLE_50_EXTEND_SCAN_EN=y
CONFIG_BT_BLE_50_EXTEND_SYNC_EN=y
CONFIG_BT_BLE_FEAT_PAWR_EN=y
CONFIG_BT_LE_PERIODIC_ADV_WITH_RESPONSE_ENABLED=y

CONFIG_BT_GATTC_ENABLE=n

CONFIG_BT_BLE_SMP_ENABLE=n

CONFIG_BT_BLE_50_EXTEND_ADV_EN=n
```

## examples/bluetooth/bluedroid/ble_50/ble_periodic_adv_with_cte/sdkconfig.defaults
```kconfig
CONFIG_BT_ENABLED=y
CONFIG_BT_BLUEDROID_ENABLED=y
CONFIG_BT_BLE_50_FEATURES_SUPPORTED=y
CONFIG_BT_BLE_42_FEATURES_SUPPORTED=n

CONFIG_BT_BLE_FEAT_PERIODIC_ADV_ENH=y
CONFIG_BT_BLE_FEAT_CTE_EN=y
CONFIG_BT_LE_CTE_FEATURE_ENABLED=y

CONFIG_BT_BLE_FEAT_CTE_CONNECTION_EN=n

CONFIG_BT_BLE_FEAT_CTE_CONNECTIONLESS_EN=y

CONFIG_BT_BLE_SMP_ENABLE=n

CONFIG_BT_GATTC_ENABLE=n

CONFIG_BT_GATTS_ENABLE=n

CONFIG_BT_BLE_50_EXTEND_ADV_EN=y

CONFIG_BT_BLE_50_PERIODIC_ADV_EN=y

CONFIG_BT_BLE_50_EXTEND_SCAN_EN=n

CONFIG_BT_BLE_50_DTM_TEST_EN=n
```

## examples/bluetooth/bluedroid/ble_50/periodic_sync/main/Kconfig.projbuild
```kconfig
menu "Example 'PERIODIC SYNCHRONIZATION' Config"

    config EXAMPLE_CI_ID
        int "example id for CI test"
        default 0
        help
            This config the example id for CI test. Only for internal used.

    config EXAMPLE_CI_PIPELINE_ID
        int "The pipeline id for CI test"
        default 0
        help
            This config the pipeline id for CI test. Only for internal used.

endmenu
```

## examples/bluetooth/bluedroid/bluedroid_host_only/bluedroid_host_only_uart/main/Kconfig.projbuild
```kconfig
menu "Example Configuration"
    config EXAMPLE_HCI_UART_BAUDRATE
        int "UART Baudrate for HCI"
        range 115200 921600
        default 921600
        help
            UART Baudrate for HCI. Please use standard baudrate.
endmenu
```

## examples/bluetooth/bluedroid/bluedroid_host_only/bluedroid_host_only_uart/sdkconfig.defaults
```kconfig
CONFIG_BT_CONTROLLER_DISABLED=y
CONFIG_BT_ENABLED=y
CONFIG_BT_BLUEDROID_ENABLED=y
CONFIG_BT_CLASSIC_ENABLED=y
```

## examples/bluetooth/bluedroid/classic_bt/a2dp_sink/main/Kconfig.projbuild
```kconfig
menu "A2DP Example Configuration"
    config EXAMPLE_A2DP_SINK_SSP_ENABLED
        bool "Secure Simple Pairing"
        depends on BT_CLASSIC_ENABLED
        default y
        help
            This enables the Secure Simple Pairing. If disable this option,
            Bluedroid will only support Legacy Pairing

    choice EXAMPLE_A2DP_SINK_OUTPUT
        prompt "A2DP Sink Output"
        default EXAMPLE_A2DP_SINK_OUTPUT_EXTERNAL_I2S
        help
            Select to use Internal DAC or external I2S driver

        config EXAMPLE_A2DP_SINK_OUTPUT_INTERNAL_DAC
            bool "Internal DAC"
            help
                Select this to use Internal DAC sink output,
                note that DAC_DMA_AUTO_16BIT_ALIGN should be turned off
                because the audio data are already 16-bit width

        config EXAMPLE_A2DP_SINK_OUTPUT_EXTERNAL_I2S
            bool "External I2S Codec"
            help
                Select this to use External I2S sink output

    endchoice

    config EXAMPLE_I2S_LRCK_PIN
        int "I2S LRCK (WS) GPIO"
        default 22
        depends on EXAMPLE_A2DP_SINK_OUTPUT_EXTERNAL_I2S
        help
            GPIO number to use for I2S LRCK(WS) Driver.

    config EXAMPLE_I2S_BCK_PIN
        int "I2S BCK GPIO"
        default 26
        depends on EXAMPLE_A2DP_SINK_OUTPUT_EXTERNAL_I2S
        help
            GPIO number to use for I2S BCK Driver.

    config EXAMPLE_I2S_DATA_PIN
        int "I2S DATA GPIO"
        default 25
        depends on EXAMPLE_A2DP_SINK_OUTPUT_EXTERNAL_I2S
        help
            GPIO number to use for I2S Data Driver.

endmenu
```

## examples/bluetooth/bluedroid/classic_bt/a2dp_sink/sdkconfig.defaults
```kconfig
# Override some defaults so BT stack is enabled and
# Classic BT is enabled and BT_DRAM_RELEASE is disabled
CONFIG_BT_ENABLED=y
CONFIG_BTDM_CTRL_MODE_BLE_ONLY=n
CONFIG_BTDM_CTRL_MODE_BR_EDR_ONLY=y
CONFIG_BTDM_CTRL_MODE_BTDM=n
CONFIG_BT_BLUEDROID_ENABLED=y
CONFIG_BT_CLASSIC_ENABLED=y
CONFIG_BT_A2DP_ENABLE=y
CONFIG_DAC_DMA_AUTO_16BIT_ALIGN=n
```

## examples/bluetooth/bluedroid/classic_bt/a2dp_sink_stream/main/Kconfig.projbuild
```kconfig
menu "A2DP Example Configuration"
    config EXAMPLE_LOCAL_DEVICE_NAME
        string "Local Device Name"
        default "ESP_SPEAKER"
        help
            Use this option to set local device name.

    config EXAMPLE_A2DP_SINK_USE_EXTERNAL_CODEC
        bool "Use External Codec Instead of Internal"
        default n
        select BT_A2DP_USE_EXTERNAL_CODEC
        help
            If enable, Bluedroid stack will not decode A2DP audio data, user need to decode it in application layer.

endmenu
```

## examples/bluetooth/bluedroid/classic_bt/a2dp_sink_stream/sdkconfig.defaults.esp32s31
```kconfig
CONFIG_PARTITION_TABLE_SINGLE_APP_LARGE=y
CONFIG_EXAMPLE_A2DP_SINK_OUTPUT_EXTERNAL_I2S=y
CONFIG_EXAMPLE_I2S_BCK_PIN=2
CONFIG_EXAMPLE_I2S_LRCK_PIN=3
CONFIG_EXAMPLE_I2S_DATA_PIN=4
```

## examples/bluetooth/bluedroid/classic_bt/a2dp_sink_stream_aac/main/Kconfig.projbuild
```kconfig
menu "A2DP Example Configuration"
    config EXAMPLE_LOCAL_DEVICE_NAME
        string "Local Device Name"
        default "ESP_SPEAKER_AAC"
        help
            Use this option to set local device name.

endmenu
```

## examples/bluetooth/bluedroid/classic_bt/avrcp_absolute_volume/main/Kconfig.projbuild
```kconfig
menu "AVRCP Example Configuration"
    config EXAMPLE_LOCAL_DEVICE_NAME
        string "Local Device Name"
        default "ESP_SPEAKER"
        help
            Use this option to set local device name.

    config EXAMPLE_A2DP_SINK_STREAM_ENABLE
        bool "Enable A2DP Sink Stream"
        default y
        help
            This enables the A2DP sink stream. If disable this option,
            audio data will not be transmitted

    config EXAMPLE_A2DP_SINK_USE_EXTERNAL_CODEC
        bool "Use External Codec Instead of Internal"
        depends on EXAMPLE_A2DP_SINK_STREAM_ENABLE
        default n
        select BT_A2DP_USE_EXTERNAL_CODEC
        help
            If enable, Bluedroid stack will not decode A2DP audio data, user need to decode it in application layer.

endmenu
```

## examples/bluetooth/bluedroid/classic_bt/avrcp_ct_metadata/main/Kconfig.projbuild
```kconfig
menu "AVRCP Example Configuration"
    config EXAMPLE_LOCAL_DEVICE_NAME
        string "Local Device Name"
        default "ESP_SPEAKER"
        help
            Use this option to set local device name.

    config EXAMPLE_A2DP_SINK_STREAM_ENABLE
        bool "Enable A2DP Sink Stream"
        default y
        help
            This enables the A2DP sink stream. If disable this option,
            audio data will not be transmitted

endmenu
```
