## examples/bluetooth/bluedroid/ble/ble_spp_client/main/Kconfig.projbuild
```kconfig
menu "Example 'SPP CLIENT' Config"

    choice EXAMPLE_SPP_CLIENT
        prompt "SPP TRANSPORT mode"
        default EXAMPLE_SPP_THROUGHPUT
        help
            Define SPP TRANSPORT mode

        config EXAMPLE_SPP_THROUGHPUT
            bool "Throughput"
        config EXAMPLE_SPP_RELIABLE
            bool "Reliable"
    endchoice

    config EXAMPLE_CI_ID
        int "example id for CI test"
        default 0
        help
            This config the example id for CI test. Only for internal used.

    config EXAMPLE_CI_PIPELINE_ID
        int "The pipeline id for CI test"
        default 0
        help
            This config the pipeline id for CI test. Only for internal used.

endmenu
```

## examples/bluetooth/bluedroid/ble/ble_spp_server/main/Kconfig.projbuild
```kconfig
menu "Example 'SPP SERVER' Config"

    choice EXAMPLE_SPP_SERVER
        prompt "SPP TRANSPORT mode"
        default EXAMPLE_SPP_THROUGHPUT
        help
            Define SPP TRANSPORT mode

        config EXAMPLE_SPP_THROUGHPUT
            bool "Throughput"
        config EXAMPLE_SPP_RELIABLE
            bool "Reliable"
    endchoice

    config EXAMPLE_ENABLE_RF_EMC_TEST_MODE
        bool
        prompt "Enable BLE EMC test mode for RF"
        default n
        help
            Use this option to enable BLE EMC test mode for RF.

endmenu
```

## examples/bluetooth/bluedroid/ble/ble_throughput/throughput_client/main/Kconfig.projbuild
```kconfig
menu "Example 'GATT CLIENT THROUGHPUT' Config"

    config EXAMPLE_GATTS_NOTIFY_THROUGHPUT
        bool "test the gatts notify throughput"
        help
            If this config item is set, then the 'EXAMPLE_GATTC_WRITE_THROUGHPUT' config should be close,
            it can't test both write or notify at the same time at this demo

    config EXAMPLE_GATTC_WRITE_THROUGHPUT
        bool "test the gattc write throughput"
        help
            If this config item is set, then the 'EXAMPLE_GATTS_NOTIFY_THROUGHPUT' config should be close,
            it can't test both write or notify at the same time at this demo

    config EXAMPLE_CI_ID
        int
        default 60
        help
            This config the example id for CI test. Only for internal used.

    config EXAMPLE_CI_PIPELINE_ID
        int "The pipeline id for CI test"
        default 0
        help
            This config the pipeline id for CI test. Only for internal used.

endmenu
```

## examples/bluetooth/bluedroid/ble/ble_throughput/throughput_server/main/Kconfig
```kconfig
menu "Example 'GATT SERVER THROUGHPUT' Config"

    config EXAMPLE_SET_RAW_ADV_DATA
        bool "Use raw data for advertising packets and scan response data"
        help
            If this config item is set, raw binary data will be used to generate advertising & scan response data.
            This option uses the esp_ble_gap_config_adv_data_raw() and esp_ble_gap_config_scan_rsp_data_raw()
            functions.

            If this config item is unset, advertising & scan response data is provided via a higher-level
            esp_ble_adv_data_t structure. The lower layer will generate the BLE packets. This option has higher
            overhead at runtime.

    config EXAMPLE_GATTS_NOTIFY_THROUGHPUT
        bool "test the gatts notify throughput"
        help
            If this config item is set, then the 'EXAMPLE_GATTC_WRITE_THROUGHPUT' config should be close, it can't test
            both write or notify at the same time at this demo

    config EXAMPLE_GATTC_WRITE_THROUGHPUT
        bool "test the gattc write throughput"
        help
            If this config item is set, then the 'EXAMPLE_GATTS_NOTIFY_THROUGHPUT' config should be close, it can't
            test both write or notify at the same time at this demo
endmenu
```

## examples/bluetooth/bluedroid/ble/gatt_client/main/Kconfig.projbuild
```kconfig
menu "Example Configuration"

    config EXAMPLE_DUMP_ADV_DATA_AND_SCAN_RESP
        bool "Dump whole adv data and scan response data in example"
        default n

    config EXAMPLE_CI_ID
        int "example id for CI test"
        default 0
        help
            This config the example id for CI test. Only for internal used.

    config EXAMPLE_CI_PIPELINE_ID
        int "The pipeline id for CI test"
        default 0
        help
            This config the pipeline id for CI test. Only for internal used.

    config EXAMPLE_INIT_DEINIT_LOOP
        bool "Perform init deinit of bluedroid host in a loop"
        default n
        help
            This config perform host init deinit loop for CI test. Only for internal used
endmenu
```

## examples/bluetooth/bluedroid/ble/gatt_server/main/Kconfig
```kconfig
menu "Example 'GATT SERVER' Config"

    config SET_RAW_ADV_DATA
        bool "Use raw data for advertising packets and scan response data"
        help
            If this config item is set, raw binary data will be used to generate advertising & scan response data.
            This option uses the esp_ble_gap_config_adv_data_raw() and esp_ble_gap_config_scan_rsp_data_raw()
            functions.

            If this config item is unset, advertising & scan response data is provided via a higher-level
            esp_ble_adv_data_t structure. The lower layer will generate the BLE packets. This option has higher
            overhead at runtime.

endmenu
```

## examples/bluetooth/bluedroid/ble/gatt_server/main/Kconfig.projbuild
```kconfig
menu "Example 'GATT SERVER' Config"
    config EXAMPLE_CHAR_READ_DATA_LEN
        int "Length of characteristic value for Read Long support"
        default 4
        range 4 1000
        help
            Defines the length of the characteristic value used in the
            Read Characteristic Values procedure.

            If the characteristic value length exceeds (MTU - 1) bytes,
            the Read Long procedure is automatically triggered, requiring
            multiple `ATT_READ_BLOB_REQ` requests from the client to retrieve
            the full value. For details, refer to Bluetooth Core Specification
            Vol 3, Part G §4.8.3.

            Note: To ensure compatibility with certain smartphones,
            the Read Long response length should ideally not exceed 500 bytes.
            If a device receives more than 600 bytes, it may stop sending
            `ATT_READ_BLOB_REQ`, resulting in incomplete data reception.


    config EXAMPLE_SET_RAW_ADV_DATA
        bool "Use raw data for advertising packets and scan response data"
        help
            If this config item is set, raw binary data will be used to generate advertising & scan response data.
            This option uses the esp_ble_gap_config_adv_data_raw() and esp_ble_gap_config_scan_rsp_data_raw()
            functions.

            If this config item is unset, advertising & scan response data is provided via a higher-level
            esp_ble_adv_data_t structure. The lower layer will generate the BLE packets. This option has higher
            overhead at runtime.

    config EXAMPLE_CI_ID
        int
        default 70
        help
            This config the example id for CI test. Only for internal used.

    config EXAMPLE_CI_PIPELINE_ID
        int "The pipeline id for CI test"
        default 0
        help
            This config the pipeline id for CI test. Only for internal used.

endmenu
```

## examples/bluetooth/bluedroid/ble/gatt_server/sdkconfig.defaults.esp32c2
```kconfig
# Override some defaults so BT stack is enabled
# by default in this example
CONFIG_IDF_TARGET="esp32c2"
CONFIG_BT_ENABLED=y
# CONFIG_BT_BLE_50_FEATURES_SUPPORTED is not set
CONFIG_BT_BLE_42_FEATURES_SUPPORTED=y
# CONFIG_BT_LE_50_FEATURE_SUPPORT is not set
CONFIG_BT_LE_HCI_EVT_BUF_SIZE=257
# XTAL Freq Config
CONFIG_XTAL_FREQ_26=y
CONFIG_XTAL_FREQ=26
```

## examples/bluetooth/bluedroid/ble/gatt_server/sdkconfig.defaults.esp32h4
```kconfig
# Override some defaults so BT stack is enabled
# by default in this example
CONFIG_PARTITION_TABLE_SINGLE_APP_LARGE=y
```

## examples/bluetooth/bluedroid/ble/gatt_server_service_table/sdkconfig.defaults
```kconfig
# Defaults for generating a new "sdkconfig" file (project settings).
# https://docs.espressif.com/projects/esp-idf/en/latest/esp32/api-guides/build-system.html#custom-sdkconfig-defaults
#
# NOTE - if this file changes, to get new defaults, you must erase any existing
# "sdkconfig" file (this will undo manual settings from "idf.py menuconfig").

# Override some defaults so BT stack is enabled
# in this example

#
# BT config
#
CONFIG_BT_ENABLED=y
CONFIG_BTDM_CTRL_MODE_BLE_ONLY=y
CONFIG_BTDM_CTRL_MODE_BR_EDR_ONLY=n
CONFIG_BTDM_CTRL_MODE_BTDM=n

#
# ESP32-specific config
#
CONFIG_ESP32_ENABLE_STACK_BT=y
# CONFIG_ESP32_ENABLE_STACK_NONE is not set
CONFIG_MEMMAP_BT=y
```

## examples/bluetooth/bluedroid/ble_50/ble50_dual_identity_server/sdkconfig.defaults
```kconfig
CONFIG_BT_ENABLED=y
CONFIG_BT_BLE_50_FEATURES_SUPPORTED=y
CONFIG_BT_BLE_42_FEATURES_SUPPORTED=n
CONFIG_BT_BLE_SMP_ENABLE=y
CONFIG_BT_BLE_PERIPH_PSEUDO_ADDR_BOND=y
CONFIG_BT_ACL_CONNECTIONS=2
CONFIG_BT_GATTS_ENABLE=y
# CONFIG_BT_GATTC_ENABLE is not set
# CONFIG_BT_BLE_50_DTM_TEST_EN is not set
# CONFIG_BT_BLE_50_PERIODIC_ADV_EN is not set
# CONFIG_BT_BLE_50_EXTEND_SCAN_EN is not set
```
