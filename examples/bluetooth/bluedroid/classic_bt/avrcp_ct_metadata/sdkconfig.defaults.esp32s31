## examples/bluetooth/bluedroid/classic_bt/avrcp_ct_metadata/sdkconfig.defaults.esp32s31
```kconfig
CONFIG_PARTITION_TABLE_SINGLE_APP_LARGE=y
CONFIG_EXAMPLE_A2DP_SINK_OUTPUT_IDLE=y
```

## examples/bluetooth/bluedroid/classic_bt/bt_discovery/sdkconfig.defaults
```kconfig
# Defaults for generating a new "sdkconfig" file (project settings).
# https://docs.espressif.com/projects/esp-idf/en/latest/esp32/api-guides/build-system.html#custom-sdkconfig-defaults
#
# NOTE - if this file changes, to get new defaults, you must erase any existing
# "sdkconfig" file (this will undo manual settings from "idf.py menuconfig").

# Enable Classic BT and disable BLE
CONFIG_BT_ENABLED=y
CONFIG_BTDM_CTRL_MODE_BR_EDR_ONLY=y
CONFIG_BT_CLASSIC_ENABLED=y
CONFIG_BT_BLE_ENABLED=n
```

## examples/bluetooth/bluedroid/classic_bt/bt_hid_mouse_device/sdkconfig.defaults
```kconfig
CONFIG_BT_ENABLED=y
CONFIG_BTDM_CTRL_MODE_BLE_ONLY=n
CONFIG_BTDM_CTRL_MODE_BR_EDR_ONLY=y
CONFIG_BTDM_CTRL_MODE_BTDM=n
CONFIG_BT_CLASSIC_ENABLED=y
CONFIG_BT_HID_ENABLED=y
CONFIG_BT_HID_DEVICE_ENABLED=y
```

## examples/bluetooth/bluedroid/classic_bt/bt_l2cap_client/main/Kconfig.projbuild
```kconfig
menu "L2CAP Example Configuration"
    config EXAMPLE_SSP_ENABLED
        bool "Secure Simple Pairing"
        depends on BT_CLASSIC_ENABLED
        default y
        help
            This enables the Secure Simple Pairing. If disable this option,
            Bluedroid will only support Legacy Pairing

    config EXAMPLE_PEER_DEVICE_NAME
        string "Target Device Name"
        default "ESP_BT_L2CAP_SERVER"
        help
            Use this option to set target device name to connect.
endmenu
```

## examples/bluetooth/bluedroid/classic_bt/bt_l2cap_client/sdkconfig.defaults
```kconfig
# Override some defaults so BT stack is enabled and
# Classic BT is enabled
CONFIG_BT_ENABLED=y
CONFIG_BTDM_CTRL_MODE_BLE_ONLY=n
CONFIG_BTDM_CTRL_MODE_BR_EDR_ONLY=y
CONFIG_BTDM_CTRL_MODE_BTDM=n
CONFIG_BT_BLUEDROID_ENABLED=y
CONFIG_BT_CLASSIC_ENABLED=y
CONFIG_BT_L2CAP_ENABLED=y
```

## examples/bluetooth/bluedroid/classic_bt/bt_l2cap_server/main/Kconfig.projbuild
```kconfig
menu "L2CAP Example Configuration"
    config EXAMPLE_SSP_ENABLED
        bool "Secure Simple Pairing"
        depends on BT_CLASSIC_ENABLED
        default y
        help
            This enables the Secure Simple Pairing. If disable this option,
            Bluedroid will only support Legacy Pairing

    config EXAMPLE_LOCAL_DEVICE_NAME
        string "Local Device Name"
        default "ESP_BT_L2CAP_SERVER"
        help
            Use this option to set local device name.
endmenu
```

## examples/bluetooth/bluedroid/classic_bt/bt_l2cap_server/sdkconfig.defaults
```kconfig
# Defaults for generating a new "sdkconfig" file (project settings).
# https://docs.espressif.com/projects/esp-idf/en/latest/esp32/api-guides/build-system.html#custom-sdkconfig-defaults
#
# NOTE - if this file changes, to get new defaults, you must erase any existing
# "sdkconfig" file (this will undo manual settings from "idf.py menuconfig").

# Override some defaults so BT stack is enabled and
# Classic BT is enabled
CONFIG_BT_ENABLED=y
CONFIG_BTDM_CTRL_MODE_BLE_ONLY=n
CONFIG_BTDM_CTRL_MODE_BR_EDR_ONLY=y
CONFIG_BTDM_CTRL_MODE_BTDM=n
CONFIG_BT_BLUEDROID_ENABLED=y
CONFIG_BT_CLASSIC_ENABLED=y
CONFIG_BT_L2CAP_ENABLED=y
```

## examples/bluetooth/bluedroid/classic_bt/bt_spp_acceptor/sdkconfig.defaults
```kconfig
# Override some defaults so BT stack is enabled
CONFIG_BT_ENABLED=y
CONFIG_BTDM_CTRL_MODE_BLE_ONLY=n
CONFIG_BTDM_CTRL_MODE_BR_EDR_ONLY=y
CONFIG_BTDM_CTRL_MODE_BTDM=n
CONFIG_BT_CLASSIC_ENABLED=y
CONFIG_BT_SPP_ENABLED=y
CONFIG_BT_BLE_ENABLED=n
```

## examples/bluetooth/bluedroid/classic_bt/bt_spp_vfs_initiator/sdkconfig.defaults
```kconfig
# Override some defaults so BT stack is enabled
# and WiFi disabled by default in this example
CONFIG_BT_ENABLED=y
CONFIG_BTDM_CTRL_MODE_BLE_ONLY=n
CONFIG_BTDM_CTRL_MODE_BR_EDR_ONLY=y
CONFIG_BTDM_CTRL_MODE_BTDM=n
CONFIG_BT_CLASSIC_ENABLED=y
CONFIG_WIFI_ENABLED=n
CONFIG_BT_SPP_ENABLED=y
CONFIG_BT_BLE_ENABLED=n
```

## examples/bluetooth/bluedroid/classic_bt/common/avrcp_utils/avrcp_cover_art_utils/Kconfig.projbuild
```kconfig
menu "AVRCP Cover Art Example Configuration"
    config EXAMPLE_LCD_FLUSH_PARALLEL_LINES
        int "LCD flush parallel lines"
        default 16
        help
            To speed up transfers, every SPI transfer sends a bunch of lines.

endmenu
```

## examples/bluetooth/bluedroid/classic_bt/hfp_ag/main/Kconfig.projbuild
```kconfig
menu "HFP Example Configuration"
    config EXAMPLE_LOCAL_DEVICE_NAME
        string "Local Device Name"
        default "ESP_HFP_AG"
        help
            Use this option to set local device name.

    config EXAMPLE_ENABLE_CONSOLE_REPL
        bool "Enable UART interactive console (REPL)"
        default y
        help
            Enable UART interactive console (REPL)

    config EXAMPLE_HFP_PCM_GPIO_SUPPORTED
        bool
        default y if IDF_TARGET_ESP32
        default n
        help
            HFP PCM GPIO signal routing is only available on ESP32.
            ESP32-S31 currently supports HCI SCO data path only.

endmenu
```

## examples/bluetooth/bluedroid/classic_bt/hfp_ag/sdkconfig.defaults.esp32s31
```kconfig
CONFIG_PARTITION_TABLE_SINGLE_APP_LARGE=y
CONFIG_BT_CTRL_BR_EDR_MAX_SYNC_CONN=1
CONFIG_BT_HFP_AUDIO_DATA_PATH_HCI=y
```

## examples/bluetooth/bluedroid/classic_bt/hfp_hf/main/Kconfig.projbuild
```kconfig
menu "HFP Example Configuration"
    config EXAMPLE_SSP_ENABLED
        bool "Secure Simple Pairing"
        depends on BT_CLASSIC_ENABLED
        default y
        help
            This enables the Secure Simple Pairing. If disable this option,
            Bluedroid will only support Legacy Pairing

    config EXAMPLE_PEER_DEVICE_NAME
        string "Target Device Name"
        default "ESP_HFP_AG"
        help
            Use this option to set target device name to connect.

    config EXAMPLE_ENABLE_CONSOLE_REPL
        bool "Enable UART interactive console (REPL)"
        default y
        help
            Enable UART interactive console (REPL)

    config EXAMPLE_HFP_PCM_GPIO_SUPPORTED
        bool
        default y if IDF_TARGET_ESP32
        default n
        help
            HFP PCM GPIO signal routing is only available on ESP32.
            ESP32-S31 currently supports HCI SCO data path only.

endmenu
```

## examples/bluetooth/bluedroid/classic_bt/hfp_hf/sdkconfig.defaults
```kconfig
# Defaults for generating a new "sdkconfig" file (project settings).
# https://docs.espressif.com/projects/esp-idf/en/latest/esp32/api-guides/build-system.html#custom-sdkconfig-defaults
#
# NOTE - if this file changes, to get new defaults, you must erase any existing
# "sdkconfig" file (this will undo manual settings from "idf.py menuconfig").

# Override some defaults so BT stack is enabled and
# Classic BT is enabled and BT_DRAM_RELEASE is disabled
CONFIG_BT_ENABLED=y
CONFIG_BT_BLE_ENABLED=n
CONFIG_BTDM_CTRL_MODE_BR_EDR_ONLY=y
CONFIG_BT_BLUEDROID_ENABLED=y
CONFIG_BT_CLASSIC_ENABLED=y
CONFIG_BT_HFP_ENABLE=y
CONFIG_BT_HFP_CLIENT_ENABLE=y
```

## examples/bluetooth/bluedroid/coex/a2dp_gatts_coex/main/Kconfig.projbuild
```kconfig
menu "A2DP Example Configuration"

    choice EXAMPLE_A2DP_SINK_OUTPUT
        prompt "A2DP Sink Output"
        default EXAMPLE_A2DP_SINK_OUTPUT_EXTERNAL_I2S
        help
            Select to use Internal DAC or external I2S driver

        config EXAMPLE_A2DP_SINK_OUTPUT_INTERNAL_DAC
            bool "Internal DAC"
            help
                Select this to use Internal DAC sink output

        config EXAMPLE_A2DP_SINK_OUTPUT_EXTERNAL_I2S
            bool "External I2S Codec"
            help
                Select this to use External I2S sink output

    endchoice

    config EXAMPLE_I2S_LRCK_PIN
        int "I2S LRCK (WS) GPIO"
        default 22
        depends on EXAMPLE_A2DP_SINK_OUTPUT_EXTERNAL_I2S
        help
            GPIO number to use for I2S LRCK(WS) Driver.

    config EXAMPLE_I2S_BCK_PIN
        int "I2S BCK GPIO"
        default 26
        depends on EXAMPLE_A2DP_SINK_OUTPUT_EXTERNAL_I2S
        help
            GPIO number to use for I2S BCK Driver.

    config EXAMPLE_I2S_DATA_PIN
        int "I2S DATA GPIO"
        default 25
        depends on EXAMPLE_A2DP_SINK_OUTPUT_EXTERNAL_I2S
        help
            GPIO number to use for I2S Data Driver.

endmenu
```

## examples/bluetooth/bluedroid/coex/a2dp_gatts_coex/sdkconfig.defaults
```kconfig
CONFIG_BT_ENABLED=y
CONFIG_BT_CLASSIC_ENABLED=y
CONFIG_BT_A2DP_ENABLE=y
CONFIG_BT_GATTC_ENABLE=n
CONFIG_BT_BLE_SMP_ENABLE=n
CONFIG_BT_BLE_50_FEATURES_SUPPORTED=n
CONFIG_BT_BLE_42_FEATURES_SUPPORTED=y
CONFIG_BTDM_CTRL_MODE_BTDM=y
```

## examples/bluetooth/bluedroid/coex/a2dp_gatts_coex/sdkconfig.defaults.esp32s31
```kconfig
CONFIG_PARTITION_TABLE_CUSTOM=y
CONFIG_ESPTOOLPY_FLASHSIZE_4MB=y
CONFIG_EXAMPLE_A2DP_SINK_OUTPUT_IDLE=y
```

## examples/bluetooth/blufi/main/Kconfig.projbuild
```kconfig
menu "Example Configuration"

    config EXAMPLE_WIFI_CONNECTION_MAXIMUM_RETRY
        int "WiFi connection maximum retry"
        range 0 255
        default 2
        help
            WiFi connection maximum retry, from 0 to 255.

    choice EXAMPLE_WIFI_SCAN_AUTH_MODE_THRESHOLD
        prompt "WiFi Scan auth mode threshold"
        default ESP_WIFI_AUTH_WPA2_PSK
        help
            The weakest authmode to accept in the scan mode.
            This value defaults to ESP_WIFI_AUTH_WPA2_PSK in case password is present and ESP_WIFI_AUTH_OPEN is used.
            Please select ESP_WIFI_AUTH_WEP/ESP_WIFI_AUTH_WPA_PSK in case AP is operating in WEP/WPA mode.

        config ESP_WIFI_AUTH_OPEN
            bool "OPEN"
        config ESP_WIFI_AUTH_WEP
            bool "WEP"
        config ESP_WIFI_AUTH_WPA_PSK
            bool "WPA PSK"
        config ESP_WIFI_AUTH_WPA2_PSK
            bool "WPA2 PSK"
        config ESP_WIFI_AUTH_WPA_WPA2_PSK
            bool "WPA/WPA2 PSK"
        config ESP_WIFI_AUTH_WPA3_PSK
            bool "WPA3 PSK"
        config ESP_WIFI_AUTH_WPA2_WPA3_PSK
            bool "WPA2/WPA3 PSK"
        config ESP_WIFI_AUTH_WAPI_PSK
            bool "WAPI PSK"
    endchoice

    config EXAMPLE_BLUFI_BLE_SMP_ENABLE
        bool "Enable BLE SMP support in BLUFI"
        depends on BT_BLUEDROID_ENABLED
        select BT_BLUFI_BLE_SMP_ENABLE
        select BT_BLE_SMP_ENABLE
        default n
        help
            Enable BLE Security Manager Protocol (SMP) for BLUFI.
            Currently, this feature is only supported with the Bluedroid host.

            If enabled:
            - BLUFI will configure SMP security parameters such as
            IO capabilities, authentication mode, and key size.
            - After a BLE connection is established, BLUFI will
            proactively initiate a security request.
            - Only after the BLE pairing is successfully completed,
            BLUFI can proceed with Wi-Fi provisioning.
            - If the user rejects pairing or inputs an incorrect passkey,
            BLUFI will not start Wi-Fi provisioning.
endmenu
```

## examples/bluetooth/blufi/sdkconfig.defaults
```kconfig
# Override some defaults so BT stack is enabled
# in this example

#
# Partition Table
# (It's possible to fit Blufi in 1MB app partition size with some other optimizations, but
# default config is close to 1MB.)
CONFIG_PARTITION_TABLE_SINGLE_APP_LARGE=y

#
# BT config
#
CONFIG_BT_ENABLED=y
CONFIG_BT_GATTC_ENABLE=n
CONFIG_BT_BLE_SMP_ENABLE=n
CONFIG_BT_BLE_BLUFI_ENABLE=y
CONFIG_MBEDTLS_HARDWARE_MPI=n
# CONFIG_BT_BLE_42_DTM_TEST_EN is not set
# CONFIG_BT_BLE_42_SCAN_EN is not set
# CONFIG_BT_BLE_50_FEATURES_SUPPORTED is not set
```

## examples/bluetooth/bt_discovery/sdkconfig.defaults
```kconfig
# Override some defaults so BT stack is enabled and
# Classic BT is enabled and BT_DRAM_RELEASE is disabled
CONFIG_BT_ENABLED=y
CONFIG_CLASSIC_BT_ENABLED=y
CONFIG_A2DP_ENABLE=n
CONFIG_GATTS_ENABLE=n
CONFIG_GATTC_ENABLE=n
CONFIG_BLE_SMP_ENABLE=n
```

## examples/bluetooth/bt_spp_vfs_initiator/sdkconfig.defaults
```kconfig
# Override some defaults so BT stack is enabled
# and WiFi disabled by default in this example
CONFIG_BT_ENABLED=y
CONFIG_CLASSIC_BT_ENABLED=y
CONFIG_WIFI_ENABLED=n
CONFIG_BT_SPP_ENABLED=y
```

## examples/bluetooth/common/ble_uart/Kconfig
```kconfig
menu "BLE UART library"

    config BLE_UART_DEVICE_NAME_PREFIX
        string "BLE device name prefix"
        default "BleUart"
        help
            Default prefix for examples that advertise as `<prefix>-XXXX`
            where XXXX is the last two bytes of the BT MAC in hex.
            Application code may ignore this and set an explicit name in
            ble_uart_config_t.

    config BLE_UART_RX_SCRATCH_SIZE
        int "RX scratch buffer size (bytes)"
        range 64 16384
        default 1024
        help
            Upper bound on a single RX payload delivered to
            ble_uart_on_rx(). Covers both plain writes (MTU - 3 bytes)
            and reassembled long writes (PREP + EXEC). Oversized writes
            are rejected with ATT error 0x0D.

            The buffer lives in BSS, so this value directly translates
            into RAM cost. Bump it if your protocol sends larger frames
            in one shot; with the NimBLE backend, raising past ~10 KB
            may also require increasing
            CONFIG_BT_NIMBLE_MSYS_1_BLOCK_COUNT.

endmenu
```

## examples/bluetooth/controller_hci_uart/sdkconfig.defaults
```kconfig
# Override some defaults so BT stack is enabled
# in this example

#
# BT config
#
CONFIG_BT_ENABLED=y
CONFIG_BTDM_CONTROLLER_MODE_BLE_ONLY=
CONFIG_BTDM_CONTROLLER_MODE_BR_EDR_ONLY=
CONFIG_BTDM_CONTROLLER_MODE_BTDM=y
CONFIG_BTDM_CONTROLLER_BLE_MAX_CONN=9
CONFIG_BTDM_CONTROLLER_BR_EDR_MAX_ACL_CONN=7
CONFIG_BTDM_CONTROLLER_BR_EDR_MAX_SYNC_CONN=3
CONFIG_BLUEDROID_ENABLED=n
CONFIG_BT_HCI_UART=y
CONFIG_BT_HCI_UART_NO_DEFAULT=1
CONFIG_BT_HCI_UART_BAUDRATE_DEFAULT=921600
```

## examples/bluetooth/esp_ble_audio/bap/broadcast_assistant/sdkconfig.defaults.esp32h4
```kconfig
# Override some defaults so BT stack is enabled
# by default in this example

CONFIG_IDF_TARGET="esp32h4"

CONFIG_BT_LE_ISO_SUPPORT=y
```
