## examples/bluetooth/esp_ble_audio/cap/acceptor/main/Kconfig.projbuild
```kconfig
# SPDX-FileCopyrightText: 2022 Nordic Semiconductor ASA
# SPDX-FileContributor: 2026 Espressif Systems (Shanghai) CO LTD
# SPDX-License-Identifier: Apache-2.0

menu "Example: CAP Acceptor"

    config EXAMPLE_UNICAST
        bool "Unicast"
        default y
        help
            If set, advertise as a Unicast acceptor (ASCS) for unicast audio.

    config EXAMPLE_BROADCAST
        bool "Broadcast"
        default y if !EXAMPLE_UNICAST
        select BT_NIMBLE_PERIODIC_ADV_SYNC_TRANSFER
        help
            If set, advertise as a Broadcast acceptor (BASS Scan Delegator)
            for syncable broadcast audio. Can coexist with EXAMPLE_UNICAST
            for a dual-role CAP Acceptor (BAP spec C.2 allows both).

    config EXAMPLE_SCAN_SELF
        bool "Scan for Broadcast Sources without Broadcast Assistant"
        # !EXAMPLE_UNICAST: dual-role + self-scan coexistence not supported yet.
        depends on EXAMPLE_BROADCAST && !EXAMPLE_UNICAST
        help
            If set, the sample will start scanning for Broadcast Sources
            without waiting for a Broadcast Assistant to connect.

endmenu
```

## examples/bluetooth/esp_ble_audio/cap/initiator/main/Kconfig.projbuild
```kconfig
# SPDX-FileCopyrightText: 2022 Nordic Semiconductor ASA
# SPDX-FileContributor: 2026 Espressif Systems (Shanghai) CO LTD
# SPDX-License-Identifier: Apache-2.0

menu "Example: CAP Initiator"

    choice EXAMPLE_CAP_INITIATOR_MODE
        prompt "CAP Initiator mode"
        default EXAMPLE_UNICAST
        help
            Select exactly one CAP initiator mode.

        config EXAMPLE_UNICAST
            bool "Unicast"
            help
                If selected, the sample will start advertising connectable
                for Broadcast Assistants.

        config EXAMPLE_BROADCAST
            bool "Broadcast"
            help
                If selected, the sample will start advertising syncable
                audio streams.

    endchoice

endmenu
```

## examples/bluetooth/esp_ble_mesh/aligenie_demo/main/Kconfig.projbuild
```kconfig
menu "AliGenie Example Configuration"

    menu "AliGenie Triples Configuration"

        config TRIPLES_PRODUCT_ID
            int "Product ID"
            default 0

        config TRIPLES_DEVICE_NAME
            string "Device Name"
            default "Device Name"
            help
                Please use lower case

        config TRIPLES_DEVICE_SECRET
            string "Device Secret"
            default "Device Secret"
            help
                Please use lower case

    endmenu

    menu "light driver config"
        config LIGHT_GPIO_RED
            int "Light red pin GPIO number"
            range -1 48 if IDF_TARGET_ESP32S3
            range -1 33
            default 25
            help
                There are more enumerations like that
                up to GPIO39, excluding GPIO20, GPIO24 and GPIO28..31.
                They are not shown here to reduce redundant information.
                @note GPIO34..39 are input mode only.

        config LIGHT_GPIO_GREEN
            int "Light green pin GPIO number"
            range -1 48 if IDF_TARGET_ESP32S3
            range -1 33
            default 26
            help
                There are more enumerations like that
                up to GPIO39, excluding GPIO20, GPIO24 and GPIO28..31.
                They are not shown here to reduce redundant information.
                @note GPIO34..39 are input mode only.

        config LIGHT_GPIO_BLUE
            int "Light blue pin GPIO number"
            range -1 48 if IDF_TARGET_ESP32S3
            range -1 33
            default 27
            help
                There are more enumerations like that
                up to GPIO39, excluding GPIO20, GPIO24 and GPIO28..31.
                They are not shown here to reduce redundant information.
                @note GPIO34..39 are input mode only.

        config LIGHT_GPIO_COLD
            int "Light cold colors pin GPIO number"
            range -1 48 if IDF_TARGET_ESP32S3
            range -1 33
            default -1
            help
                There are more enumerations like that
                up to GPIO39, excluding GPIO20, GPIO24 and GPIO28..31.
                They are not shown here to reduce redundant information.
                @note GPIO34..39 are input mode only.

        config LIGHT_GPIO_WARM
            int "Light warm color pin GPIO number"
            range -1 48 if IDF_TARGET_ESP32S3
            range -1 33
            default -1
            help
                There are more enumerations like that
                up to GPIO39, excluding GPIO20, GPIO24 and GPIO28..31.
                They are not shown here to reduce redundant information.
                @note GPIO34..39 are input mode only.

        config LIGHT_FADE_PERIOD_MS
            int "The time from the current color to the next color"
            default 500
            help
                The time from the current color to the next color.

        config LIGHT_BLINK_PERIOD_MS
            int "Period of blinking lights"
            default 2000
            help
                Period of blinking lights.

    endmenu

endmenu
```

## examples/bluetooth/esp_ble_mesh/aligenie_demo/sdkconfig.defaults
```kconfig
# Override some defaults so BT stack is enabled
# by default in this example
CONFIG_BT_ENABLED=y
CONFIG_BT_GATTS_SEND_SERVICE_CHANGE_MANUAL=y
CONFIG_BT_BTU_TASK_STACK_SIZE=4512

#
# Partition Table
#
CONFIG_PARTITION_TABLE_CUSTOM=y
CONFIG_PARTITION_TABLE_CUSTOM_FILENAME="partitions.csv"

#
# Serial flasher config
#
CONFIG_ESPTOOLPY_FLASHSIZE_4MB=y
CONFIG_ESPTOOLPY_FLASHFREQ_80M=y

# Override some defaults of ESP BLE Mesh
CONFIG_BLE_MESH=y
CONFIG_BLE_MESH_NODE=y
CONFIG_BLE_MESH_PB_GATT=y
CONFIG_BLE_MESH_TX_SEG_MSG_COUNT=10
CONFIG_BLE_MESH_RX_SEG_MSG_COUNT=10
CONFIG_BLE_MESH_SETTINGS=y
CONFIG_BLE_MESH_SUBNET_COUNT=5
CONFIG_BLE_MESH_APP_KEY_COUNT=5
CONFIG_BLE_MESH_MODEL_KEY_COUNT=5
CONFIG_BLE_MESH_MODEL_GROUP_COUNT=5
CONFIG_BLE_MESH_MSG_CACHE_SIZE=20
CONFIG_BLE_MESH_ADV_BUF_COUNT=256

#
# light driver config
#
CONFIG_PWM_ENABLE_HW_FADE=n
# end of light driver config
```

## examples/bluetooth/esp_ble_mesh/aligenie_demo/sdkconfig.defaults.esp32c3
```kconfig
# Override some defaults so BT stack is enabled
# by default in this example
CONFIG_IDF_TARGET="esp32c3"
CONFIG_BT_CTRL_SCAN_DUPL_TYPE_DATA_DEVICE=y
CONFIG_BT_CTRL_BLE_MESH_SCAN_DUPL_EN=y
CONFIG_BT_BLE_42_FEATURES_SUPPORTED=y
CONFIG_BT_BLE_50_FEATURES_SUPPORTED=n

#
# light driver config
#
CONFIG_LIGHT_GPIO_RED=4
CONFIG_LIGHT_GPIO_GREEN=5
CONFIG_LIGHT_GPIO_BLUE=6
CONFIG_LIGHT_GPIO_COLD=7
CONFIG_LIGHT_GPIO_WARM=10
# end of light driver config
```

## examples/bluetooth/esp_ble_mesh/aligenie_demo/sdkconfig.defaults.esp32h2
```kconfig
# Override some defaults so BT stack is enabled
# by default in this example
CONFIG_BT_ENABLED=y
CONFIG_BT_LE_SCAN_DUPL_TYPE_DATA_DEVICE=y
CONFIG_BT_GATTS_SEND_SERVICE_CHANGE_MANUAL=y
CONFIG_BT_BTU_TASK_STACK_SIZE=4512
CONFIG_BT_BLE_42_FEATURES_SUPPORTED=y
CONFIG_BT_BLE_50_FEATURES_SUPPORTED=n
CONFIG_BT_LE_50_FEATURE_SUPPORT=n

#
# light driver config
#
CONFIG_LIGHT_GPIO_RED=4
CONFIG_LIGHT_GPIO_GREEN=5
CONFIG_LIGHT_GPIO_BLUE=11
CONFIG_LIGHT_GPIO_COLD=12
CONFIG_LIGHT_GPIO_WARM=10
# end of light driver config
```

## examples/bluetooth/esp_ble_mesh/aligenie_demo/sdkconfig.defaults.esp32s3
```kconfig
# Override some defaults so BT stack is enabled
# by default in this example
CONFIG_IDF_TARGET="esp32s3"
CONFIG_BT_CTRL_SCAN_DUPL_TYPE_DATA_DEVICE=y
CONFIG_BT_CTRL_BLE_MESH_SCAN_DUPL_EN=y
CONFIG_BT_BLE_42_FEATURES_SUPPORTED=y
CONFIG_BT_BLE_50_FEATURES_SUPPORTED=n

#
# light driver config
#
CONFIG_LIGHT_GPIO_RED=14
CONFIG_LIGHT_GPIO_GREEN=13
CONFIG_LIGHT_GPIO_BLUE=12
CONFIG_LIGHT_GPIO_COLD=11
CONFIG_LIGHT_GPIO_WARM=10
# end of light driver config
```

## examples/bluetooth/esp_ble_mesh/ble_mesh_client_model/sdkconfig.defaults
```kconfig
# Override some defaults so BT stack is enabled
# by default in this example
CONFIG_BT_ENABLED=y
CONFIG_BTDM_CONTROLLER_MODE_BLE_ONLY=y
CONFIG_BTDM_CONTROLLER_MODE_BR_EDR_ONLY=
CONFIG_BTDM_CONTROLLER_MODE_BTDM=
CONFIG_BTDM_CONTROLLER_MODEM_SLEEP=n
CONFIG_BLE_SCAN_DUPLICATE=y
CONFIG_SCAN_DUPLICATE_TYPE=2
CONFIG_SCAN_DUPLICATE_BY_ADV_DATA_AND_DEVICE_ADDR=y
CONFIG_DUPLICATE_SCAN_CACHE_SIZE=200
CONFIG_BLE_MESH_SCAN_DUPLICATE_EN=y
CONFIG_MESH_DUPLICATE_SCAN_CACHE_SIZE=200
CONFIG_BTDM_CONTROLLER_FULL_SCAN_SUPPORTED=y
CONFIG_BLE_ADV_REPORT_FLOW_CONTROL_SUPPORTED=n
CONFIG_GATTS_ENABLE=y
CONFIG_GATTS_SEND_SERVICE_CHANGE_MANUAL=y
CONFIG_BLE_MESH=y
CONFIG_BLE_MESH_HCI_5_0=y
CONFIG_BLE_MESH_USE_DUPLICATE_SCAN=y
CONFIG_BLE_MESH_NODE=y
CONFIG_BLE_MESH_PROV=y
CONFIG_BLE_MESH_NET_BUF_POOL_USAGE=y
CONFIG_BLE_MESH_PROXY=y
CONFIG_BLE_MESH_PB_GATT=y
CONFIG_BLE_MESH_GATT_PROXY=y
CONFIG_BLE_MESH_NODE_ID_TIMEOUT=60
CONFIG_BLE_MESH_PROXY_FILTER_SIZE=1
CONFIG_BLE_MESH_IV_UPDATE_TEST=
CONFIG_BLE_MESH_SUBNET_COUNT=1
CONFIG_BLE_MESH_APP_KEY_COUNT=1
CONFIG_BLE_MESH_MODEL_KEY_COUNT=1
CONFIG_BLE_MESH_MODEL_GROUP_COUNT=1
CONFIG_BLE_MESH_LABEL_COUNT=1
CONFIG_BLE_MESH_CRPL=10
CONFIG_BLE_MESH_MSG_CACHE_SIZE=10
CONFIG_BLE_MESH_ADV_BUF_COUNT=60
CONFIG_BLE_MESH_TX_SEG_MSG_COUNT=6
CONFIG_BLE_MESH_RX_SEG_MSG_COUNT=1
CONFIG_BLE_MESH_RX_SDU_MAX=384
CONFIG_BLE_MESH_TX_SEG_MAX=32
CONFIG_BLE_MESH_RELAY=y
CONFIG_BLE_MESH_LOW_POWER=
CONFIG_BLE_MESH_FRIEND=
CONFIG_BLE_MESH_CFG_CLI=
CONFIG_BLE_MESH_GENERIC_ONOFF_CLI=y
CONFIG_BTU_TASK_STACK_SIZE=4512
```

## examples/bluetooth/esp_ble_mesh/ble_mesh_coex_test/main/Kconfig.projbuild
```kconfig
menu "Example Configuration"

    choice EXAMPLE_RUN_MODE
        prompt "select run mode"
        help
            select run mode

        config EXAMPLE_AUTO
            bool "auto"
            help
                In automatic mode, the program coordinates three development board work
                through a synchronization mechanism.

        config EXAMPLE_MANAUL
            bool "manual"
            help
                In manual mode, you will work with three development boards via commands.
    endchoice

    config EXAMPLE_WIFI_SSID
        depends on EXAMPLE_MANAUL
        string "WiFi SSID"
        help
            SSID (network name) for the example to connect to. The length cannot exceed 20 bytes.
    config EXAMPLE_WIFI_PASSWORD
        depends on EXAMPLE_MANAUL
        string "WiFi Password"
        help
            WiFi password (WPA or WPA2) for the example to use.
            Can be left blank if the network has no security set.
            The length cannot exceed 20 bytes.

    choice EXAMPLE_SELECT_ROLE
        prompt "select role"
        depends on EXAMPLE_AUTO
        config EXAMPLE_COEX_ROLE
            bool "run device as coex role"
        config EXAMPLE_WIFI_ROLE
            bool "run device as wifi role"
        config EXAMPLE_BT_ROLE
            bool "run device as bluetooth role"
    endchoice

    choice EXAMPLE_SELECT_CASE
        prompt "select case"
        depends on EXAMPLE_COEX_ROLE
        config EXAMPLE_COEX_TX_ADV
            bool "TCP TX and BLE ADV"
        config EXAMPLE_COEX_RX_ADV
            bool "TCP RX and BLE ADV"
        config EXAMPLE_COEX_TX_SCAN
            bool "TCP TX and BLE SCAN"
        config EXAMPLE_COEX_RX_SCAN
            bool "TCP RX and BLE SCAN"
    endchoice

    config EXAMPLE_WIFI_SSID
        depends on EXAMPLE_COEX_ROLE
        string "WiFi SSID"
        help
            SSID (network name) for the example to connect to. The length cannot exceed 20 bytes.
    config EXAMPLE_WIFI_PASSWORD
        depends on EXAMPLE_COEX_ROLE
        string "WiFi Password"
        help
            WiFi password (WPA or WPA2) for the example to use.
            Can be left blank if the network has no security set.
            The length cannot exceed 20 bytes.

endmenu #"Example Configuration End"
```

## examples/bluetooth/esp_ble_mesh/ble_mesh_console/ble_mesh_node/sdkconfig.defaults
```kconfig
# Override some defaults so BT stack is enabled
# by default in this example
CONFIG_BT_ENABLED=y
CONFIG_BTDM_CONTROLLER_MODE_BLE_ONLY=y
CONFIG_BTDM_CONTROLLER_MODE_BR_EDR_ONLY=n
CONFIG_BTDM_CONTROLLER_MODE_BTDM=n
CONFIG_BTDM_CONTROLLER_MODEM_SLEEP=n
CONFIG_SCAN_DUPLICATE_BY_ADV_DATA_AND_DEVICE_ADDR=y
CONFIG_BLE_MESH_SCAN_DUPLICATE_EN=y
CONFIG_GATTS_SEND_SERVICE_CHANGE_MANUAL=y
CONFIG_BTU_TASK_STACK_SIZE=4512

# Override some defaults of ESP BLE Mesh
CONFIG_BLE_MESH=y
CONFIG_BLE_MESH_NODE=y
CONFIG_BLE_MESH_PB_GATT=y
CONFIG_BLE_MESH_TX_SEG_MSG_COUNT=10
CONFIG_BLE_MESH_RX_SEG_MSG_COUNT=10
CONFIG_BLE_MESH_CFG_CLI=y

CONFIG_CONSOLE_UART_BAUDRATE=921600
CONFIG_ESPTOOLPY_BAUD_921600B=y
CONFIG_MONITOR_BAUD_921600B=y
```

## examples/bluetooth/esp_ble_mesh/ble_mesh_console/ble_mesh_provisioner/sdkconfig.defaults
```kconfig
# Override some defaults so BT stack is enabled
# by default in this example
CONFIG_BT_ENABLED=y
CONFIG_BTDM_CTRL_MODE_BLE_ONLY=y
CONFIG_BTDM_CTRL_MODE_BR_EDR_ONLY=n
CONFIG_BTDM_CTRL_MODE_BTDM=n
CONFIG_BTDM_MODEM_SLEEP=n
CONFIG_BTDM_SCAN_DUPL_TYPE_DATA_DEVICE=y
CONFIG_BTDM_BLE_MESH_SCAN_DUPL_EN=y
CONFIG_BT_BTU_TASK_STACK_SIZE=4512

# Override some defaults of ESP BLE Mesh
CONFIG_BLE_MESH=y
CONFIG_BLE_MESH_PROVISIONER=y
CONFIG_BLE_MESH_MAX_PROV_NODES=40
CONFIG_BLE_MESH_PB_GATT=y
CONFIG_BLE_MESH_PBA_SAME_TIME=10
CONFIG_BLE_MESH_PBG_SAME_TIME=3
CONFIG_BLE_MESH_TX_SEG_MSG_COUNT=3
CONFIG_BLE_MESH_RX_SEG_MSG_COUNT=3
CONFIG_BLE_MESH_CFG_CLI=y
CONFIG_BLE_MESH_GENERIC_ONOFF_CLI=y
CONFIG_BLE_MESH_MSG_CACHE_SIZE=60
CONFIG_BLE_MESH_ADV_BUF_COUNT=200
CONFIG_BLE_MESH_CRPL=40
CONFIG_BLE_MESH_SELF_TEST=y
```

## examples/bluetooth/esp_ble_mesh/ble_mesh_console/sdkconfig.defaults
```kconfig
# Override some defaults so BT stack is enabled
# by default in this example
CONFIG_BT_ENABLED=y
CONFIG_BTDM_CTRL_MODE_BLE_ONLY=y
CONFIG_BTDM_CTRL_MODE_BR_EDR_ONLY=n
CONFIG_BTDM_CTRL_MODE_BTDM=n
CONFIG_BTDM_MODEM_SLEEP=n
CONFIG_BTDM_SCAN_DUPL_TYPE_DATA_DEVICE=y
CONFIG_BTDM_BLE_MESH_SCAN_DUPL_EN=y
CONFIG_BT_GATTS_SEND_SERVICE_CHANGE_MANUAL=y
CONFIG_BT_BTU_TASK_STACK_SIZE=4512

# Override some defaults of ESP BLE Mesh
CONFIG_BLE_MESH=y
CONFIG_BLE_MESH_NODE=y
CONFIG_BLE_MESH_PB_GATT=y
CONFIG_BLE_MESH_TX_SEG_MSG_COUNT=3
CONFIG_BLE_MESH_RX_SEG_MSG_COUNT=3
CONFIG_BLE_MESH_CFG_CLI=y
CONFIG_BLE_MESH_GENERIC_ONOFF_CLI=y
CONFIG_BLE_MESH_PROVISIONER=y
CONFIG_BLE_MESH_PROVISIONER_RECV_HB=y
CONFIG_BLE_MESH_PROVISIONER_RECV_HB_FILTER_SIZE=3
CONFIG_BLE_MESH_SELF_TEST=y
CONFIG_BLE_MESH_TEST_AUTO_ENTER_NETWORK=y
CONFIG_BLE_MESH_WAIT_FOR_PROV_MAX_DEV_NUM=80
CONFIG_BLE_MESH_MAX_PROV_NODES=80

# partitions
CONFIG_PARTITION_TABLE_CUSTOM=y
CONFIG_PARTITION_TABLE_FILENAME="partitions.csv"
CONFIG_ESPTOOLPY_FLASHSIZE_4MB=y
CONFIG_ESPTOOLPY_FLASHSIZE="4MB"
```

## examples/bluetooth/esp_ble_mesh/ble_mesh_fast_provision/ble_mesh_fast_prov_client/sdkconfig.defaults
```kconfig
# Override some defaults so BT stack is enabled
# by default in this example
CONFIG_BT_ENABLED=y
CONFIG_BTDM_CONTROLLER_MODE_BLE_ONLY=y
CONFIG_BTDM_CONTROLLER_MODE_BR_EDR_ONLY=
CONFIG_BTDM_CONTROLLER_MODE_BTDM=
CONFIG_BTDM_CONTROLLER_MODEM_SLEEP=n
CONFIG_SCAN_DUPLICATE_BY_ADV_DATA_AND_DEVICE_ADDR=y
CONFIG_BLE_MESH_SCAN_DUPLICATE_EN=y
CONFIG_BTDM_CONTROLLER_FULL_SCAN_SUPPORTED=y
CONFIG_BLUEDROID_ENABLED=y
CONFIG_BLE_SMP_ENABLE=n
CONFIG_BTU_TASK_STACK_SIZE=4512

# Override some defaults of ESP BLE Mesh
CONFIG_BLE_MESH=y
CONFIG_BLE_MESH_PROVISIONER=y
CONFIG_BLE_MESH_PROV=y
CONFIG_BLE_MESH_PBA_SAME_TIME=1
CONFIG_BLE_MESH_PB_GATT=y
CONFIG_BLE_MESH_CRPL=10
CONFIG_BLE_MESH_ADV_BUF_COUNT=100
CONFIG_BLE_MESH_TX_SEG_MSG_COUNT=10
CONFIG_BLE_MESH_RX_SEG_MSG_COUNT=10
CONFIG_BLE_MESH_TX_SEG_MAX=32
CONFIG_BLE_MESH_TRACE_LEVEL_WARNING=y
CONFIG_BLE_MESH_CFG_CLI=y
CONFIG_BLE_MESH_GENERIC_ONOFF_CLI=y
```
