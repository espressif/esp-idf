## examples/bluetooth/esp_ble_iso/common_components/example_utils/Kconfig.projbuild
```kconfig
# SPDX-FileCopyrightText: 2026 Espressif Systems (Shanghai) CO LTD
# SPDX-License-Identifier: Apache-2.0

menu "Example: Common ISO Utilities"

    config EXAMPLE_ISO_TX_TIMESTAMP
        bool "Synchronize multi-channel TX with timestamps"
        depends on BT_ISO_BROADCASTER || BT_ISO_CENTRAL
        default n
        help
            Give the SDUs of all channels of a BIG or CIG the same timestamps,
            based on the controller clock. Each SDU is timestamped with its SDU
            reference time (R0, R1, ...: the CIG reference point or BIG anchor
            point of its event plus k SDU intervals):

              Host                               Controller
                |  every SDU interval, one SDU (CH1): |
                |  SDU 0, 1, ... without timestamp    |
                |------------------------------------>|  on air at R0, R1..
                |  after each, LE Read ISO TX Sync    |
                |<----------------------------------->|  seq, its event's A
                |  ... until SDU j starts an event:   |
                |  Rj = A, Rn = Rj + (n - j)I         |
                |                                     |
                |  every SDU interval, one frame:     |
                |  SDU at Rn on CH1, CH2, ...         |
                |------------------------------------>|  one event for all
                |  CH3 ready: joins at the next frame |
                |                                     |
                |  per SDU: handled at, its ref. time |
                |<------------------------------------|
                |  best lead of 50 SDUs < 200 us:     |
                |  one more frame at the next tick    |
                |------------------------------------>|

            The controller places SDUs without timestamps by sequence number.
            TX Sync gives only the reference point A of an event, shared by its
            SDUs, so the first channel reads it after each SDU until SDUs
            ISO interval / SDU interval - 1 apart show the same A: the first of
            them starts the event and its reference time is A. The read is a
            blocking HCI command (about 2.5 ms), so it comes after the send,
            not to delay it. One TX scheduler for the group then sends one
            frame per SDU interval, one SDU with the same timestamp on each
            channel. The best lead (how long before its reference time an SDU
            is handled) of every 50 SDUs follows the clock difference between
            the timer and the controller: below 200 us one frame is added, above
            two SDU intervals more one is skipped. A stall lowers only some
            SDUs, and the ticks then catch up, so it changes nothing; a best
            lead below minus one SDU interval is a stall or a backlog, and no
            frame is added for it. A channel ready later joins at the next
            frame, so it is as early as the others. TX Sync is not read again:
            the controller places SDUs by their timestamps, on anchors of its
            own clock.

            Supported on BIG broadcaster and CIS central with unframed data.

    config EXAMPLE_ISO_RX_ALIGN_CHECK
        bool "Check on RX that timestamped SDUs share events"
        depends on BT_ISO_SYNC_RECEIVER || BT_ISO_PERIPHERAL
        default n
        help
            For debugging the receiving side of a BIG or CIG whose TX side uses
            "Synchronize multi-channel TX with timestamps", which puts each
            SDU's timestamp, i.e. its frame, in its first 4 bytes. SDUs of one
            SDU reference time share the RX timestamp, so they must be of one
            frame; each SDU is compared with the one before. RX timestamps up to
            100 us apart count as one: each CIS anchor is estimated on its own.

            Every 6000 compared: "RX group: total, aligned, misaligned". The
            first misaligned SDUs are logged.

endmenu
```

## examples/bluetooth/hci/controller_hci_uart/main/Kconfig.projbuild
```kconfig
menu "Example Configuration"

    config EXAMPLE_HCI_CONSOLE
        bool "Enable HCI console REPL"
        default n
        depends on !IDF_TARGET_ESP32
        help
            Start a console REPL on the log UART for example commands such as
            HCI UART pin reconfig.

    config EXAMPLE_BLE_DTM_CONFIGURATION_COMMAND
        bool
        prompt "Enable BLE DTM configuration commands"
        default n
        depends on EXAMPLE_HCI_CONSOLE && BT_ENABLED
        depends on SOC_ESP_NIMBLE_CONTROLLER || IDF_TARGET_ESP32C3 || IDF_TARGET_ESP32S3
        select BT_CTRL_AGC_RECORRECT_EN if (IDF_TARGET_ESP32C3 || IDF_TARGET_ESP32S3)
        select BT_CTRL_CODED_AGC_RECORRECT_EN if (IDF_TARGET_ESP32C3 || IDF_TARGET_ESP32S3)
        select BT_CTRL_HCI_UART_DTM_MODE if BT_CTRL_HCI_UART_INIT_BY_CONTROLLER
        help
            Add the BLE DTM command group to the HCI console.
            On ESP32-C3/S3, HCI UART is configured without flow control for DTM.

    config EXAMPLE_CTE_ANTENNA_GPIO
        bool "Use GPIOs for CTE antenna switching"
        depends on BT_CONTROLLER_ENABLED && SOC_BLE_CTE_SUPPORTED && BT_LE_CTE_FEATURE_ENABLED
        default n
        help
            Initialize antenna selection GPIOs using the same routing as the CTE
            examples. Enable for local antenna switching, such as AoA reception
            or AoD transmission. AoA transmission does not require this option.
            The external host still configures CTE through HCI commands.
            Choose pins that do not conflict with UART, flash, or board peripherals.

    if EXAMPLE_CTE_ANTENNA_GPIO

        config EXAMPLE_ANT_GPIO_BIT_COUNT
            int "Number of GPIO bits for antenna encoding"
            range 1 4
            default 2
            help
                Select the number of GPIO pins used as encoded bits for antenna switching.
                Each additional GPIO bit doubles the number of controllable antennas.
                Example:
                1 bit -> 2 antennas (0, 1)
                2 bits -> 4 antennas (00, 01, 10, 11)
                3 bits -> 8 antennas
                4 bits -> 16 antennas

        config EXAMPLE_ANT_GPIO_0
            int "GPIO Bit 0 (LSB)"
            range 0 39
            default 0
            help
                GPIO pin number for the least significant bit (LSB) of antenna encoding.

        config EXAMPLE_ANT_GPIO_1
            int "GPIO Bit 1"
            range 0 39
            default 1
            depends on EXAMPLE_ANT_GPIO_BIT_COUNT > 1
            help
                GPIO pin number for bit 1 of antenna encoding.

        config EXAMPLE_ANT_GPIO_2
            int "GPIO Bit 2"
            range 0 39
            default 2
            depends on EXAMPLE_ANT_GPIO_BIT_COUNT > 2
            help
                GPIO pin number for bit 2 of antenna encoding.

        config EXAMPLE_ANT_GPIO_3
            int "GPIO Bit 3 (MSB)"
            range 0 39
            default 3
            depends on EXAMPLE_ANT_GPIO_BIT_COUNT > 3
            help
                GPIO pin number for the most significant bit (MSB) of antenna encoding.

    endif # EXAMPLE_CTE_ANTENNA_GPIO

endmenu
```

## examples/bluetooth/hci/controller_hci_uart/sdkconfig.defaults.esp32h4
```kconfig
CONFIG_BT_CTRL_HCI_INTERFACE_USE_UART=y
CONFIG_BT_CTRL_HCI_UART_TX_PIN=8
CONFIG_BT_CTRL_HCI_UART_RX_PIN=9
CONFIG_BT_CTRL_HCI_UART_FLOWCTRL=n
CONFIG_BT_CTRL_HCI_UART_BAUD=115200
```

## examples/bluetooth/nimble/ble_htp/htp_cent/main/Kconfig.projbuild
```kconfig
menu "Example Configuration"

    config EXAMPLE_PEER_ADDR
        string "Peer Address"
        default "ADDR_ANY"
        help
            Enter the peer address in aa:bb:cc:dd:ee:ff form to connect to a specific peripheral

    config EXAMPLE_ENCRYPTION
        bool
        prompt "Enable Link Encryption"
        default y
        help
            This enables bonding and encryption after connection has been established.

    config EXAMPLE_EXTENDED_ADV
        bool
        depends on SOC_BLE_50_SUPPORTED && BT_NIMBLE_50_FEATURE_SUPPORT
        default y if SOC_ESP_NIMBLE_CONTROLLER
        select BT_NIMBLE_EXT_ADV
        prompt "Enable Extended Adv"
        help
            Use this option to enable extended advertising in the example.
            If this option is disabled, ensure config BT_NIMBLE_EXT_ADV is
            also disabled from Nimble stack menuconfig

    config EXAMPLE_CI_ID
        int "example id for CI test"
        default 0
        help
            This config the example id for CI test. Only for internal used.

    config EXAMPLE_CI_PIPELINE_ID
        int "The pipeline id for CI test"
        default 0
        help
            This config the pipeline id for CI test. Only for internal used.

endmenu
```

## examples/bluetooth/nimble/ble_pawr_adv/ble_pawr_adv/main/Kconfig.projbuild
```kconfig
menu "Example Configuration"

    config EXAMPLE_EXTENDED_ADV
        bool
        depends on SOC_BLE_50_SUPPORTED
        default y if SOC_ESP_NIMBLE_CONTROLLER
        select BT_NIMBLE_EXT_ADV
        prompt "Enable Extended Adv"
        help
            Use this option to enable extended advertising in the example.
            If you disable this option, ensure config BT_NIMBLE_EXT_ADV is
            also disabled from Nimble stack menuconfig.

    config EXAMPLE_RANDOM_ADDR
        bool
        prompt "Advertise RANDOM Address"
        help
            Use this option to advertise a random address instead of public address

    config EXAMPLE_PERIODIC_ADV_ENH
        bool
        prompt "Enable Periodic Adv Enhancements"
        depends on SOC_BLE_50_SUPPORTED && SOC_BLE_PERIODIC_ADV_ENH_SUPPORTED
        select BT_NIMBLE_PERIODIC_ADV_ENH
        help
            Use this option to enable periodic advertising enhancements

    config EXAMPLE_CI_ID
        int "example id for CI test"
        default 0
        help
            This config the example id for CI test. Only for internal used.

    config EXAMPLE_CI_PIPELINE_ID
        int "The pipeline id for CI test"
        default 0
        help
            This config the pipeline id for CI test. Only for internal used.
endmenu
```

## examples/bluetooth/nimble/ble_periodic_sync/main/Kconfig.projbuild
```kconfig
menu "Example Configuration"

    config EXAMPLE_PERIODIC_ADV_ENH
        bool
        prompt "Enable Periodic Adv Enhancements"
        depends on SOC_BLE_50_SUPPORTED && SOC_BLE_PERIODIC_ADV_ENH_SUPPORTED
        select BT_NIMBLE_PERIODIC_ADV_ENH
        help
            Use this option to enable periodic adv enhancements

    config EXAMPLE_CI_ID
        int "example id for CI test"
        default 0
        help
            This config the example id for CI test. Only for internal used.

    config EXAMPLE_CI_PIPELINE_ID
        int "The pipeline id for CI test"
        default 0
        help
            This config the pipeline id for CI test. Only for internal used.
endmenu
```

## examples/bluetooth/nimble/ble_phy/phy_cent/main/Kconfig.projbuild
```kconfig
menu "Example Configuration"

    config EXAMPLE_PEER_ADDR
        string "Peer Address"
        default "ADDR_ANY"
        help
            Enter the peer address in aa:bb:cc:dd:ee:ff form to connect to a specific peripheral

    config EXAMPLE_CI_ID
        int "example id for CI test"
        default 0
        help
            This config the example id for CI test. Only for internal used.

    config EXAMPLE_CI_PIPELINE_ID
        int "The pipeline id for CI test"
        default 0
        help
            This config the pipeline id for CI test. Only for internal used.

endmenu
```

## examples/bluetooth/nimble/ble_proximity_sensor/proximity_sensor_prph/main/Kconfig.projbuild
```kconfig
menu "Example Configuration"

    config EXAMPLE_EXTENDED_ADV
        bool
        depends on SOC_BLE_50_SUPPORTED && BT_NIMBLE_50_FEATURE_SUPPORT
        default y if SOC_ESP_NIMBLE_CONTROLLER
        select BT_NIMBLE_EXT_ADV
        prompt "Enable Extended Adv"
        help
            Use this option to enable extended advertising in the example.
            If this option is disabled, ensure config BT_NIMBLE_EXT_ADV is
            also disabled from Nimble stack menuconfig

    config EXAMPLE_CI_ID
        int "Example ID for CI test"
        default 0
        help
            This config sets the example ID for CI test. For internal use only.

    config EXAMPLE_CI_PIPELINE_ID
        int "Pipeline ID for CI test"
        default 0
        help
            This config sets the pipeline ID for CI test. For internal use only.
endmenu
```

## examples/bluetooth/nimble/ble_spi_slave/sdkconfig.defaults
```kconfig
CONFIG_BT_ENABLED=y
CONFIG_BT_BLUEDROID_ENABLED=n
CONFIG_BT_NIMBLE_ENABLED=y
CONFIG_BT_BLE_LOG_SPI_OUT_ENABLED=y
```

## examples/bluetooth/nimble/power_save/sdkconfig.defaults.esp32c2
```kconfig
CONFIG_IDF_TARGET="esp32c2"

# Bluetooth Low Power Config
CONFIG_BT_LE_SLEEP_ENABLE=y
CONFIG_BT_LE_LP_CLK_SRC_DEFAULT=y

# XTAL Freq Config
CONFIG_XTAL_FREQ_26=y
CONFIG_XTAL_FREQ=26

#
# Sleep Config
#
CONFIG_ESP_SLEEP_POWER_DOWN_FLASH=y

# RTC clock source
CONFIG_RTC_CLK_SRC_EXT_OSC=y
```

## examples/bluetooth/nimble/power_save/sdkconfig.defaults.esp32c6
```kconfig
CONFIG_IDF_TARGET="esp32c6"

# Bluetooth Low Power Config
CONFIG_BT_LE_SLEEP_ENABLE=y
CONFIG_BT_LE_LP_CLK_SRC_DEFAULT=y


CONFIG_ESP_MODEM_CLOCK_ENABLE_CHECKING=y

#
# Sleep Config
#
CONFIG_ESP_SLEEP_POWER_DOWN_FLASH=y
CONFIG_ESP_PHY_MAC_BB_PD=y
CONFIG_ESP_PHY_HW_SWITCH_RF=y

# end of Sleep Config

#
# RTC Clock Config
#
CONFIG_RTC_CLK_SRC_EXT_CRYS=y
# end of RTC Clock Config
```

## examples/bluetooth/nimble/power_save/sdkconfig.defaults.esp32h21
```kconfig
CONFIG_IDF_TARGET="esp32h21"

# Bluetooth Low Power Config
CONFIG_BT_LE_SLEEP_ENABLE=y
CONFIG_BT_LE_LP_CLK_SRC_DEFAULT=y

CONFIG_ESP_MODEM_CLOCK_ENABLE_CHECKING=y

#
# RTC Clock Config
#
CONFIG_RTC_CLK_SRC_EXT_CRYS=y
# end of RTC Clock Config
```

## examples/bluetooth/nimble/power_save/sdkconfig.defaults.esp32s31
```kconfig
CONFIG_IDF_TARGET="esp32s31"

# Bluetooth Low Power Config
CONFIG_BT_CTRL_SLEEP_ENABLE=y
CONFIG_BT_CTRL_LP_CLK_SRC_DEFAULT=y
CONFIG_BT_CTRL_SLEEP_RELATED_CODE_IN_IRAM=y
CONFIG_BT_CTRL_LE_ADV_SLEEP_CODE_IN_IRAM=y
CONFIG_BT_CTRL_LE_CONN_SLEEP_CODE_IN_IRAM=y

CONFIG_ESP_MODEM_CLOCK_ENABLE_CHECKING=y
CONFIG_ESP_PHY_HW_SWITCH_RF=y

#
# RTC Clock Config
#
CONFIG_RTC_CLK_SRC_EXT_CRYS=y
# end of RTC Clock Config
```

## examples/bluetooth/nimble/throughput_app/gatt/bleprph_throughput/main/Kconfig.projbuild
```kconfig
menu "Example Configuration"

    config EXAMPLE_CI_ID
        int "example id for CI test"
        default 0

    config EXAMPLE_CI_PIPELINE_ID
        int "Project CI pipeline ID for CI test"
        default 0

    config EXAMPLE_EXTENDED_ADV
        bool
        depends on SOC_BLE_50_SUPPORTED && BT_NIMBLE_50_FEATURE_SUPPORT
        default y if SOC_ESP_NIMBLE_CONTROLLER
        select BT_NIMBLE_EXT_ADV
        prompt "Enable Extended Adv"
        help
            Use this option to enable extended advertising in the example.
            If this option is disabled, ensure config BT_NIMBLE_EXT_ADV is
            also disabled from Nimble stack menuconfig

endmenu
```
