## examples/bluetooth/esp_ble_mesh/ble_mesh_prov_test/ble_mesh_node/sdkconfig.defaults
```kconfig
# Override some defaults so BT stack is enabled
# by default in this example

#
# Bluetooth
#
CONFIG_BT_ENABLED=y

#
# Bluetooth controller
#
CONFIG_BTDM_CONTROLLER_MODE_BLE_ONLY=y
CONFIG_BTDM_CONTROLLER_MODE_BR_EDR_ONLY=
CONFIG_BTDM_CONTROLLER_MODE_BTDM=
CONFIG_BTDM_CONTROLLER_BLE_MAX_CONN=3
CONFIG_BTDM_CTRL_BR_EDR_SCO_DATA_PATH_EFF=0
CONFIG_BTDM_CONTROLLER_BLE_MAX_CONN_EFF=3
CONFIG_BTDM_CONTROLLER_BR_EDR_MAX_ACL_CONN_EFF=0
CONFIG_BTDM_CONTROLLER_BR_EDR_MAX_SYNC_CONN_EFF=0
CONFIG_BTDM_CONTROLLER_PINNED_TO_CORE_0=y
CONFIG_BTDM_CONTROLLER_PINNED_TO_CORE_1=
CONFIG_BTDM_CONTROLLER_PINNED_TO_CORE=0
CONFIG_BTDM_CONTROLLER_HCI_MODE_VHCI=y
CONFIG_BTDM_CONTROLLER_HCI_MODE_UART_H4=

#
# MODEM SLEEP Options
#
CONFIG_BTDM_CONTROLLER_MODEM_SLEEP=
CONFIG_BLE_SCAN_DUPLICATE=y
CONFIG_SCAN_DUPLICATE_BY_DEVICE_ADDR=
CONFIG_SCAN_DUPLICATE_BY_ADV_DATA=
CONFIG_SCAN_DUPLICATE_BY_ADV_DATA_AND_DEVICE_ADDR=y
CONFIG_SCAN_DUPLICATE_TYPE=2
CONFIG_DUPLICATE_SCAN_CACHE_SIZE=200
CONFIG_BLE_MESH_SCAN_DUPLICATE_EN=y
CONFIG_MESH_DUPLICATE_SCAN_CACHE_SIZE=200
CONFIG_BTDM_CONTROLLER_FULL_SCAN_SUPPORTED=y
CONFIG_BLE_ADV_REPORT_FLOW_CONTROL_SUPPORTED=
CONFIG_BTDM_COEX_BT_OPTIONS=
CONFIG_BLUEDROID_ENABLED=y
CONFIG_BLUEDROID_PINNED_TO_CORE_0=y
CONFIG_BLUEDROID_PINNED_TO_CORE_1=
CONFIG_BLUEDROID_PINNED_TO_CORE=0
CONFIG_BTC_TASK_STACK_SIZE=3072
CONFIG_BTU_TASK_STACK_SIZE=4512
CONFIG_BLUEDROID_MEM_DEBUG=
CONFIG_CLASSIC_BT_ENABLED=
CONFIG_GATTS_ENABLE=y
CONFIG_GATTS_SEND_SERVICE_CHANGE_MANUAL=y
CONFIG_GATTS_SEND_SERVICE_CHANGE_AUTO=
CONFIG_GATTS_SEND_SERVICE_CHANGE_MODE=1
CONFIG_GATTC_ENABLE=y
CONFIG_GATTC_CACHE_NVS_FLASH=
CONFIG_BLE_SMP_ENABLE=
CONFIG_BT_STACK_NO_LOG=


# Override some defaults of ESP BLE Mesh
CONFIG_BLE_MESH=y
CONFIG_BLE_MESH_HCI_5_0=y
CONFIG_BLE_MESH_USE_DUPLICATE_SCAN=y
CONFIG_BLE_MESH_FAST_PROV=
CONFIG_BLE_MESH_NODE=y
CONFIG_BLE_MESH_PROVISIONER=
CONFIG_BLE_MESH_PROV=y
CONFIG_BLE_MESH_PB_ADV=y
CONFIG_BLE_MESH_PB_GATT=
CONFIG_BLE_MESH_PROXY=
CONFIG_BLE_MESH_GATT_PROXY_SERVER=
CONFIG_BLE_MESH_GATT_PROXY_CLIENT=
CONFIG_BLE_MESH_NET_BUF_POOL_USAGE=y
CONFIG_BLE_MESH_SETTINGS=
CONFIG_BLE_MESH_SUBNET_COUNT=3
CONFIG_BLE_MESH_APP_KEY_COUNT=3
CONFIG_BLE_MESH_MODEL_KEY_COUNT=3
CONFIG_BLE_MESH_MODEL_GROUP_COUNT=3
CONFIG_BLE_MESH_LABEL_COUNT=3
CONFIG_BLE_MESH_CRPL=10
CONFIG_BLE_MESH_MSG_CACHE_SIZE=10
CONFIG_BLE_MESH_ADV_BUF_COUNT=120
CONFIG_BLE_MESH_IVU_DIVIDER=4
CONFIG_BLE_MESH_TX_SEG_MSG_COUNT=1
CONFIG_BLE_MESH_RX_SEG_MSG_COUNT=10
CONFIG_BLE_MESH_RX_SDU_MAX=384
CONFIG_BLE_MESH_TX_SEG_MAX=32
CONFIG_BLE_MESH_RELAY=
CONFIG_BLE_MESH_LOW_POWER=
CONFIG_BLE_MESH_FRIEND=
CONFIG_BLE_MESH_NO_LOG=
CONFIG_BLE_MESH_CLIENT_MSG_TIMEOUT=400


# Override some defaults of log output
CONFIG_CONSOLE_UART_BAUDRATE=921600
CONFIG_MONITOR_BAUD_921600B=y

#
# Example Configuration
#
CONFIG_BLE_MESH_ESP_WROOM_32=y
CONFIG_BLE_MESH_ESP_WROVER=
CONFIG_BLE_MESH_PATCH_FOR_SLAB_APP_1_1_0=y
CONFIG_BLE_MESH_PROV_TEST=y
```

## examples/bluetooth/esp_ble_mesh/ble_mesh_prov_test/ble_mesh_provisioner/main/Kconfig.projbuild
```kconfig
menu "Example Configuration"

    config BLE_MESH_PROV_TEST
        bool "Temporary Provisioning Test"
        default y
        help
            A temporary option for BLE Mesh provisioning test.

endmenu
```

## examples/bluetooth/esp_ble_mesh/ble_mesh_prov_test/ble_mesh_provisioner/sdkconfig.defaults
```kconfig
# Override some defaults so BT stack is enabled
# by default in this example



#
# Bluetooth
#
CONFIG_BT_ENABLED=y

#
# Bluetooth controller
#
CONFIG_BTDM_CONTROLLER_MODE_BLE_ONLY=
CONFIG_BTDM_CONTROLLER_MODE_BR_EDR_ONLY=
CONFIG_BTDM_CONTROLLER_MODE_BTDM=y
CONFIG_BTDM_CONTROLLER_BLE_MAX_CONN=3
CONFIG_BTDM_CONTROLLER_BR_EDR_MAX_ACL_CONN=2
CONFIG_BTDM_CONTROLLER_BR_EDR_MAX_SYNC_CONN=0
CONFIG_BTDM_CTRL_BR_EDR_SCO_DATA_PATH_EFF=0
CONFIG_BTDM_CONTROLLER_BLE_MAX_CONN_EFF=3
CONFIG_BTDM_CONTROLLER_BR_EDR_MAX_ACL_CONN_EFF=2
CONFIG_BTDM_CONTROLLER_BR_EDR_MAX_SYNC_CONN_EFF=0
CONFIG_BTDM_CONTROLLER_PINNED_TO_CORE_0=y
CONFIG_BTDM_CONTROLLER_PINNED_TO_CORE_1=
CONFIG_BTDM_CONTROLLER_PINNED_TO_CORE=0
CONFIG_BTDM_CONTROLLER_HCI_MODE_VHCI=y
CONFIG_BTDM_CONTROLLER_HCI_MODE_UART_H4=

#
# MODEM SLEEP Options
#
CONFIG_BTDM_CONTROLLER_MODEM_SLEEP=
CONFIG_BLE_SCAN_DUPLICATE=y
CONFIG_SCAN_DUPLICATE_BY_DEVICE_ADDR=
CONFIG_SCAN_DUPLICATE_BY_ADV_DATA=
CONFIG_SCAN_DUPLICATE_BY_ADV_DATA_AND_DEVICE_ADDR=y
CONFIG_SCAN_DUPLICATE_TYPE=2
CONFIG_DUPLICATE_SCAN_CACHE_SIZE=200
CONFIG_BLE_MESH_SCAN_DUPLICATE_EN=y
CONFIG_MESH_DUPLICATE_SCAN_CACHE_SIZE=200
CONFIG_BLE_ADV_REPORT_FLOW_CONTROL_SUPPORTED=
CONFIG_BTDM_COEX_BT_OPTIONS=y
CONFIG_BTDM_COEX_BLE_ADV_HIGH_PRIORITY=y
CONFIG_BLUEDROID_ENABLED=y
CONFIG_BLUEDROID_PINNED_TO_CORE_0=y
CONFIG_BLUEDROID_PINNED_TO_CORE_1=
CONFIG_BLUEDROID_PINNED_TO_CORE=0
CONFIG_BTC_TASK_STACK_SIZE=3072
CONFIG_BTU_TASK_STACK_SIZE=4512
CONFIG_BLUEDROID_MEM_DEBUG=
CONFIG_CLASSIC_BT_ENABLED=y
CONFIG_A2DP_ENABLE=
CONFIG_BT_SPP_ENABLED=
CONFIG_HFP_ENABLE=
CONFIG_BT_SSP_ENABLED=y
CONFIG_GATTS_ENABLE=y
CONFIG_GATTS_SEND_SERVICE_CHANGE_MANUAL=y
CONFIG_GATTS_SEND_SERVICE_CHANGE_AUTO=
CONFIG_GATTS_SEND_SERVICE_CHANGE_MODE=1
CONFIG_GATTC_ENABLE=y
CONFIG_GATTC_CACHE_NVS_FLASH=
CONFIG_BLE_SMP_ENABLE=
CONFIG_BT_STACK_NO_LOG=


# Override some defaults of ESP BLE Mesh
CONFIG_BLE_MESH=y
CONFIG_BLE_MESH_HCI_5_0=y
CONFIG_BLE_MESH_USE_DUPLICATE_SCAN=y
CONFIG_BLE_MESH_FAST_PROV=
CONFIG_BLE_MESH_NODE=
CONFIG_BLE_MESH_PROVISIONER=y
CONFIG_BLE_MESH_WAIT_FOR_PROV_MAX_DEV_NUM=20
CONFIG_BLE_MESH_MAX_STORED_NODES=20
CONFIG_BLE_MESH_MAX_PROV_NODES=20
CONFIG_BLE_MESH_PBA_SAME_TIME=1
CONFIG_BLE_MESH_PROVISIONER_SUBNET_COUNT=3
CONFIG_BLE_MESH_PROVISIONER_APP_KEY_COUNT=9
CONFIG_BLE_MESH_PROV=y
CONFIG_BLE_MESH_PB_ADV=y
CONFIG_BLE_MESH_PB_GATT=
CONFIG_BLE_MESH_PROXY=
CONFIG_BLE_MESH_GATT_PROXY_CLIENT=
CONFIG_BLE_MESH_NET_BUF_POOL_USAGE=y
CONFIG_BLE_MESH_SETTINGS=
CONFIG_BLE_MESH_SUBNET_COUNT=3
CONFIG_BLE_MESH_APP_KEY_COUNT=3
CONFIG_BLE_MESH_MODEL_KEY_COUNT=3
CONFIG_BLE_MESH_MODEL_GROUP_COUNT=3
CONFIG_BLE_MESH_LABEL_COUNT=3
CONFIG_BLE_MESH_CRPL=10
CONFIG_BLE_MESH_MSG_CACHE_SIZE=10
CONFIG_BLE_MESH_ADV_BUF_COUNT=150
CONFIG_BLE_MESH_IVU_DIVIDER=4
CONFIG_BLE_MESH_TX_SEG_MSG_COUNT=1
CONFIG_BLE_MESH_RX_SEG_MSG_COUNT=10
CONFIG_BLE_MESH_RX_SDU_MAX=384
CONFIG_BLE_MESH_TX_SEG_MAX=32
CONFIG_BLE_MESH_NO_LOG=
CONFIG_BLE_MESH_CFG_CLI=y
CONFIG_BLE_MESH_HEALTH_CLI=
CONFIG_BLE_MESH_GENERIC_ONOFF_CLI=y

# Override some defaults of log output
CONFIG_CONSOLE_UART_BAUDRATE=921600
CONFIG_MONITOR_BAUD_921600B=y

#
# Example Configuration
#
CONFIG_BLE_MESH_PROV_TEST=y


#
# Partition Table
#
CONFIG_PARTITION_TABLE_SINGLE_APP=
CONFIG_PARTITION_TABLE_TWO_OTA=
CONFIG_PARTITION_TABLE_CUSTOM=y
CONFIG_PARTITION_TABLE_CUSTOM_FILENAME="partitions.csv"
CONFIG_PARTITION_TABLE_FILENAME="partitions.csv"
CONFIG_PARTITION_TABLE_OFFSET=0x8000
CONFIG_PARTITION_TABLE_MD5=y
```

## examples/bluetooth/esp_ble_mesh/ble_mesh_provisioner/sdkconfig.defaults
```kconfig
# Defaults for generating a new "sdkconfig" file (project settings).
# https://docs.espressif.com/projects/esp-idf/en/latest/esp32/api-guides/build-system.html#custom-sdkconfig-defaults
#
# NOTE - if this file changes, to get new defaults, you must erase any existing
# "sdkconfig" file (this will undo manual settings from "idf.py menuconfig").

# Override some defaults so BT stack is enabled
# by default in this example
CONFIG_BT_ENABLED=y
CONFIG_BTDM_CTRL_MODE_BLE_ONLY=y
CONFIG_BTDM_CTRL_MODE_BR_EDR_ONLY=n
CONFIG_BTDM_CTRL_MODE_BTDM=n
CONFIG_CTRL_BTDM_MODEM_SLEEP=n
CONFIG_BTDM_SCAN_DUPL_TYPE_DATA_DEVICE=y
CONFIG_BTDM_BLE_MESH_SCAN_DUPL_EN=y
CONFIG_BT_BTU_TASK_STACK_SIZE=4512

# Override some defaults of ESP BLE Mesh
CONFIG_BLE_MESH=y
CONFIG_BLE_MESH_PROVISIONER=y
CONFIG_BLE_MESH_PB_GATT=y
CONFIG_BLE_MESH_TX_SEG_MSG_COUNT=10
CONFIG_BLE_MESH_RX_SEG_MSG_COUNT=10
CONFIG_BLE_MESH_CFG_CLI=y
CONFIG_BLE_MESH_GENERIC_ONOFF_CLI=y
```

## examples/bluetooth/esp_ble_mesh/ble_mesh_sensor_model/sensor_server/sdkconfig.defaults
```kconfig
# Override some defaults so BT stack is enabled
# by default in this example
CONFIG_BT_ENABLED=y
CONFIG_BTDM_CTRL_MODE_BLE_ONLY=y
CONFIG_BTDM_CTRL_MODE_BR_EDR_ONLY=n
CONFIG_BTDM_CTRL_MODE_BTDM=n
CONFIG_BTDM_MODEM_SLEEP=n
CONFIG_BTDM_SCAN_DUPL_TYPE_DATA_DEVICE=y
CONFIG_BTDM_BLE_MESH_SCAN_DUPL_EN=y
CONFIG_BT_GATTS_SEND_SERVICE_CHANGE_MANUAL=y
CONFIG_BT_BTU_TASK_STACK_SIZE=4512

# Override some defaults of ESP BLE Mesh
CONFIG_BLE_MESH=y
CONFIG_BLE_MESH_NODE=y
CONFIG_BLE_MESH_PB_GATT=y
CONFIG_BLE_MESH_TX_SEG_MSG_COUNT=10
CONFIG_BLE_MESH_RX_SEG_MSG_COUNT=10
```

## examples/bluetooth/esp_ble_mesh/ble_mesh_tx_rx_test/coex_a2dp_mini/main/Kconfig.projbuild
```kconfig
menu "A2DP Example Configuration"

menuconfig  RUN_ON_ESP32_LYRAT
    bool "Run on ESP32-LyraT-Board"
    default n
    help
        Run this A2DP sink demo on ESP32-LyraT board.
        It could play music and heart sound on ESP32-LyraT board.
        If you don't want the demo run ESP32-LyarT, please set "N",
        therefore it will crased when initialise external Codec chip.

menu "Media Hal Config"
menu "I2C Configuration (Configure Codec Chip Register)"

config I2C_PORT
    int "I2C port"
    default 0 if RUN_ON_ESP32_LYRAT
    default 0
    range 0 1
    help
        Select I2C port number.

config I2C_CLK_PIN
    int "I2C clock pin"
    default 23 if RUN_ON_ESP32_LYRAT
    default 23
    range 0 39
    help
        Select I2C clock pin.

config I2C_DATA_PIN
    int "I2C data pin"
    default 18 if RUN_ON_ESP32_LYRAT
    default 18
    range 0 39
    help
        Select I2C data pin.

endmenu

menu "I2S Configuration (Output Data to Codec Chip)"

config I2S_PORT
    int "I2S port"
    default 0 if RUN_ON_ESP32_LYRAT
    default 0
    range 0 1
    help
        Select I2S port number.

config I2S_SCLK_PIN
    int "I2S SCLK pin"
    default 5 if RUN_ON_ESP32_LYRAT
    default 5
    range 0 39
    help
        Select I2S SCLK pin(GPIO no).

config I2S_WS_PIN
    int "I2S WS pin"
    default 25 if RUN_ON_ESP32_LYRAT
    default 25
    range 0 39
    help
        Select I2S WS pin(GPIO no).

## A2DP don't need data input, so make it invisible
config I2S_DATA_IN_PIN
    int
    default 26 if RUN_ON_ESP32_LYRAT
    default 26
    range 0 39
    help
        Select I2S data input pin(GPIO no).

config I2S_DATA_OUT_PIN
    int "I2S data ouyput pin"
    default 35 if RUN_ON_ESP32_LYRAT
    default 35
    range 0 39
    help
        Select I2S data output pin(GPIO no).

config I2S_MCLK_OUT_GPIO0_ENABLE
    bool "Use GPIO0 as I2S MCLK OUTPUT"
    default y if RUN_ON_ESP32_LYRAT
    default n
    help
        Use GPIO0 as I2S MCLK OUTPUT.

config I2S_BITS_PER_SAMPLE
    int "I2S sample bits (only support 8, 16, 24, 32)"
    default 16 if RUN_ON_ESP32_LYRAT
    default 16
    range 8 32
    help
        Select I2S sample bits
endmenu

config I2S_DAC_EN
    bool "Use internal DAC intead Codec chip receive I2S signal)"
    default n if RUN_ON_ESP32_LYRAT
    default n
    help
        If the sound output format is I2S format, then it can use internal
        DAC intead Codec chip receive I2S signal and do sound output.

## A2DP don't need data input, so make it invisible
config I2S_ADC_EN
    bool
    default n if RUN_ON_ESP32_LYRAT
    default n
    help
        Just for microphone, A2DP don't need microphone.

menuconfig PA_EN_GPIO_ENABLE
    bool "Use GPIO to enable PA"
    default y if RUN_ON_ESP32_LYRAT
    default n
    help
        Select if there's a GPIO to enable PA.

config PA_EN_GPIO
    int "PA enable GPIO"
    depends on PA_EN_GPIO_ENABLE
    default 21 if RUN_ON_ESP32_LYRAT
    default 21
    help
        The GPIO which can enable PA.

config VOLUME_DEFAULT
    int "Default Volume for Media CODEC"
    default 60
    range 0 100
    help
        Set default volume for codec chip.
endmenu

config A2DP_MEDIA_RINGBUF
    bool "Use ringbuf to store audio data when i2s write"
    default y
    help
        When i2s write, use ringbuf  to store more audio data as cache.

endmenu
```

## examples/bluetooth/esp_ble_mesh/ble_mesh_tx_rx_test/test_tx/sdkconfig.defaults
```kconfig
# Override some defaults so BT stack is enabled
# by default in this example
CONFIG_BT_ENABLED=y
CONFIG_BTDM_CONTROLLER_MODE_BLE_ONLY=y
CONFIG_BTDM_CONTROLLER_MODE_BR_EDR_ONLY=
CONFIG_BTDM_CONTROLLER_MODE_BTDM=
CONFIG_BTDM_CONTROLLER_MODEM_SLEEP=n
CONFIG_SCAN_DUPLICATE_BY_ADV_DATA_AND_DEVICE_ADDR=y
CONFIG_BLE_MESH_SCAN_DUPLICATE_EN=y
# CONFIG_BTDM_CONTROLLER_FULL_SCAN_SUPPORTED=y
CONFIG_BLE_ADV_REPORT_FLOW_CONTROL_SUPPORTED=n
CONFIG_BLUEDROID_ENABLED=y
CONFIG_GATTS_SEND_SERVICE_CHANGE_MANUAL=y
CONFIG_BLE_SMP_ENABLE=n
CONFIG_BTU_TASK_STACK_SIZE=4512

# Override some defaults of ESP BLE Mesh
CONFIG_BLE_MESH=y
CONFIG_BLE_MESH_PROVISIONER=y
CONFIG_BLE_MESH_PBA_SAME_TIME=1
CONFIG_BLE_MESH_TX_SEG_MSG_COUNT=10
CONFIG_BLE_MESH_RX_SEG_MSG_COUNT=10
CONFIG_BLE_MESH_TX_SEG_MAX=32
CONFIG_BLE_MESH_TRACE_LEVEL_ERROR=y
CONFIG_BLE_MESH_CFG_CLI=y

# Override some defaults of log output
CONFIG_CONSOLE_UART_BAUDRATE=921600
CONFIG_MONITOR_BAUD_921600B=y
```

## examples/bluetooth/esp_ble_mesh/ble_mesh_vendor_models/fast_prov_vendor_model/sdkconfig.defaults
```kconfig
# Override some defaults so BT stack is enabled
# by default in this example
CONFIG_BT_ENABLED=y
CONFIG_BLE_MESH=y
CONFIG_BLE_MESH_FAST_PROV=y
CONFIG_BLE_MESH_PROV=y
CONFIG_BLE_MESH_NODE=y
CONFIG_BLE_MESH_PROVISIONER=y
CONFIG_BLE_MESH_WAIT_FOR_PROV_MAX_DEV_NUM=20
CONFIG_BLE_MESH_MAX_STORED_NODES=10
CONFIG_BLE_MESH_MAX_PROV_NODES=6
CONFIG_BLE_MESH_PBA_SAME_TIME=3
CONFIG_BLE_MESH_PBG_SAME_TIME=3
CONFIG_BLE_MESH_PROVISIONER_SUBNET_COUNT=3
CONFIG_BLE_MESH_PROVISIONER_APP_KEY_COUNT=9
CONFIG_BLE_MESH_PB_ADV=y
CONFIG_BLE_MESH_NET_BUF_POOL_USAGE=y
CONFIG_BLE_MESH_PB_GATT=y
CONFIG_BLE_MESH_GATT_PROXY_SERVER=y
CONFIG_BLE_MESH_RELAY=y
CONFIG_BLE_MESH_LOW_POWER=
CONFIG_BLE_MESH_FRIEND=
CONFIG_BT_BTU_TASK_STACK_SIZE=4512
CONFIG_BLE_MESH_CFG_CLI=y
CONFIG_BLE_MESH_CRPL=60
CONFIG_BLE_MESH_MSG_CACHE_SIZE=60
CONFIG_BLE_MESH_ADV_BUF_COUNT=200
CONFIG_BLE_MESH_TX_SEG_MSG_COUNT=10
CONFIG_BLE_MESH_RX_SEG_MSG_COUNT=10
CONFIG_BLE_MESH_RX_SDU_MAX=384
CONFIG_BLE_MESH_TX_SEG_MAX=32
CONFIG_BLE_MESH_NO_LOG=n
CONFIG_BLE_MESH_STACK_TRACE_LEVEL=0
```

## examples/bluetooth/esp_ble_mesh/ble_mesh_wifi_coexist/main/Kconfig.projbuild
```kconfig
menu "Example Configuration"

    choice BLE_MESH_EXAMPLE_BOARD
        prompt "Board selection for BLE Mesh"
        default BLE_MESH_ESP_WROOM_32
        help
            Select this option to choose the board for BLE Mesh. The default is ESP32-WROOM-32

        config BLE_MESH_ESP_WROOM_32
            bool "ESP32-WROOM-32"

        config BLE_MESH_ESP_WROVER
            bool "ESP32-WROVER"
    endchoice

endmenu
```
