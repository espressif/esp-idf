## examples/bluetooth/esp_ble_mesh/ble_mesh_wifi_coexist/sdkconfig.defaults
```kconfig
# Override some defaults so BT stack is enabled
# by default in this example
CONFIG_BT_ENABLED=y
CONFIG_BTDM_CONTROLLER_MODE_BLE_ONLY=y
CONFIG_BTDM_CONTROLLER_MODE_BR_EDR_ONLY=n
CONFIG_BTDM_CONTROLLER_MODE_BTDM=n
CONFIG_BTDM_CONTROLLER_MODEM_SLEEP=n
CONFIG_SCAN_DUPLICATE_BY_ADV_DATA_AND_DEVICE_ADDR=y
CONFIG_BLE_MESH_SCAN_DUPLICATE_EN=y
CONFIG_GATTS_SEND_SERVICE_CHANGE_MANUAL=y
CONFIG_BTU_TASK_STACK_SIZE=4512

# Override some defaults of ESP BLE Mesh
CONFIG_BLE_MESH=y
CONFIG_BLE_MESH_FAST_PROV=y
CONFIG_BLE_MESH_MAX_PROV_NODES=6
CONFIG_BLE_MESH_PBA_SAME_TIME=3
CONFIG_BLE_MESH_PB_GATT=y
CONFIG_BLE_MESH_CRPL=60
CONFIG_BLE_MESH_MSG_CACHE_SIZE=60
CONFIG_BLE_MESH_ADV_BUF_COUNT=200
CONFIG_BLE_MESH_TX_SEG_MSG_COUNT=10
CONFIG_BLE_MESH_RX_SEG_MSG_COUNT=10
CONFIG_BLE_MESH_TRACE_LEVEL_ERROR=y
CONFIG_BLE_MESH_CFG_CLI=y

CONFIG_ESP32_DEFAULT_CPU_FREQ_240=y
CONFIG_ESP32_DEFAULT_CPU_FREQ_MHZ=240
CONFIG_MEMMAP_SMP=y

CONFIG_ESP_SYSTEM_EVENT_TASK_STACK_SIZE=4096

CONFIG_ESP32_WIFI_STATIC_RX_BUFFER_NUM=16
CONFIG_ESP32_WIFI_DYNAMIC_RX_BUFFER_NUM=64
CONFIG_ESP32_WIFI_DYNAMIC_TX_BUFFER_NUM=64
CONFIG_ESP32_WIFI_AMPDU_TX_ENABLED=y
CONFIG_ESP32_WIFI_TX_BA_WIN=32
CONFIG_ESP32_WIFI_AMPDU_RX_ENABLED=y
CONFIG_ESP32_WIFI_RX_BA_WIN=32

CONFIG_FREERTOS_UNICORE=
CONFIG_FREERTOS_HZ=1000

CONFIG_ESP_INT_WDT=
CONFIG_ESP_TASK_WDT=

CONFIG_LWIP_TCP_SND_BUF_DEFAULT=65534
CONFIG_LWIP_TCP_WND_DEFAULT=65534
CONFIG_LWIP_TCP_RECVMBOX_SIZE=64
CONFIG_LWIP_UDP_RECVMBOX_SIZE=64
CONFIG_LWIP_TCPIP_RECVMBOX_SIZE=64
CONFIG_LWIP_ETHARP_TRUST_IP_MAC=

CONFIG_ESPTOOLPY_FLASHMODE_QIO=y
CONFIG_ESPTOOLPY_FLASHFREQ_40M=y
CONFIG_LWIP_IRAM_OPTIMIZATION=y

CONFIG_PARTITION_TABLE_CUSTOM=y
CONFIG_ESPTOOLPY_FLASHSIZE_4MB=y
```

## examples/bluetooth/esp_ble_mesh/common_components/button/Kconfig
```kconfig
menu "Button"

    choice BUTTON_TIMER_IMPLEMENT
        bool "Button Timer Mode"
        default BUTTON_USE_ESP_TIMER
        help
            Choose a implementation of timer for button instance.

        config BUTTON_USE_RTOS_TIMER
            bool "Use FreeRTOS Timer"

        config BUTTON_USE_ESP_TIMER
            bool "Use ESP Timer"
    endchoice

    config BUTTON_IO_GLITCH_FILTER_TIME_MS
        int "IO glitch filter timer ms (10~100)"
        range 10 100
        default 50

    config BUTTON_IO_NUM
        int "Default Boot Button IO"
        default 0 if IDF_TARGET_ESP32
        default 9 if IDF_TARGET_ESP32C3
        default 0 if IDF_TARGET_ESP32S3
        default 8 if IDF_TARGET_ESP32C6
        default 9 if IDF_TARGET_ESP32H2
        default 9 if IDF_TARGET_ESP32C61
        default 28 if IDF_TARGET_ESP32C5

endmenu
```

## examples/bluetooth/esp_ble_mesh/common_vendor_models/fast_prov_vendor_model/sdkconfig.defaults
```kconfig
# Override some defaults so BT stack is enabled
# by default in this example
CONFIG_BT_ENABLED=y

# Override some defaults of ESP BLE Mesh
CONFIG_BLE_MESH=y
CONFIG_BLE_MESH_FAST_PROV=y
```

## examples/bluetooth/esp_ble_mesh/fast_provisioning/fast_prov_client/sdkconfig.defaults
```kconfig
# Override some defaults so BT stack is enabled
# by default in this example
CONFIG_BT_ENABLED=y
CONFIG_BT_BTU_TASK_STACK_SIZE=4512
CONFIG_PARTITION_TABLE_SINGLE_APP_LARGE=y

# Override some defaults of ESP BLE Mesh
CONFIG_BLE_MESH=y
CONFIG_BLE_MESH_PROVISIONER=y
CONFIG_BLE_MESH_PBA_SAME_TIME=1
CONFIG_BLE_MESH_PB_GATT=y
CONFIG_BLE_MESH_ADV_BUF_COUNT=100
CONFIG_BLE_MESH_TX_SEG_MSG_COUNT=10
CONFIG_BLE_MESH_RX_SEG_MSG_COUNT=10
CONFIG_BLE_MESH_CFG_CLI=y
CONFIG_BLE_MESH_GENERIC_ONOFF_CLI=y
```

## examples/bluetooth/esp_ble_mesh/fast_provisioning/fast_prov_server/sdkconfig.defaults
```kconfig
# Override some defaults so BT stack is enabled
# by default in this example
CONFIG_BT_ENABLED=y
CONFIG_BT_GATTS_SEND_SERVICE_CHANGE_MANUAL=y
CONFIG_BT_BTU_TASK_STACK_SIZE=4512

# Override some defaults of ESP BLE Mesh
CONFIG_BLE_MESH=y
CONFIG_BLE_MESH_FAST_PROV=y
CONFIG_BLE_MESH_MAX_PROV_NODES=6
CONFIG_BLE_MESH_PBA_SAME_TIME=3
CONFIG_BLE_MESH_PB_GATT=y
CONFIG_BLE_MESH_CRPL=60
CONFIG_BLE_MESH_MSG_CACHE_SIZE=60
CONFIG_BLE_MESH_ADV_BUF_COUNT=200
CONFIG_BLE_MESH_TX_SEG_MSG_COUNT=10
CONFIG_BLE_MESH_RX_SEG_MSG_COUNT=10
CONFIG_BLE_MESH_TRACE_LEVEL_ERROR=y
CONFIG_BLE_MESH_CFG_CLI=y

CONFIG_PARTITION_TABLE_CUSTOM=y
CONFIG_ESPTOOLPY_FLASHSIZE_4MB=y
```

## examples/bluetooth/esp_ble_mesh/fast_provisioning/fast_prov_server/sdkconfig.defaults.esp32c6
```kconfig
# Override some defaults so BT stack is enabled
# by default in this example
CONFIG_BT_ENABLED=y
CONFIG_BT_LE_SCAN_DUPL_TYPE_DATA_DEVICE=y
CONFIG_BT_CTRL_BLE_MESH_SCAN_DUPL_EN=y
CONFIG_BT_GATTS_SEND_SERVICE_CHANGE_MANUAL=y
CONFIG_BT_BTU_TASK_STACK_SIZE=4512
CONFIG_BT_BLE_42_FEATURES_SUPPORTED=y
CONFIG_BT_BLE_50_FEATURES_SUPPORTED=n
CONFIG_BT_LE_50_FEATURE_SUPPORT=n

# Override some defaults of ESP BLE Mesh
CONFIG_BLE_MESH=y
CONFIG_BLE_MESH_FAST_PROV=y
CONFIG_BLE_MESH_MAX_PROV_NODES=6
CONFIG_BLE_MESH_PBA_SAME_TIME=3
CONFIG_BLE_MESH_PB_GATT=y
CONFIG_BLE_MESH_CRPL=60
CONFIG_BLE_MESH_MSG_CACHE_SIZE=60
CONFIG_BLE_MESH_ADV_BUF_COUNT=200
CONFIG_BLE_MESH_TX_SEG_MSG_COUNT=10
CONFIG_BLE_MESH_RX_SEG_MSG_COUNT=10
CONFIG_BLE_MESH_TRACE_LEVEL_ERROR=y
CONFIG_BLE_MESH_CFG_CLI=y

CONFIG_PARTITION_TABLE_CUSTOM=y
CONFIG_ESPTOOLPY_FLASHSIZE_4MB=y
```

## examples/bluetooth/esp_ble_mesh/provisioner/sdkconfig.defaults.esp32
```kconfig
# Override some defaults so BT stack is enabled
# by default in this example
CONFIG_IDF_TARGET="esp32"
CONFIG_BT_ENABLED=y
CONFIG_BTDM_CTRL_MODE_BLE_ONLY=y
CONFIG_BTDM_CTRL_MODEM_SLEEP=n
CONFIG_BTDM_SCAN_DUPL_TYPE_DATA_DEVICE=y
CONFIG_BTDM_BLE_MESH_SCAN_DUPL_EN=y
```

## examples/bluetooth/esp_ble_mesh/remote_provisioning/rpr_client/sdkconfig.defaults.esp32s3
```kconfig
# Override some defaults so BT stack is enabled
# by default in this example
CONFIG_IDF_TARGET="esp32s3"
CONFIG_BT_CTRL_SCAN_DUPL_TYPE_DATA_DEVICE=y
CONFIG_BT_CTRL_BLE_MESH_SCAN_DUPL_EN=y
CONFIG_BT_BLE_42_FEATURES_SUPPORTED=y
CONFIG_BT_BLE_50_FEATURES_SUPPORTED=n
```

## examples/bluetooth/esp_ble_mesh/sensor_models/sensor_client/sdkconfig.defaults.esp32h2
```kconfig
# Override some defaults so BT stack is enabled
# by default in this example
CONFIG_IDF_TARGET="esp32h2"
CONFIG_BT_LE_SCAN_DUPL_TYPE_DATA_DEVICE=y
CONFIG_BT_BLE_42_FEATURES_SUPPORTED=y
CONFIG_BT_BLE_50_FEATURES_SUPPORTED=n
CONFIG_BT_LE_50_FEATURE_SUPPORT=n
```

## examples/bluetooth/esp_ble_mesh/vendor_models/vendor_client/main/Kconfig.projbuild
```kconfig
menu "Board Configuration"

    config BUTTON_IO_NUM
        int "GPIO number for button"
        default 0
        help
            GPIO number to use as a button input.

    config BUTTON_ACTIVE_LEVEL
        int "Active level for button (0 = LOW, 1 = HIGH)"
        default 0
        range 0 1
        help
            Logic level at which the button is considered pressed.

endmenu
```

## examples/bluetooth/esp_ble_mesh/vendor_models/vendor_server/sdkconfig.defaults
```kconfig
# Override some defaults so BT stack is enabled
# by default in this example
CONFIG_BT_ENABLED=y
CONFIG_BTDM_CTRL_MODE_BLE_ONLY=y
CONFIG_BTDM_CTRL_MODE_BR_EDR_ONLY=n
CONFIG_BTDM_CTRL_MODE_BTDM=n
CONFIG_CTRL_BTDM_MODEM_SLEEP=n
CONFIG_BTDM_SCAN_DUPL_TYPE_DATA_DEVICE=y
CONFIG_BTDM_BLE_MESH_SCAN_DUPL_EN=y
CONFIG_BT_GATTS_SEND_SERVICE_CHANGE_MANUAL=y
CONFIG_BT_BTU_TASK_STACK_SIZE=4512

# Override some defaults of ESP BLE Mesh
CONFIG_BLE_MESH=y
CONFIG_BLE_MESH_NODE=y
CONFIG_BLE_MESH_PB_GATT=y
CONFIG_BLE_MESH_TX_SEG_MSG_COUNT=10
CONFIG_BLE_MESH_RX_SEG_MSG_COUNT=10

#
# Serial flasher config
#
CONFIG_ESPTOOLPY_MONITOR_BAUD_921600B=y
CONFIG_ESPTOOLPY_MONITOR_BAUD=921600

#
# ESP32-specific
#
CONFIG_ESP_CONSOLE_UART_BAUDRATE=921600
```

## examples/bluetooth/esp_ble_mesh/vendor_models/vendor_server/sdkconfig.defaults.esp32
```kconfig
# Override some defaults so BT stack is enabled
# by default in this example
CONFIG_IDF_TARGET="esp32"
CONFIG_BTDM_CTRL_MODE_BLE_ONLY=y
CONFIG_BTDM_CTRL_MODEM_SLEEP=n
CONFIG_BTDM_SCAN_DUPL_TYPE_DATA_DEVICE=y
CONFIG_BTDM_BLE_MESH_SCAN_DUPL_EN=y

#
# Serial flasher config
#
CONFIG_ESPTOOLPY_MONITOR_BAUD=921600

#
# ESP32-specific
#
CONFIG_ESP_CONSOLE_UART_BAUDRATE=921600
```

## examples/bluetooth/esp_ble_mesh/wifi_coexist/main/Kconfig.projbuild
```kconfig
menu "Example Configuration"

    choice BLE_MESH_EXAMPLE_BOARD
        prompt "Board selection for BLE Mesh"
        default BLE_MESH_ESP_WROOM_32 if IDF_TARGET_ESP32
        default BLE_MESH_ESP32C3_DEV if IDF_TARGET_ESP32C3
        default BLE_MESH_ESP32S3_DEV if IDF_TARGET_ESP32S3
        default BLE_MESH_ESP32C6_DEV if IDF_TARGET_ESP32C6
        help
            Select this option to choose the board for BLE Mesh. The default is ESP32-WROOM-32

        config BLE_MESH_ESP_WROOM_32
            bool "ESP32-WROOM-32"
            depends on IDF_TARGET_ESP32

        config BLE_MESH_ESP_WROVER
            bool "ESP32-WROVER"
            depends on IDF_TARGET_ESP32

        config BLE_MESH_ESP32C3_DEV
            bool "ESP32C3-DevKitC"
            depends on IDF_TARGET_ESP32C3

        config BLE_MESH_ESP32S3_DEV
            bool "ESP32S3-DevKitC"
            depends on IDF_TARGET_ESP32S3

        config BLE_MESH_ESP32C6_DEV
            bool "ESP32C6-DevKitC"
            depends on IDF_TARGET_ESP32C6

        config BLE_MESH_ESP32C5_DEV
            bool "ESP32C5-DevKitC"
            depends on IDF_TARGET_ESP32C5

    endchoice

endmenu
```

## examples/bluetooth/esp_ble_mesh/wifi_coexist/sdkconfig.defaults
```kconfig
# Override some defaults so BT stack is enabled
# by default in this example
CONFIG_BT_ENABLED=y
CONFIG_BT_GATTS_SEND_SERVICE_CHANGE_MANUAL=y
CONFIG_BT_BTU_TASK_STACK_SIZE=4512

# Override some defaults of ESP BLE Mesh
CONFIG_BLE_MESH=y
CONFIG_BLE_MESH_FAST_PROV=y
CONFIG_BLE_MESH_MAX_PROV_NODES=6
CONFIG_BLE_MESH_PBA_SAME_TIME=3
CONFIG_BLE_MESH_PB_GATT=y
CONFIG_BLE_MESH_CRPL=60
CONFIG_BLE_MESH_MSG_CACHE_SIZE=60
CONFIG_BLE_MESH_ADV_BUF_COUNT=200
CONFIG_BLE_MESH_TX_SEG_MSG_COUNT=10
CONFIG_BLE_MESH_RX_SEG_MSG_COUNT=10
CONFIG_BLE_MESH_TRACE_LEVEL_ERROR=y
CONFIG_BLE_MESH_CFG_CLI=y

CONFIG_ESP_SYSTEM_EVENT_TASK_STACK_SIZE=4096

CONFIG_ESP_WIFI_STATIC_RX_BUFFER_NUM=16
CONFIG_ESP_WIFI_DYNAMIC_RX_BUFFER_NUM=64
CONFIG_ESP_WIFI_DYNAMIC_TX_BUFFER_NUM=64
CONFIG_ESP_WIFI_AMPDU_TX_ENABLED=y
CONFIG_ESP_WIFI_TX_BA_WIN=32
CONFIG_ESP_WIFI_AMPDU_RX_ENABLED=y
CONFIG_ESP_WIFI_RX_BA_WIN=32

CONFIG_FREERTOS_UNICORE=n
CONFIG_FREERTOS_HZ=1000

CONFIG_ESP_INT_WDT=n
CONFIG_ESP_TASK_WDT_EN=n

CONFIG_LWIP_TCP_SND_BUF_DEFAULT=65534
CONFIG_LWIP_TCP_WND_DEFAULT=65534
CONFIG_LWIP_TCP_RECVMBOX_SIZE=64
CONFIG_LWIP_UDP_RECVMBOX_SIZE=64
CONFIG_LWIP_TCPIP_RECVMBOX_SIZE=64

CONFIG_ESPTOOLPY_FLASHMODE_QIO=y
CONFIG_ESPTOOLPY_FLASHFREQ_40M=y
CONFIG_LWIP_IRAM_OPTIMIZATION=n

CONFIG_ESP_WIFI_RX_IRAM_OPT=n

CONFIG_PARTITION_TABLE_CUSTOM=y
CONFIG_ESPTOOLPY_FLASHSIZE_4MB=y
```

## examples/bluetooth/esp_hid_device/main/Kconfig.projbuild
```kconfig
menu "HID Example Configuration"
    config EXAMPLE_SSP_ENABLED
        bool "Secure Simple Pairing"
        depends on BT_CLASSIC_ENABLED
        default y
        help
            This enables the Secure Simple Pairing. If disable this option,
            Bluedroid will only support Legacy Pairing

    choice EXAMPLE_HID_DEVICE_ROLE
        prompt "HID Device Role"
        depends on BT_NIMBLE_ENABLED
        default EXAMPLE_MEDIA_ENABLE
        help
            Three Supported Roles for Device
            - Media Device
            - Keyboard
            - Mouse

        config EXAMPLE_MEDIA_ENABLE
            select BT_NIMBLE_HID_SERVICE
            bool "Enable Media Device"

        config EXAMPLE_KBD_ENABLE
            select BT_NIMBLE_HID_SERVICE
            bool "Enable Keyboard Device"

        config EXAMPLE_MOUSE_ENABLE
            select BT_NIMBLE_HID_SERVICE
            bool "Enable Mouse Device"
    endchoice

    config EXAMPLE_HID_DEVICE_ROLE
        int
        default 1 if EXAMPLE_MEDIA_ENABLE
        default 2 if EXAMPLE_KBD_ENABLE
        default 3 if EXAMPLE_MOUSE_ENABLE
endmenu
```
