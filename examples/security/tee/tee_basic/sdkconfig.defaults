## examples/security/tee/tee_basic/sdkconfig.defaults
```kconfig
# Enabling TEE
CONFIG_SECURE_ENABLE_TEE=y
CONFIG_SECURE_TEE_LOG_LEVEL_INFO=y
CONFIG_PARTITION_TABLE_SINGLE_APP_TEE=y
CONFIG_SECURE_TEE_ATTESTATION=n
CONFIG_MBEDTLS_TEE_SEC_STG_ECDSA_SIGN=n
CONFIG_SECURE_TEE_IRAM_SIZE=0xC000
```

## examples/security/tee/tee_secure_ota/main/Kconfig.projbuild
```kconfig
menu "Example Configuration"

    orsource "$IDF_PATH/examples/common_components/env_caps/$IDF_TARGET/Kconfig.env_caps"

    config EXAMPLE_SKIP_COMMON_NAME_CHECK
        bool "Skip server certificate CN fieldcheck"
        default n
        help
            This allows you to skip the validation of OTA server certificate CN field.

    config EXAMPLE_OTA_RECV_TIMEOUT
        int "OTA Receive Timeout"
        default 5000
        help
            Maximum time for reception

endmenu
```

## examples/security/tee/tee_secure_ota/sdkconfig.defaults
```kconfig
# Enabling TEE
CONFIG_SECURE_ENABLE_TEE=y
CONFIG_ESPTOOLPY_FLASHSIZE_4MB=y
CONFIG_PARTITION_TABLE_TWO_OTA_TEE=y
CONFIG_MBEDTLS_TEE_SEC_STG_ECDSA_SIGN=n
```

## examples/security/tee/tee_secure_storage/main/Kconfig.projbuild
```kconfig
menu "Example Configuration"

    config EXAMPLE_TEE_SEC_STG_SIGN_KEY_STR_ID
        string "TEE: Secure Storage Key ID for signing"
        default "sign_key_id_0"
        help
            Identifier for the ECDSA keypair stored in secure storage and used for
            sign/verify operations in this example.

    config EXAMPLE_TEE_SEC_STG_ENC_KEY_STR_ID
        string "TEE: Secure Storage Key ID for encryption"
        default "aes_key_id_0"
        help
            Identifier for the AES-256 key stored in secure storage and used for
            the AEAD encryption/decryption part of this example.

endmenu
```

## examples/security/tee/tee_secure_storage/sdkconfig.defaults
```kconfig
# Enabling TEE
CONFIG_SECURE_ENABLE_TEE=y
CONFIG_PARTITION_TABLE_SINGLE_APP_TEE=y
```

## examples/spiramTest/sdkconfig.defaults
```kconfig
CONFIG_BOOTLOADER_LOG_LEVEL_NONE=y

CONFIG_COMPILER_STACK_CHECK_MODE_ALL=y
CONFIG_COMPILER_OPTIMIZATION_ASSERTIONS_ENABLE=y
CONFIG_COMPILER_OPTIMIZATION_CHECKS_SILENT=n
CONFIG_COMPILER_WARN_WRITE_STRINGS=y

CONFIG_HEAP_TASK_TRACKING=y
CONFIG_HEAP_TRACING_STANDALONE=y
CONFIG_HEAP_POISONING_COMPREHENSIVE=y

CONFIG_FREERTOS_WATCHPOINT_END_OF_STACK=y
CONFIG_FREERTOS_USE_STATS_FORMATTING_FUNCTIONS=y
CONFIG_FREERTOS_USE_TRACE_FACILITY=y
CONFIG_FREERTOS_GENERATE_RUN_TIME_STATS=y
CONFIG_FREERTOS_CHECK_STACKOVERFLOW_CANARY=y
CONFIG_FREERTOS_WATCHPOINT_END_OF_STACK=y
CONFIG_FREERTOS_INTERRUPT_BACKTRACE=y
CONFIG_FREERTOS_ENABLE_TASK_SNAPSHOT=y
CONFIG_FREERTOS_CHECK_MUTEX_GIVEN_BY_OWNER=y

CONFIG_LOG_DEFAULT_LEVEL_INFO=y
CONFIG_LOG_MAXIMUM_LEVEL_VERBOSE=y


CONFIG_ESP_COREDUMP_ENABLE_TO_UART=y
CONFIG_ESP_TASK_WDT=n
CONFIG_ESP_DEBUG_STUBS_ENABLE=y



#do not modify eFuse permanently
CONFIG_EFUSE_VIRTUAL=y
CONFIG_EFUSE_VIRTUAL_KEEP_IN_FLASH=y

CONFIG_BOOT_ROM_LOG_ALWAYS_ON=y


CONFIG_ESP32S2_SPIRAM_SUPPORT=y
CONFIG_ESP32S2_DEFAULT_CPU_FREQ_240=y
CONFIG_ESP32S2_INSTRUCTION_CACHE_16KB=y
CONFIG_SPIRAM_SPEED_80M=y
```

## examples/storage/emmc/main/Kconfig.projbuild
```kconfig
menu "eMMC Example Configuration"

    config EXAMPLE_FORMAT_IF_MOUNT_FAILED
        bool "Format the card if mount failed"
        default n
        help
            If this config item is set, format_if_mount_failed will be set to true and the card will be formatted if
            the mount has failed.

    choice EXAMPLE_EMMC_BUS_WIDTH
        prompt "eMMC bus width"
        default EXAMPLE_EMMC_BUS_WIDTH_4
        help
            Select the bus width of the MMC interface.

        config EXAMPLE_EMMC_BUS_WIDTH_8
            bool "8 lines (D0 - D7)"

        config EXAMPLE_EMMC_BUS_WIDTH_4
            bool "4 lines (D0 - D3)"

        config EXAMPLE_EMMC_BUS_WIDTH_1
            bool "1 line (D0)"
    endchoice

    if SOC_SDMMC_USE_GPIO_MATRIX

        config EXAMPLE_PIN_CMD
            int "CMD GPIO number"
            default 33 if IDF_TARGET_ESP32S3

        config EXAMPLE_PIN_CLK
            int "CLK GPIO number"
            default 34 if IDF_TARGET_ESP32S3

        config EXAMPLE_PIN_D0
            int "D0 GPIO number"
            default 37 if IDF_TARGET_ESP32S3

        if EXAMPLE_EMMC_BUS_WIDTH_4 || EXAMPLE_EMMC_BUS_WIDTH_8

            config EXAMPLE_PIN_D1
                int "D1 GPIO number"
                default 38 if IDF_TARGET_ESP32S3

            config EXAMPLE_PIN_D2
                int "D2 GPIO number"
                default 39 if IDF_TARGET_ESP32S3

            config EXAMPLE_PIN_D3
                int "D3 GPIO number"
                default 36 if IDF_TARGET_ESP32S3

        endif  # EXAMPLE_EMMC_BUS_WIDTH_4 || EXAMPLE_EMMC_BUS_WIDTH_8

        if EXAMPLE_EMMC_BUS_WIDTH_8

            config EXAMPLE_PIN_D4
                int "D4 GPIO number"
                default 35 if IDF_TARGET_ESP32S3

            config EXAMPLE_PIN_D5
                int "D5 GPIO number"
                default 40 if IDF_TARGET_ESP32S3

            config EXAMPLE_PIN_D6
                int "D6 GPIO number"
                default 42 if IDF_TARGET_ESP32S3

            config EXAMPLE_PIN_D7
                int "D7 GPIO number"
                default 41 if IDF_TARGET_ESP32S3

        endif  # EXAMPLE_EMMC_BUS_WIDTH_8

    endif  # SOC_SDMMC_USE_GPIO_MATRIX

endmenu
```

## examples/storage/fatfs/fatfsgen/main/Kconfig.projbuild
```kconfig
menu "Example Configuration"

    config EXAMPLE_FATFS_MODE_READ_ONLY
        bool "Read only mode for generated FATFS image"
        default y
        help
            If read-only mode is set, the generated fatfs image will be raw (without wear levelling support).
            Otherwise it will support wear levelling that enables read-write mounting.

endmenu
```

## examples/storage/fatfs/fatfsgen/sdkconfig.defaults
```kconfig
CONFIG_ESPTOOLPY_FLASHSIZE_4MB=y
CONFIG_PARTITION_TABLE_CUSTOM=y
CONFIG_PARTITION_TABLE_CUSTOM_FILENAME="partitions_example.csv"
CONFIG_FATFS_LFN_HEAP=y
```

## examples/storage/littlefs/sdkconfig.defaults
```kconfig
CONFIG_PARTITION_TABLE_CUSTOM=y
CONFIG_PARTITION_TABLE_CUSTOM_FILENAME="partitions_demo_esp_littlefs.csv"
```

## examples/storage/nvs/nvs_bootloader/sdkconfig.defaults
```kconfig
# The size of bootloader has been increased, so the partition table offset needs adjustment
CONFIG_PARTITION_TABLE_OFFSET=0xB000
CONFIG_BOOTLOADER_LOG_LEVEL_WARN=y
CONFIG_BOOTLOADER_LOG_LEVEL=2
```

## examples/storage/nvs/nvs_statistics/sdkconfig.defaults
```kconfig
CONFIG_PARTITION_TABLE_CUSTOM=y
CONFIG_PARTITION_TABLE_CUSTOM_FILENAME="partitions.csv"
CONFIG_ESPTOOLPY_FLASHSIZE_4MB=y
```

## examples/storage/perf_benchmark/main/Kconfig.projbuild
```kconfig
menu "Performance Benchmark Example Configuration"
    config EXAMPLE_TARGET_RW_SIZE
        int "Target size for read/write (bytes)"
        default 65536
        help
            This is the target size used for the benchmark,
            it represents how much data will be transferred in each test.
            (The actual size of the allocated buffer will be larger for "more than target size" cases.)
            The test will test will show the performance of reading and writing
            of both slightly more and slightly less than this size as well.
            This will greatly affect the performance of the benchmark.
            In general, the larger the rw size, the better the performance.
            For FATFS, the best performance is achieved when the rw size
            matches the cluster size or is at least a multiple of the sector size.

    config EXAMPLE_TEST_TRIES
        int "Number of test tries"
        default 10
        help
            The number of times to run the benchmark.
            The average value will be displayed.

    config EXAMPLE_USE_BYTES
        bool "Use bytes instead of bits"
        default y
        help
            If this config item is set, the IO speed will be displayed in megabytes per second
            instead of megabits per second.

    config EXAMPLE_TEST_SPIFLASH
        bool "Test internal SPI flash"
        default y
        help
            If this config item is set, the internal SPI flash will be tested.

    menu "Internal flash test config"
        depends on EXAMPLE_TEST_SPIFLASH

        config EXAMPLE_TEST_SPIFLASH_RAW
            bool "Test raw access"
            default y
            help
                If this config item is set, raw access will be tested.

        config EXAMPLE_TEST_SPIFLASH_FATFS
            bool "Test FATFS"
            default y
            help
                If this config item is set, FATFS will be tested.

        config EXAMPLE_FATFS_SPIFLASH_CLUSTER_SIZE
            depends on EXAMPLE_TEST_SPIFLASH_FATFS
            int "Cluster size for FATFS on internal flash"
            default EXAMPLE_TARGET_RW_SIZE
            help
                The cluster size of the FATFS filesystem.
                The cluster size must be a multiple of the sector size.
                The default value is the same as the target read/write size.
                The larger the cluster size, the better the performance,
                but the more space will be wasted on the storage medium.

        config EXAMPLE_TEST_SPIFLASH_SPIFFS
            bool "Test SPIFFS"
            default y
            help
                If this config item is set, SPIFFS will be tested.

        config EXAMPLE_TEST_SPIFLASH_LITTLEFS
            bool "Test LittleFS"
            default y
            help
                If this config item is set, LittleFS will be tested.

    endmenu  # "Internal flash test config"

    config EXAMPLE_TEST_SD_CARD
        bool "Test SD card"
        default y
        help
            If this config item is set, the SD card will be tested after it is mounted.

    choice EXAMPLE_SD_CARD_INTERFACE
        prompt "SD card interface"
        depends on EXAMPLE_TEST_SD_CARD
        default EXAMPLE_USE_SDMMC if SOC_SDMMC_HOST_SUPPORTED
        default EXAMPLE_USE_SDSPI if !SOC_SDMMC_HOST_SUPPORTED
        help
            Select the SD card interface.

        if SOC_SDMMC_HOST_SUPPORTED
            config EXAMPLE_USE_SDMMC
                bool "SDMMC"
        endif  # SOC_SDMMC_HOST_SUPPORTED

        config EXAMPLE_USE_SDSPI
            bool "SDSPI"
    endchoice  # EXAMPLE_SD_CARD_INTERFACE

    menu "SD card test config"
        depends on EXAMPLE_TEST_SD_CARD

        config EXAMPLE_TEST_SD_CARD_RAW
            bool "Test raw access"
            default y
            help
                If this config item is set, raw access will be tested.

        config EXAMPLE_TEST_SD_CARD_FATFS
            bool "Test FATFS"
            default y
            help
                If this config item is set, FATFS will be tested.

        config EXAMPLE_FATFS_SD_CARD_CLUSTER_SIZE
            depends on EXAMPLE_TEST_SD_CARD_FATFS
            int "Cluster size for FATFS on SD card"
            default EXAMPLE_TARGET_RW_SIZE
            help
                The cluster size of the FATFS filesystem.
                The cluster size must be a multiple of the sector size.
                The default value is the same as the target read/write size.
                The larger the cluster size, the better the performance,
                but the more space will be wasted on the storage medium.

        config EXAMPLE_TEST_SD_CARD_LITTLEFS
            bool "Test LittleFS"
            default y
            help
                If this config item is set, LittleFS will be tested.

        choice EXAMPLE_SD_CARD_FREQ_PICKER
            prompt "SD card frequency"
            default EXAMPLE_SD_FREQ_HIGHSPEED if EXAMPLE_USE_SDMMC
            default EXAMPLE_SD_FREQ_DEFAULT if EXAMPLE_USE_SDSPI
            help
                Select the frequency of SD card interface.

            config EXAMPLE_SD_FREQ_PROBING
                bool "Probing frequency (400kHz)"

            config EXAMPLE_SD_FREQ_DEFAULT
                bool "Default frequency (20MHz)"

            config EXAMPLE_SD_FREQ_HIGHSPEED
                bool "High speed frequency (40MHz)"
                depends on EXAMPLE_USE_SDMMC

            config EXAMPLE_SD_FREQ_CUSTOM
                bool "Custom frequency"
        endchoice  # EXAMPLE_SD_CARD_FREQ_PICKER

        config EXAMPLE_SD_FREQ_CUSTOM_VAL
            int "Custom frequency (kHz)"
            default 20000
            depends on EXAMPLE_SD_FREQ_CUSTOM
            help
                Enter the custom frequency of SD card interface.

        if EXAMPLE_USE_SDMMC

            choice EXAMPLE_SDMMC_BUS_WIDTH
                prompt "SD/MMC bus width"
                help
                    Select the bus width of SD or MMC interface.
                    Note that even if 1 line mode is used,
                    D3 pin of the SD card must have a pull-up resistor connected.
                    Otherwise the card may enter SPI mode,
                    the only way to recover from which is to cycle power to the card.

                config EXAMPLE_SDMMC_BUS_WIDTH_4
                    bool "4 lines (D0 - D3)"

                config EXAMPLE_SDMMC_BUS_WIDTH_1
                    bool "1 line (D0)"
            endchoice  # EXAMPLE_SDMMC_BUS_WIDTH

            if SOC_SDMMC_USE_GPIO_MATRIX

                config EXAMPLE_PIN_CMD
                    int "CMD GPIO number"
                    default 35 if IDF_TARGET_ESP32S3

                config EXAMPLE_PIN_CLK
                    int "CLK GPIO number"
                    default 36 if IDF_TARGET_ESP32S3

                config EXAMPLE_PIN_D0
                    int "D0 GPIO number"
                    default 37 if IDF_TARGET_ESP32S3

                if EXAMPLE_SDMMC_BUS_WIDTH_4

                    config EXAMPLE_PIN_D1
                        int "D1 GPIO number"
                        default 38 if IDF_TARGET_ESP32S3

                    config EXAMPLE_PIN_D2
                        int "D2 GPIO number"
                        default 33 if IDF_TARGET_ESP32S3

                    config EXAMPLE_PIN_D3
                        int "D3 GPIO number"
                        default 34 if IDF_TARGET_ESP32S3

                endif  # EXAMPLE_SDMMC_BUS_WIDTH_4

            endif  # SOC_SDMMC_USE_GPIO_MATRIX

        endif  # EXAMPLE_USE_SDMMC

        if EXAMPLE_USE_SDSPI

            config EXAMPLE_PIN_MOSI
                int "MOSI GPIO number"
                default 15 if IDF_TARGET_ESP32
                default 35 if IDF_TARGET_ESP32S2
                default 35 if IDF_TARGET_ESP32S3
                default 5  if IDF_TARGET_ESP32H2
                default 4  # C3 and others

            config EXAMPLE_PIN_MISO
                int "MISO GPIO number"
                default 2 if IDF_TARGET_ESP32
                default 37 if IDF_TARGET_ESP32S2
                default 37 if IDF_TARGET_ESP32S3
                default 0  if IDF_TARGET_ESP32H2
                default 6  # C3 and others

            config EXAMPLE_PIN_CLK
                int "CLK GPIO number"
                default 14 if IDF_TARGET_ESP32
                default 36 if IDF_TARGET_ESP32S2
                default 36 if IDF_TARGET_ESP32S3
                default 4  if IDF_TARGET_ESP32H2
                default 5  # C3 and others

            config EXAMPLE_PIN_CS
                int "CS GPIO number"
                default 13 if IDF_TARGET_ESP32
                default 34 if IDF_TARGET_ESP32S2
                default 34 if IDF_TARGET_ESP32S3
                default 1  # C3 and others

        endif  # EXAMPLE_USE_SDSPI

    endmenu  # "SD card test config"

endmenu  # "Performance Monitor Example Configuration"
```
