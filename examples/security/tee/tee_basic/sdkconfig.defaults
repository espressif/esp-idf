## examples/storage/perf_benchmark/sdkconfig.defaults
```kconfig
CONFIG_PARTITION_TABLE_CUSTOM=y
CONFIG_PARTITION_TABLE_CUSTOM_FILENAME="partitions_example.csv"
CONFIG_PARTITION_TABLE_FILENAME="partitions_example.csv"
CONFIG_PARTITION_TABLE_OFFSET=0x9000
CONFIG_ESP_TASK_WDT_EN=n

# FATFS
CONFIG_FATFS_VFS_FSTAT_BLKSIZE=4096

# LittleFS
CONFIG_LITTLEFS_SDMMC_SUPPORT=y

# SPI flash
CONFIG_ESPTOOLPY_FLASHMODE_QIO=y
CONFIG_ESPTOOLPY_FLASHMODE="qio"
CONFIG_ESPTOOLPY_FLASHSIZE_4MB=y
```

## examples/storage/sd_card/sdmmc/main/Kconfig.projbuild
```kconfig
menu "SD/MMC Example Configuration"

    config EXAMPLE_FORMAT_IF_MOUNT_FAILED
        bool "Format the card if mount failed"
        default n
        help
            If this config item is set, format_if_mount_failed will be set to true and the card will be formatted if
            the mount has failed.

    config EXAMPLE_FORMAT_SD_CARD
        bool "Format the card as a part of the example"
        default n
        help
            If this config item is set, the card will be formatted as a part of the example.

    choice EXAMPLE_SDMMC_BUS_WIDTH
        prompt "SD/MMC bus width"
        default EXAMPLE_SDMMC_BUS_WIDTH_4
        help
            Select the bus width of SD or MMC interface.
            Note that even if 1 line mode is used, D3 pin of the SD card must have a pull-up resistor connected.
            Otherwise the card may enter SPI mode, the only way to recover from which is to cycle power to the card.

        config EXAMPLE_SDMMC_BUS_WIDTH_4
            bool "4 lines (D0 - D3)"

        config EXAMPLE_SDMMC_BUS_WIDTH_1
            bool "1 line (D0)"
    endchoice

    choice EXAMPLE_SDMMC_SPEED_MODE
        prompt "SD/MMC speed mode"
        default EXAMPLE_SDMMC_SPEED_DS

        config EXAMPLE_SDMMC_SPEED_DS
            bool "Default Speed"
        config EXAMPLE_SDMMC_SPEED_HS
            bool "High Speed"
        config EXAMPLE_SDMMC_SPEED_UHS_I_SDR50
            bool "UHS-I SDR50 (100 MHz, 50 MB/s)"
            depends on SOC_SDMMC_UHS_I_SUPPORTED
        config EXAMPLE_SDMMC_SPEED_UHS_I_DDR50
            bool "UHS-I DDR50 (50 MHz, 50 MB/s)"
            depends on SOC_SDMMC_UHS_I_SUPPORTED
        config EXAMPLE_SDMMC_SPEED_UHS_I_SDR104
            bool "UHS-I SDR104 (200 MHz, 100 MB/s)"
            depends on SOC_SDMMC_UHS_I_SUPPORTED
    endchoice

    config EXAMPLE_PIN_CMD
        int
        prompt "CMD GPIO number" if SOC_SDMMC_USE_GPIO_MATRIX
        default 35 if IDF_TARGET_ESP32S3
        default 44 if IDF_TARGET_ESP32P4
        default 15 if IDF_TARGET_ESP32

    config EXAMPLE_PIN_CLK
        int
        prompt "CLK GPIO number" if SOC_SDMMC_USE_GPIO_MATRIX
        default 36 if IDF_TARGET_ESP32S3
        default 43 if IDF_TARGET_ESP32P4
        default 14 if IDF_TARGET_ESP32

    config EXAMPLE_PIN_D0
        int
        prompt "D0 GPIO number" if SOC_SDMMC_USE_GPIO_MATRIX
        default 37 if IDF_TARGET_ESP32S3
        default 39 if IDF_TARGET_ESP32P4
        default 2 if IDF_TARGET_ESP32

    if EXAMPLE_SDMMC_BUS_WIDTH_4

        config EXAMPLE_PIN_D1
            int
            prompt "D1 GPIO number" if SOC_SDMMC_USE_GPIO_MATRIX
            default 38 if IDF_TARGET_ESP32S3
            default 40 if IDF_TARGET_ESP32P4
            default 4 if IDF_TARGET_ESP32


        config EXAMPLE_PIN_D2
            int
            prompt "D2 GPIO number" if SOC_SDMMC_USE_GPIO_MATRIX
            default 33 if IDF_TARGET_ESP32S3
            default 41 if IDF_TARGET_ESP32P4
            default 12 if IDF_TARGET_ESP32


        config EXAMPLE_PIN_D3
            int
            prompt "D3 GPIO number" if SOC_SDMMC_USE_GPIO_MATRIX
            default 34 if IDF_TARGET_ESP32S3
            default 42 if IDF_TARGET_ESP32P4
            default 13 if IDF_TARGET_ESP32

    endif  # EXAMPLE_SDMMC_BUS_WIDTH_4

    config EXAMPLE_DEBUG_PIN_CONNECTIONS
        bool "Debug sd pin connections and pullup strength"
        default n

    config EXAMPLE_ENABLE_ADC_FEATURE
        bool "Enable ADC feature"
        depends on EXAMPLE_DEBUG_PIN_CONNECTIONS
        default y if IDF_TARGET_ESP32
        default n

    config EXAMPLE_ADC_UNIT
        int "ADC Unit"
        depends on EXAMPLE_ENABLE_ADC_FEATURE
        default 1 if IDF_TARGET_ESP32
        default 1

    config EXAMPLE_ADC_PIN_CLK
        int "CLK mapped ADC pin"
        depends on EXAMPLE_ENABLE_ADC_FEATURE
        default 6 if IDF_TARGET_ESP32
        default 1

    config EXAMPLE_ADC_PIN_CMD
        int "CMD mapped ADC pin"
        depends on EXAMPLE_ENABLE_ADC_FEATURE
        default 3 if IDF_TARGET_ESP32
        default 1

    config EXAMPLE_ADC_PIN_D0
        int "D0 mapped ADC pin"
        depends on EXAMPLE_ENABLE_ADC_FEATURE
        default 2 if IDF_TARGET_ESP32
        default 1

    if EXAMPLE_SDMMC_BUS_WIDTH_4

        config EXAMPLE_ADC_PIN_D1
            int "D1 mapped ADC pin"
            depends on EXAMPLE_ENABLE_ADC_FEATURE
            default 0 if IDF_TARGET_ESP32
            default 1

        config EXAMPLE_ADC_PIN_D2
            int "D2 mapped ADC pin"
            depends on EXAMPLE_ENABLE_ADC_FEATURE
            default 5 if IDF_TARGET_ESP32
            default 1

        config EXAMPLE_ADC_PIN_D3
            int "D3 mapped ADC pin"
            depends on EXAMPLE_ENABLE_ADC_FEATURE
            default 4 if IDF_TARGET_ESP32
            default 1

    endif  # EXAMPLE_SDMMC_BUS_WIDTH_4

    config EXAMPLE_SD_PWR_CTRL_LDO_INTERNAL_IO
        depends on SOC_SDMMC_IO_POWER_EXTERNAL
        bool "SD power supply comes from internal LDO IO (READ HELP!)"
        default y
        help
            Only needed when the SD card is connected to specific IO pins which can be used for high-speed SDMMC.
            Please read the schematic first and check if the SD VDD is connected to any internal LDO output.
            Unselect this option if the SD card is powered by an external power supply.

    config EXAMPLE_SD_PWR_CTRL_LDO_IO_ID
        depends on SOC_SDMMC_IO_POWER_EXTERNAL && EXAMPLE_SD_PWR_CTRL_LDO_INTERNAL_IO
        int "LDO ID"
        default 4 if IDF_TARGET_ESP32P4
        help
            Please read the schematic first and input your LDO ID.
endmenu
```

## examples/storage/sd_card/sdspi/main/Kconfig.projbuild
```kconfig
menu "SD SPI Example Configuration"

    config EXAMPLE_FORMAT_IF_MOUNT_FAILED
        bool "Format the card if mount failed"
        default n
        help
            If this config item is set, format_if_mount_failed will be set to true and the card will be formatted if
            the mount has failed.

    config EXAMPLE_FORMAT_SD_CARD
        bool "Format the card as a part of the example"
        default n
        help
            If this config item is set, the card will be formatted as a part of the example.

    config EXAMPLE_PIN_MOSI
        int "MOSI GPIO number"
        default 15 if IDF_TARGET_ESP32
        default 35 if IDF_TARGET_ESP32S2
        default 4 if IDF_TARGET_ESP32S3
        default 5  if IDF_TARGET_ESP32H2
        default 36 if IDF_TARGET_ESP32P4
        default 4  # C3 and others

    config EXAMPLE_PIN_MISO
        int "MISO GPIO number"
        default 2 if IDF_TARGET_ESP32
        default 37 if IDF_TARGET_ESP32S2
        default 5 if IDF_TARGET_ESP32S3
        default 0  if IDF_TARGET_ESP32H2
        default 47 if IDF_TARGET_ESP32P4
        default 6  # C3 and others

    config EXAMPLE_PIN_CLK
        int "CLK GPIO number"
        default 14 if IDF_TARGET_ESP32
        default 36 if IDF_TARGET_ESP32S2
        default 2 if IDF_TARGET_ESP32S3
        default 4  if IDF_TARGET_ESP32H2
        default 53 if IDF_TARGET_ESP32P4
        default 5  # C3 and others

    config EXAMPLE_PIN_CS
        int "CS GPIO number"
        default 13 if IDF_TARGET_ESP32
        default 34 if IDF_TARGET_ESP32S2
        default 8 if IDF_TARGET_ESP32S3
        default 33 if IDF_TARGET_ESP32P4
        default 1  # C3 and others

    config EXAMPLE_DEBUG_PIN_CONNECTIONS
        bool "Debug sd pin connections and pullup strength"
        default n

    config EXAMPLE_ENABLE_ADC_FEATURE
        bool "Enable ADC feature"
        depends on EXAMPLE_DEBUG_PIN_CONNECTIONS
        default y if IDF_TARGET_ESP32
        default n

    config EXAMPLE_ADC_UNIT
        int "ADC Unit"
        depends on EXAMPLE_DEBUG_PIN_CONNECTIONS
        default 1 if IDF_TARGET_ESP32
        default 0 if IDF_TARGET_ESP32S3
        default 1

    config EXAMPLE_ADC_PIN_MOSI
        int "MOSI mapped ADC pin"
        depends on EXAMPLE_ENABLE_ADC_FEATURE
        default 3 if IDF_TARGET_ESP32
        default 7 if IDF_TARGET_ESP32S3
        default 1

    config EXAMPLE_ADC_PIN_MISO
        int "MISO mapped ADC pin"
        depends on EXAMPLE_ENABLE_ADC_FEATURE
        default 2 if IDF_TARGET_ESP32
        default 1 if IDF_TARGET_ESP32S3
        default 1

    config EXAMPLE_ADC_PIN_CLK
        int "CLK mapped ADC pin"
        depends on EXAMPLE_ENABLE_ADC_FEATURE
        default 6 if IDF_TARGET_ESP32
        default 0 if IDF_TARGET_ESP32S3
        default 1

    config EXAMPLE_ADC_PIN_CS
        int "CS mapped ADC pin"
        depends on EXAMPLE_ENABLE_ADC_FEATURE
        default 4 if IDF_TARGET_ESP32
        default 6 if IDF_TARGET_ESP32S3
        default 1

    config EXAMPLE_SD_PWR_CTRL_LDO_INTERNAL_IO
        depends on SOC_SDMMC_IO_POWER_EXTERNAL
        bool "SD power supply comes from internal LDO IO (READ HELP!)"
        default n
        help
            Only needed when the SD card is connected to specific IO pins which can be used for high-speed SDMMC.
            Please read the schematic first and check if the SD VDD is connected to any internal LDO output.
            Unselect this option if the SD card is powered by an external power supply.

    config EXAMPLE_SD_PWR_CTRL_LDO_IO_ID
        depends on SOC_SDMMC_IO_POWER_EXTERNAL && EXAMPLE_SD_PWR_CTRL_LDO_INTERNAL_IO
        int "LDO ID"
        default 4 if IDF_TARGET_ESP32P4
        help
            Please read the schematic first and input your LDO ID.
endmenu
```

## examples/storage/spiffs/main/Kconfig.projbuild
```kconfig
menu "SPIFFS Example menu"

    config EXAMPLE_SPIFFS_CHECK_ON_START
        bool "Run SPIFFS_check on every start-up"
        default y
        help
            If this config item is set, esp_spiffs_check() will be run on every start-up.
            Slow on large flash sizes.
endmenu
```

## examples/storage/spiffs/sdkconfig.defaults
```kconfig
CONFIG_PARTITION_TABLE_CUSTOM=y
CONFIG_PARTITION_TABLE_CUSTOM_FILENAME="partitions_example.csv"
CONFIG_PARTITION_TABLE_CUSTOM_APP_BIN_OFFSET=0x10000
CONFIG_PARTITION_TABLE_FILENAME="partitions_example.csv"
CONFIG_APP_OFFSET=0x10000
```

## examples/system/app_trace_to_host/main/Kconfig.projbuild
```kconfig
menu "Example Configuration"

config CUSTOM_RTC_CLK_8M_DIV
   bool "Set custom RTC 8 MHz clock divider to lower CW frequency (CHECK HELP FIRST)"
   default "n"
   help
       Set custom / non standard divider for RTC 8 MHz clock.
       This is to lower minimum frequency of cosine waveform generator (CW)
       in order to provide sinusoidal signal at about 50 or 60 Hz.
       
       WARNINIG: setting non standard divider for the RTC 8 MHz clock
       will affect functionality of RTC peripherals other than CW.

       This includes ADC sampling, and will in general make
       all RTC register access slower. 

       DO NOT use this option / change default RTC 8 MHz clock divider
       in your applications, if you are not sure what you are doing.

endmenu
```

## examples/system/app_trace_to_host/sdkconfig.defaults
```kconfig
# Defaults for generating a new "sdkconfig" file (project settings).
# https://docs.espressif.com/projects/esp-idf/en/latest/esp32/api-guides/build-system.html#custom-sdkconfig-defaults
#
# NOTE - if this file changes, to get new defaults, you must erase any existing
# "sdkconfig" file (this will undo manual settings from "idf.py menuconfig").

# Enable application tracing by default
CONFIG_APPTRACE_DEST_JTAG=y
CONFIG_APPTRACE_ENABLE=y
# Disable WiFi stack by default
CONFIG_WIFI_ENABLED=n
```
