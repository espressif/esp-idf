/*
 * SPDX-FileCopyrightText: 2026 Espressif Systems (Shanghai) CO LTD
 *
 * SPDX-License-Identifier: Unlicense OR CC0-1.0
 */

/*
 * Supplementary ULP linker script template processed by ldgen.
 *
 * ldgen replaces the mapping[ulp_math_fast] marker with explicit symbol
 * entries derived from the component .lf fragment files. The generated
 * output is linked via -T alongside the main lp_core_riscv.ld.
 */
SECTIONS
{
    . = ADDR(.bss) + SIZEOF(.bss);
    .ulp_math_fast ALIGN(4) :
    {
        mapping[ulp_math_fast]
        *(.ulp_math_fast .ulp_math_fast.*)
    } > ram
}
