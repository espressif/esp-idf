## examples/system/app_trace_to_plot/sdkconfig.defaults
```kconfig
# Enable application tracing by default
CONFIG_APPTRACE_ENABLE=y
CONFIG_APPTRACE_DEST_JTAG=y
```

## examples/system/base_mac_address/main/Kconfig.projbuild
```kconfig
menu "Example Configuration"

    choice BASE_MAC_ADDRESS_STORAGE
        prompt "Storage location of the base MAC address"
        default BASE_MAC_STORED_EFUSE_BLK0
        help
            Select the storage location of the base MAC addresses.
            1. eFuse BLK0: The "Default (Espressif factory)" selection. The
            default base MAC address is written to words 1 and 2 of eFuse block
            0 when the chip was manufactured. Call esp_efuse_mac_get_default()
            read retrieve the "eFuse BLK0" MAC address.
            2. eFuse BLK3: A custom base MAC address is burned by the user into
            eFuse word 0 of block 3. Call esp_efuse_mac_get_custom() to read
            the "eFuse BLK3" MAC address.
            3. Other External Storage: Selecting this option will cause the
            example to call external_storage_mac_get() which is defined in this
            example to simply return a MAC address preset in software. Users
            should modify this function to access their desired storage mediums
            (e.g. flash, EEPROM etc).

        config BASE_MAC_STORED_EFUSE_BLK0
            bool "Default (Espressif factory) eFuse BLK0"
        config BASE_MAC_STORED_EFUSE_BLK3
            bool "Custom eFuse BLK3"
        config BASE_MAC_STORED_OTHER_EXTERNAL_STORAGE
            bool "Other external storage"
    endchoice

    choice BASE_MAC_STORED_EFUSE_BLK3_ERROR_BEHAV
        prompt "Behavior when retrieving eFuse BLK3 fails"
        depends on BASE_MAC_STORED_EFUSE_BLK3
        default BASE_MAC_STORED_EFUSE_BLK3_ERROR_DEFAULT
        help
            Select the behavior when reading base MAC address "eFuse BLK3" fails
            (i.e. the retrieved result is all 0).
            - If "Abort" is selected, the ESP32 will abort.
            - If "Use the default base MAC address from BLK0 of eFuse" is
            selected, the default "eFuse BLK0" will be used instead.

        config BASE_MAC_STORED_EFUSE_BLK3_ERROR_ABORT
            bool "Abort"
        config BASE_MAC_STORED_EFUSE_BLK3_ERROR_DEFAULT
            bool "Use the default base MAC address eFuse BLK0"
    endchoice

endmenu
```

## examples/system/console/advanced/main/Kconfig.projbuild
```kconfig
menu "Example Configuration"

    config CONSOLE_STORE_HISTORY
        bool "Store command history in flash"
        default y
        help
            Linenoise line editing library provides functions to save and load
            command history. If this option is enabled, initializes a FAT filesystem
            and uses it to store command history.

    config CONSOLE_IGNORE_EMPTY_LINES
        bool "Ignore empty lines inserted into the console"
        default y
        help
            If an empty line is inserted to the console, the Console can either
            ignore empty lines (the example would continue), or break on empty lines
            (the example would stop after an empty line).

endmenu
```

## examples/system/console/advanced/sdkconfig.defaults
```kconfig
# Reduce bootloader log verbosity
CONFIG_BOOTLOADER_LOG_LEVEL_WARN=y
CONFIG_BOOTLOADER_LOG_LEVEL=2

# Increase main task stack size
CONFIG_ESP_MAIN_TASK_STACK_SIZE=7168

# Enable filesystem
CONFIG_PARTITION_TABLE_CUSTOM=y
CONFIG_PARTITION_TABLE_CUSTOM_FILENAME="partitions_example.csv"
CONFIG_PARTITION_TABLE_FILENAME="partitions_example.csv"

# Enable FreeRTOS stats formatting functions, needed for 'tasks' command
CONFIG_FREERTOS_USE_TRACE_FACILITY=y
CONFIG_FREERTOS_USE_STATS_FORMATTING_FUNCTIONS=y

CONFIG_ESPTOOLPY_FLASHSIZE_4MB=y

# On chips with USB serial, disable secondary console which does not make sense when using console component
CONFIG_ESP_CONSOLE_SECONDARY_NONE=y
```

## examples/system/console/advanced_usb_cdc/sdkconfig.defaults
```kconfig
# Enable USB console
CONFIG_ESP_CONSOLE_USB_CDC=y

# On chips with USB serial, disable secondary console which does not make sense when using console component
CONFIG_ESP_CONSOLE_SECONDARY_NONE=y

# Reduce bootloader log verbosity
CONFIG_BOOTLOADER_LOG_LEVEL_WARN=y
CONFIG_BOOTLOADER_LOG_LEVEL=2

# Enable FreeRTOS stats formatting functions, needed for 'tasks' command
CONFIG_FREERTOS_USE_TRACE_FACILITY=y
CONFIG_FREERTOS_USE_STATS_FORMATTING_FUNCTIONS=y
```

## examples/system/console/basic/main/Kconfig.projbuild
```kconfig
menu "Example Configuration"

    config CONSOLE_STORE_HISTORY
        bool "Store command history in flash"
        default y
        help
            Linenoise line editing library provides functions to save and load
            command history. If this option is enabled, initalizes a FAT filesystem
            and uses it to store command history.

    config CONSOLE_MAX_COMMAND_LINE_LENGTH
        int "Maximum command line length"
        default 1024
        help
            This value marks the maximum length of a single command line. Once it is
            reached, no more characters will be accepted by the console.

endmenu
```

## examples/system/console/main/Kconfig.projbuild
```kconfig
menu "Example Configuration"

    config STORE_HISTORY
        bool "Store command history in flash"
        default y
        help
            Linenoise line editing library provides functions to save and load
            command history. If this option is enabled, initalizes a FAT filesystem
            and uses it to store command history.

endmenu
```

## examples/system/console/sdkconfig.defaults
```kconfig
# Reduce bootloader log verbosity
CONFIG_LOG_BOOTLOADER_LEVEL_WARN=y
CONFIG_LOG_BOOTLOADER_LEVEL=2

# Increase main task stack size
CONFIG_MAIN_TASK_STACK_SIZE=7168

# Enable filesystem
CONFIG_PARTITION_TABLE_CUSTOM=y
CONFIG_PARTITION_TABLE_CUSTOM_FILENAME="partitions_example.csv"
CONFIG_PARTITION_TABLE_CUSTOM_APP_BIN_OFFSET=0x10000
CONFIG_PARTITION_TABLE_FILENAME="partitions_example.csv"
CONFIG_APP_OFFSET=0x10000

# Enable FreeRTOS stats formatting functions, needed for 'tasks' command
CONFIG_FREERTOS_USE_TRACE_FACILITY=y
CONFIG_FREERTOS_USE_STATS_FORMATTING_FUNCTIONS=y
```

## examples/system/cpp_exceptions/sdkconfig.defaults
```kconfig
# Enable C++ exceptions and set emergency pool size for exception objects
CONFIG_CXX_EXCEPTIONS=y
CONFIG_CXX_EXCEPTIONS_EMG_POOL_SIZE=1024
```
