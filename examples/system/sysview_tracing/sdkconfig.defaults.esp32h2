## examples/system/sysview_tracing/sdkconfig.defaults.esp32h2
```kconfig
CONFIG_IDF_TARGET="esp32h2"
CONFIG_APPTRACE_UART_TX_GPIO=24
CONFIG_APPTRACE_UART_RX_GPIO=23
```

## examples/system/sysview_tracing/sdkconfig.defaults.esp32p4
```kconfig
CONFIG_IDF_TARGET="esp32p4"
CONFIG_APPTRACE_UART_TX_GPIO=37
CONFIG_APPTRACE_UART_RX_GPIO=38
```

## examples/system/sysview_tracing/sdkconfig.defaults.esp32s2
```kconfig
CONFIG_IDF_TARGET="esp32s2"
CONFIG_APPTRACE_UART_TX_GPIO=43
CONFIG_APPTRACE_UART_RX_GPIO=44
```

## examples/system/sysview_tracing_heap_log/sdkconfig.defaults
```kconfig
# Enable single core mode by default
CONFIG_FREERTOS_UNICORE=y
# 1ms tick period
CONFIG_FREERTOS_HZ=1000
# Enable application tracing by default
CONFIG_APPTRACE_DEST_JTAG=y
CONFIG_APPTRACE_MEMBUFS_APPTRACE_PROTO_ENABLE=y
CONFIG_APPTRACE_ENABLE=y
# Enable FreeRTOS SystemView Tracing by default
CONFIG_APPTRACE_SV_ENABLE=y
CONFIG_APPTRACE_SV_TS_SOURCE_GPTIMER=y
CONFIG_APPTRACE_SV_EVT_OVERFLOW_ENABLE=y
CONFIG_APPTRACE_SV_EVT_ISR_ENTER_ENABLE=y
CONFIG_APPTRACE_SV_EVT_ISR_EXIT_ENABLE=y
CONFIG_APPTRACE_SV_EVT_ISR_TO_SCHED_ENABLE=y
CONFIG_APPTRACE_SV_EVT_TASK_START_EXEC_ENABLE=y
CONFIG_APPTRACE_SV_EVT_TASK_STOP_EXEC_ENABLE=y
CONFIG_APPTRACE_SV_EVT_TASK_START_READY_ENABLE=y
CONFIG_APPTRACE_SV_EVT_TASK_STOP_READY_ENABLE=y
CONFIG_APPTRACE_SV_EVT_TASK_CREATE_ENABLE=y
CONFIG_APPTRACE_SV_EVT_TASK_TERMINATE_ENABLE=y
CONFIG_APPTRACE_SV_EVT_IDLE_ENABLE=y
CONFIG_APPTRACE_SV_EVT_TIMER_ENTER_ENABLE=y
CONFIG_APPTRACE_SV_EVT_TIMER_EXIT_ENABLE=y
# Disable color output in logs
CONFIG_LOG_COLORS=n
# Enable heap tracing to host
CONFIG_HEAP_TRACING_TOHOST=y
```

## examples/system/tracing/app_trace_basic/sdkconfig.defaults
```kconfig
# Enable application tracing by default
CONFIG_ESP_TRACE_ENABLE=y
CONFIG_ESP_TRACE_LIB_NONE=y
CONFIG_ESP_TRACE_TRANSPORT_APPTRACE=y
```

## examples/system/tracing/app_trace_to_plot/sdkconfig.defaults
```kconfig
# Enable application tracing by default
CONFIG_ESP_TRACE_ENABLE=y
CONFIG_ESP_TRACE_LIB_NONE=y
CONFIG_ESP_TRACE_TRANSPORT_APPTRACE=y
CONFIG_APPTRACE_DEST_JTAG=y
```

## examples/system/tracing/function_tracing/sdkconfig.defaults
```kconfig
# 1ms tick period
CONFIG_FREERTOS_HZ=1000
# Enable SystemView tracing by default
CONFIG_ESP_TRACE_ENABLE=y
CONFIG_ESP_TRACE_LIB_EXTERNAL=y
CONFIG_ESP_TRACE_TS_SOURCE_ESP_TIMER=y
CONFIG_SEGGER_SYSVIEW_EVT_TASK_START_EXEC_ENABLE=y
CONFIG_SEGGER_SYSVIEW_EVT_TASK_STOP_EXEC_ENABLE=y
CONFIG_SEGGER_SYSVIEW_EVT_TASK_CREATE_ENABLE=y

# Compiler-instrumented function tracing
CONFIG_ESP_TRACE_FUNCTION_TRACE=y
```

## examples/system/tracing/gcov/main/Kconfig.projbuild
```kconfig
menu "Example Configuration"

    orsource "$IDF_PATH/examples/common_components/env_caps/$IDF_TARGET/Kconfig.env_caps"

    config BLINK_GPIO
        int "Blink GPIO number"
        range ENV_GPIO_RANGE_MIN ENV_GPIO_OUT_RANGE_MAX
        default 8 if IDF_TARGET_ESP32C3 || IDF_TARGET_ESP32H2 || IDF_TARGET_ESP32C2
        default 18 if IDF_TARGET_ESP32S2
        default 48 if IDF_TARGET_ESP32S3
        default 5
        help
            GPIO number (IOxx) to blink on and off or the RMT signal for the addressable LED.
            Some GPIOs are used for other purposes (flash connections, etc.) and cannot be used to blink.

endmenu
```

## examples/system/tracing/sysview_tracing_heap_log/sdkconfig.defaults
```kconfig
# 1ms tick period
CONFIG_FREERTOS_HZ=1000
# Enable application tracing by default
CONFIG_ESP_TRACE_ENABLE=y
CONFIG_ESP_TRACE_LIB_EXTERNAL=y
CONFIG_ESP_TRACE_TRANSPORT_APPTRACE=y
CONFIG_ESP_TRACE_TS_SOURCE_GPTIMER=y

# FreeRTOS SystemView Tracing Settings
CONFIG_SEGGER_SYSVIEW_EVT_OVERFLOW_ENABLE=y
CONFIG_SEGGER_SYSVIEW_EVT_ISR_ENTER_ENABLE=y
CONFIG_SEGGER_SYSVIEW_EVT_ISR_EXIT_ENABLE=y
CONFIG_SEGGER_SYSVIEW_EVT_ISR_TO_SCHED_ENABLE=y
CONFIG_SEGGER_SYSVIEW_EVT_TASK_START_EXEC_ENABLE=y
CONFIG_SEGGER_SYSVIEW_EVT_TASK_STOP_EXEC_ENABLE=y
CONFIG_SEGGER_SYSVIEW_EVT_TASK_START_READY_ENABLE=y
CONFIG_SEGGER_SYSVIEW_EVT_TASK_STOP_READY_ENABLE=y
CONFIG_SEGGER_SYSVIEW_EVT_TASK_CREATE_ENABLE=y
CONFIG_SEGGER_SYSVIEW_EVT_TASK_TERMINATE_ENABLE=y
CONFIG_SEGGER_SYSVIEW_EVT_IDLE_ENABLE=y
CONFIG_SEGGER_SYSVIEW_EVT_TIMER_ENTER_ENABLE=y
CONFIG_SEGGER_SYSVIEW_EVT_TIMER_EXIT_ENABLE=y
# Disable color output in logs
CONFIG_LOG_COLORS=n
# Enable heap tracing to host
CONFIG_HEAP_TRACING_TOHOST=y
# For RISC-V targets
CONFIG_ESP_SYSTEM_USE_FRAME_POINTER=y
```

## examples/system/tracing/sysview_tracing_heap_log/sdkconfig.defaults.esp32p4
```kconfig
# Increase size of bootloader due to frame pointer. Only overflowed on P4.
CONFIG_PARTITION_TABLE_OFFSET=0x10000
```

## examples/system/ulp/lp_core/build_system_v2/main/ulp/sdkconfig.defaults
```kconfig
# Override the default clamp max value for this ULP application
CONFIG_ULP_CLAMP_MAX_VALUE=100
```

## examples/system/ulp/lp_core/gpio_intr_pulse_counter/main/Kconfig.projbuild
```kconfig
menu "Example Configuration"
    config EXAMPLE_PULSE_COUNT_PIN
        int "Input pin for the pulse counter"
        default 6
        help
            GPIO pin used as the input for the pulse counter

    config EXAMPLE_PULSE_COUNT_WAKEUP_LIMIT
        int "Wake-up pulse count limit"
        default 10
        help
            Number of pulses counted after which the ULP will wake up the main CPU

    config EXAMPLE_PULSE_COUNT_SIMULATE
        bool "Simulate pulses on input pin"
        default n
        help
            The ULP will periodically toggle the input pin to simulate pulses

endmenu
```

## examples/system/ulp/lp_core/inter_cpu_critical_section/sdkconfig.defaults
```kconfig
# Enable LP Core
CONFIG_ULP_COPROC_ENABLED=y
CONFIG_ULP_COPROC_TYPE_LP_CORE=y
CONFIG_ULP_COPROC_RESERVE_MEM=8192

# Route LP Core output to HP
CONFIG_ULP_PANIC_OUTPUT_ENABLE=y
CONFIG_ULP_HP_UART_CONSOLE_PRINT=y

# Extend Task Watchdog timeout period to 10 seconds
CONFIG_ESP_TASK_WDT_TIMEOUT_S=10
```

## examples/system/ulp/lp_core/lp_adc/main/Kconfig.projbuild
```kconfig
menu "Example Configuration"

    config EXAMPLE_LP_ADC1_CHANNEL_0_SELECT
        int "LP ADC1 Channel 0 Select"
        default 4
        range 0 7
        help
            Select the channel to be used for LP ADC1 Channel 0

    config EXAMPLE_LP_ADC1_CHANNEL_1_SELECT
        int "LP ADC1 Channel 1 Select"
        default 5
        range 0 7
        help
            Select the channel to be used for LP ADC1 Channel 1

endmenu
```

## examples/system/ulp/lp_core/lp_mailbox/sdkconfig.defaults
```kconfig
# Enable LP Core
CONFIG_ULP_COPROC_ENABLED=y
CONFIG_ULP_COPROC_TYPE_LP_CORE=y
CONFIG_ULP_COPROC_RESERVE_MEM=8192
```

## examples/system/ulp/sdkconfig.defaults
```kconfig
# Enable ULP
CONFIG_ULP_COPROC_ENABLED=y
CONFIG_ULP_COPROC_RESERVE_MEM=1024
# Some flash chips need extra time to wake up
# Set this a bit higher to improve out-of-the-box experience
CONFIG_ESP32_DEEP_SLEEP_WAKEUP_DELAY=500
# Set log level to Warning to produce clean output
CONFIG_LOG_BOOTLOADER_LEVEL_WARN=y
CONFIG_LOG_BOOTLOADER_LEVEL=2
CONFIG_LOG_DEFAULT_LEVEL_WARN=y
CONFIG_LOG_DEFAULT_LEVEL=2
```

## examples/system/ulp/ulp_fsm/ulp_adc/sdkconfig.defaults
```kconfig
# Enable ULP
CONFIG_ULP_COPROC_ENABLED=y
CONFIG_ULP_COPROC_TYPE_FSM=y
CONFIG_ULP_COPROC_RESERVE_MEM=1024
# Set log level to Warning to produce clean output
CONFIG_BOOTLOADER_LOG_LEVEL_WARN=y
CONFIG_BOOTLOADER_LOG_LEVEL=2
CONFIG_LOG_DEFAULT_LEVEL_WARN=y
CONFIG_LOG_DEFAULT_LEVEL=2
CONFIG_BOOTLOADER_SKIP_VALIDATE_IN_DEEP_SLEEP=y
```

## examples/system/ulp/ulp_fsm_riscv_combined/counter/sdkconfig.defaults
```kconfig
# Enable both ULP types
CONFIG_ULP_COPROC_ENABLED=y
CONFIG_ULP_COPROC_TYPE_FSM=y
CONFIG_ULP_COPROC_TYPE_RISCV=y
CONFIG_ULP_COPROC_RESERVE_MEM=4096

# Set log level to Info to see output
CONFIG_BOOTLOADER_LOG_LEVEL_INFO=y
CONFIG_BOOTLOADER_LOG_LEVEL=3
CONFIG_LOG_DEFAULT_LEVEL_INFO=y
CONFIG_LOG_DEFAULT_LEVEL=3
```

## examples/system/ulp/ulp_riscv/interrupts/main/Kconfig.projbuild
```kconfig
menu "ULP RISC-V Interrupt Example Configuration"

    config EXAMPLE_GPIO_INT
        int "GPIO interrupt pin"
        range 0 21
        default 0
        help
            GPIO number to trigger an interrupt on the ULP RISC-V core.

endmenu
```

## examples/system/ulp/ulp_riscv/uart_print/main/Kconfig.projbuild
```kconfig
menu "ULP-RISCV UART TX Example Configuration"

    orsource "$IDF_PATH/examples/common_components/env_caps/$IDF_TARGET/Kconfig.env_caps"

    config EXAMPLE_UART_TXD
        int "UART TXD pin number"
        range ENV_GPIO_RANGE_MIN ENV_GPIO_OUT_RANGE_MAX
        default 4
        help
            GPIO number for UART TX pin. See UART documentation for more information
            about available pin numbers for UART.

endmenu
```

## examples/system/ulp_adc/sdkconfig.defaults
```kconfig
# Enable ULP
CONFIG_ULP_COPROC_ENABLED=y
CONFIG_ULP_COPROC_RESERVE_MEM=1024
# Set log level to Warning to produce clean output
CONFIG_LOG_BOOTLOADER_LEVEL_WARN=y
CONFIG_LOG_BOOTLOADER_LEVEL=2
CONFIG_LOG_DEFAULT_LEVEL_WARN=y
CONFIG_LOG_DEFAULT_LEVEL=2
```

## examples/system/ulp_fsm/ulp/sdkconfig.defaults
```kconfig
# Set log level to Warning to produce clean output
CONFIG_BOOTLOADER_LOG_LEVEL_WARN=y
CONFIG_BOOTLOADER_LOG_LEVEL=2
CONFIG_LOG_DEFAULT_LEVEL_WARN=y
CONFIG_LOG_DEFAULT_LEVEL=2
CONFIG_BOOTLOADER_SKIP_VALIDATE_IN_DEEP_SLEEP=y
```

## examples/system/ulp_fsm/ulp/sdkconfig.defaults.esp32
```kconfig
# Enable ULP
CONFIG_ESP32_ULP_COPROC_ENABLED=y
CONFIG_ESP32_ULP_COPROC_RESERVE_MEM=1024
```

## examples/system/ulp_fsm/ulp/sdkconfig.defaults.esp32s2
```kconfig
# Enable ULP
CONFIG_ESP32S2_ULP_COPROC_ENABLED=y
CONFIG_ESP32S2_ULP_COPROC_RESERVE_MEM=1024
```
