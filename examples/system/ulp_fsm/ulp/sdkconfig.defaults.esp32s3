## examples/wifi/espnow/main/Kconfig.projbuild
```kconfig
menu "Example Configuration"

    choice ESPNOW_WIFI_MODE
        prompt "WiFi mode"
        default ESPNOW_WIFI_MODE_STATION
        help
            WiFi mode(station or softap).

        config ESPNOW_WIFI_MODE_STATION
            bool "Station"
        config ESPNOW_WIFI_MODE_STATION_SOFTAP
            bool "Softap"
    endchoice

    config ESPNOW_PMK
        string "ESPNOW primary master key"
        default "pmk1234567890123"
        help
            ESPNOW primary master for the example to use. The length of ESPNOW primary master must be 16 bytes.

    config ESPNOW_LMK
        string "ESPNOW local master key"
        default "lmk1234567890123"
        help
            ESPNOW local master for the example to use. The length of ESPNOW local master must be 16 bytes.

    config ESPNOW_CHANNEL
        int "Channel"
        default 1
        range 0 14
        help
            The channel on which sending and receiving ESPNOW data.

    config ESPNOW_SEND_COUNT
        int "Send count"
        default 100
        range 1 65535
        help
            Total count of unicast ESPNOW data to be sent.

    config ESPNOW_SEND_DELAY
        int "Send delay"
        default 1000
        range 0 65535
        help
            Delay between sending two ESPNOW data, unit: ms.

    config ESPNOW_SEND_LEN
        int "Send len"
        range 10 250
        default 10
        help
            Length of ESPNOW data to be sent, unit: byte.

    config ESPNOW_ENABLE_LONG_RANGE
        bool "Enable Long Range"
        default "n"
        help
            When enable long range, the PHY rate of ESP32 will be 512Kbps or 256Kbps

    config ESPNOW_ENABLE_POWER_SAVE
        bool "Enable ESPNOW Power Save"
        default "n"
        select ESP_WIFI_STA_DISCONNECTED_PM_ENABLE
        depends on ESPNOW_WIFI_MODE_STATION
        help
            With ESPNOW power save enabled, chip would be able to wakeup and sleep periodically
            Notice ESP_WIFI_STA_DISCONNECTED_PM_ENABLE is essential at Wi-Fi disconnected

    config ESPNOW_WAKE_WINDOW
        int "ESPNOW wake window, unit in millisecond"
        range 0 65535
        default 50
        depends on ESPNOW_ENABLE_POWER_SAVE
        help
            ESPNOW wake window

    config ESPNOW_WAKE_INTERVAL
        int "ESPNOW wake interval, unit in millisecond"
        range 1 65535
        default 100
        depends on ESPNOW_ENABLE_POWER_SAVE
        help
            ESPNOW wake interval

endmenu
```

## examples/wifi/ftm/main/Kconfig.projbuild
```kconfig
menu "Example Configuration"

    config ESP_FTM_REPORT_LOG_ENABLE
        bool "FTM Report logging"
        default n
        depends on ESP_WIFI_FTM_INITIATOR_SUPPORT
        help
            Select this option to get a detailed report of FTM Procedure with raw values

    config ESP_FTM_REPORT_SHOW_DIAG
        depends on ESP_FTM_REPORT_LOG_ENABLE
        bool "Show dialog tokens"
        default y

    config ESP_FTM_REPORT_SHOW_RTT
        depends on ESP_FTM_REPORT_LOG_ENABLE
        bool "Show RTT values"
        default y

    config ESP_FTM_REPORT_SHOW_T1T2T3T4
        depends on ESP_FTM_REPORT_LOG_ENABLE
        bool "Show T1 to T4"
        default y

    config ESP_FTM_REPORT_SHOW_RSSI
        depends on ESP_FTM_REPORT_LOG_ENABLE
        bool "Show RSSI levels"
        default y

endmenu
```

## examples/wifi/getting_started/softAP/main/Kconfig.projbuild
```kconfig
menu "Example Configuration"

    config ESP_WIFI_SSID
        string "WiFi SSID"
        default "myssid"
        help
            SSID (network name) for the example to connect to.

    config ESP_WIFI_PASSWORD
        string "WiFi Password"
        default "mypassword"
        help
            WiFi password (WPA or WPA2) for the example to use.
    config ESP_WIFI_CHANNEL
        int "WiFi Channel"
        range 1 13
        default 1
        help
            WiFi channel (network channel) for the example to use.

    config ESP_MAX_STA_CONN
        int "Maximal STA connections"
        default 4
        range 1 4 if IDF_TARGET_ESP32C2
        range 1 15
        help
            Maximum number of STAs allowed to connect to the soft-AP (wifi_config_t.ap.max_connection).
            Upper bound matches ESP_WIFI_MAX_CONN_NUM in esp_wifi_types_native.h:
            1-4 on ESP32-C2, 1-15 on other Wi-Fi chips.
            Soft-AP and ESP-NOW share encryption keys; see Wi-Fi driver documentation
            if ESP-NOW is enabled.

    config ESP_GTK_REKEYING_ENABLE
        bool "Enable GTK Rekeying"
        default y
        help
            Flag to enable GTK rekeying.

    config ESP_GTK_REKEY_INTERVAL
        int "GTK rekey interval"
        depends on ESP_GTK_REKEYING_ENABLE
        range 60 65535
        default 600
        help
            GTK rekeying interval in seconds.
endmenu
```

## examples/wifi/getting_started/station/main/Kconfig.projbuild
```kconfig
menu "Example Configuration"

    config ESP_WIFI_SSID
        string "WiFi SSID"
        default "myssid"
        help
            SSID (network name) for the example to connect to.

    config ESP_WIFI_PASSWORD
        string "WiFi Password"
        default "mypassword"
        help
            WiFi password (WPA or WPA2) for the example to use.

    choice ESP_WIFI_SAE_MODE
        prompt "WPA3 SAE mode selection"
        default ESP_STATION_EXAMPLE_WPA3_SAE_PWE_BOTH
        help
            Select mode for SAE as Hunt and Peck, H2E or both.
        config ESP_STATION_EXAMPLE_WPA3_SAE_PWE_HUNT_AND_PECK
            bool "HUNT AND PECK"
        config ESP_STATION_EXAMPLE_WPA3_SAE_PWE_HASH_TO_ELEMENT
            bool "H2E"
            depends on ESP_WIFI_ENABLE_SAE_H2E
        config ESP_STATION_EXAMPLE_WPA3_SAE_PWE_BOTH
            bool "BOTH"
            depends on ESP_WIFI_ENABLE_SAE_H2E
    endchoice

    config ESP_WIFI_PW_ID
        string "PASSWORD IDENTIFIER"
        depends on  ESP_STATION_EXAMPLE_WPA3_SAE_PWE_HASH_TO_ELEMENT|| ESP_STATION_EXAMPLE_WPA3_SAE_PWE_BOTH
        default ""
        help
            password identifier for SAE H2E

    config ESP_MAXIMUM_RETRY
        int "Maximum retry"
        default 5
        help
            Set the Maximum retry to avoid station reconnecting to the AP unlimited when the AP is really inexistent.

    choice ESP_WIFI_SCAN_AUTH_MODE_THRESHOLD
        prompt "WiFi Scan auth mode threshold"
        default ESP_WIFI_AUTH_WPA2_PSK
        help
            The weakest authmode to accept in the scan mode.
            This value defaults to ESP_WIFI_AUTH_WPA2_PSK in case password is present and ESP_WIFI_AUTH_OPEN is used.
            Please select ESP_WIFI_AUTH_WEP/ESP_WIFI_AUTH_WPA_PSK in case AP is operating in WEP/WPA mode.

        config ESP_WIFI_AUTH_OPEN
            bool "OPEN"
        config ESP_WIFI_AUTH_WEP
            bool "WEP"
        config ESP_WIFI_AUTH_WPA_PSK
            bool "WPA PSK"
        config ESP_WIFI_AUTH_WPA2_PSK
            bool "WPA2 PSK"
        config ESP_WIFI_AUTH_WPA_WPA2_PSK
            bool "WPA/WPA2 PSK"
        config ESP_WIFI_AUTH_WPA3_PSK
            bool "WPA3 PSK"
        config ESP_WIFI_AUTH_WPA2_WPA3_PSK
            bool "WPA2/WPA3 PSK"
        config ESP_WIFI_AUTH_WAPI_PSK
            bool "WAPI PSK"
    endchoice

endmenu
```

## examples/wifi/iperf/sdkconfig.defaults
```kconfig
CONFIG_ESP_SYSTEM_EVENT_TASK_STACK_SIZE=4096

CONFIG_FREERTOS_UNICORE=n
CONFIG_FREERTOS_HZ=1000

CONFIG_ESP_INT_WDT=n
CONFIG_ESP_TASK_WDT_EN=n

CONFIG_LWIP_IRAM_OPTIMIZATION=y
CONFIG_LWIP_TCPIP_TASK_PRIO=23

CONFIG_IPERF_TRAFFIC_TASK_PRIORITY=23
CONFIG_IPERF_REPORT_TASK_PRIORITY=24
CONFIG_COMPILER_OPTIMIZATION_PERF=y

CONFIG_PARTITION_TABLE_SINGLE_APP_LARGE=y
```

## examples/wifi/iperf/sdkconfig.defaults.00
```kconfig
CONFIG_MEMMAP_SMP=y

CONFIG_SYSTEM_EVENT_TASK_STACK_SIZE=4096

CONFIG_INT_WDT=
CONFIG_TASK_WDT=
```

## examples/wifi/iperf/sdkconfig.defaults.esp32
```kconfig
#
# ESP32-specific
#
CONFIG_ESP_WIFI_STATIC_RX_BUFFER_NUM=16
CONFIG_ESP_WIFI_DYNAMIC_RX_BUFFER_NUM=64
CONFIG_ESP_WIFI_DYNAMIC_TX_BUFFER_NUM=64
CONFIG_ESP_WIFI_AMPDU_TX_ENABLED=y
CONFIG_ESP_WIFI_TX_BA_WIN=32
CONFIG_ESP_WIFI_AMPDU_RX_ENABLED=y
CONFIG_ESP_WIFI_RX_BA_WIN=32

CONFIG_LWIP_TCP_SND_BUF_DEFAULT=65534
CONFIG_LWIP_TCP_WND_DEFAULT=65534
CONFIG_LWIP_TCP_RECVMBOX_SIZE=64
CONFIG_LWIP_UDP_RECVMBOX_SIZE=64
CONFIG_LWIP_TCPIP_RECVMBOX_SIZE=64

CONFIG_ESPTOOLPY_FLASHMODE_QIO=y
CONFIG_ESPTOOLPY_FLASHFREQ_40M=y

CONFIG_ESP_DEFAULT_CPU_FREQ_MHZ_240=y
CONFIG_ESP_DEFAULT_CPU_FREQ_MHZ=240
```

## examples/wifi/iperf/sdkconfig.defaults.esp32c2
```kconfig
#
# ESP32-C2
#
CONFIG_ESP_WIFI_STATIC_RX_BUFFER_NUM=14
CONFIG_ESP_WIFI_DYNAMIC_RX_BUFFER_NUM=18
CONFIG_ESP_WIFI_DYNAMIC_TX_BUFFER_NUM=18
CONFIG_ESP_WIFI_AMPDU_TX_ENABLED=y
CONFIG_ESP_WIFI_TX_BA_WIN=16
CONFIG_ESP_WIFI_AMPDU_RX_ENABLED=y
CONFIG_ESP_WIFI_RX_BA_WIN=16

CONFIG_LWIP_TCP_SND_BUF_DEFAULT=18432
CONFIG_LWIP_TCP_WND_DEFAULT=18432
CONFIG_LWIP_TCP_RECVMBOX_SIZE=32
CONFIG_LWIP_UDP_RECVMBOX_SIZE=32
CONFIG_LWIP_TCPIP_RECVMBOX_SIZE=32

CONFIG_ESP_DEFAULT_CPU_FREQ_MHZ_120=y
CONFIG_ESP_DEFAULT_CPU_FREQ_MHZ=120

CONFIG_ESPTOOLPY_FLASHMODE_QIO=y
CONFIG_ESPTOOLPY_FLASHFREQ_60M=y

CONFIG_LWIP_TCPIP_CORE_LOCKING=y
CONFIG_LWIP_TCPIP_CORE_LOCKING_INPUT=y
```

## examples/wifi/iperf/sdkconfig.defaults.esp32c3
```kconfig
#
# ESP32C3
#
CONFIG_ESP_WIFI_STATIC_RX_BUFFER_NUM=20
CONFIG_ESP_WIFI_DYNAMIC_RX_BUFFER_NUM=40
CONFIG_ESP_WIFI_DYNAMIC_TX_BUFFER_NUM=40
CONFIG_ESP_WIFI_AMPDU_TX_ENABLED=y
CONFIG_ESP_WIFI_TX_BA_WIN=32
CONFIG_ESP_WIFI_AMPDU_RX_ENABLED=y
CONFIG_ESP_WIFI_RX_BA_WIN=32

CONFIG_LWIP_TCP_SND_BUF_DEFAULT=40960
CONFIG_LWIP_TCP_WND_DEFAULT=40960
CONFIG_LWIP_TCP_RECVMBOX_SIZE=64
CONFIG_LWIP_UDP_RECVMBOX_SIZE=64
CONFIG_LWIP_TCPIP_RECVMBOX_SIZE=64

CONFIG_ESP_DEFAULT_CPU_FREQ_MHZ_160=y
CONFIG_ESP_DEFAULT_CPU_FREQ_MHZ=160

CONFIG_ESPTOOLPY_FLASHMODE_QIO=y
CONFIG_ESPTOOLPY_FLASHFREQ_80M=y

CONFIG_LWIP_TCPIP_CORE_LOCKING=y
CONFIG_LWIP_TCPIP_CORE_LOCKING_INPUT=y
```

## examples/wifi/iperf/sdkconfig.defaults.esp32c5
```kconfig
#
# ESP32C5-Specific
#
CONFIG_IDF_ENV_FPGA=n

CONFIG_ESP_WIFI_STATIC_RX_BUFFER_NUM=22
CONFIG_ESP_WIFI_DYNAMIC_RX_BUFFER_NUM=48
CONFIG_ESP_WIFI_DYNAMIC_TX_BUFFER_NUM=48
CONFIG_ESP_WIFI_AMPDU_TX_ENABLED=y
CONFIG_ESP_WIFI_TX_BA_WIN=32
CONFIG_ESP_WIFI_AMPDU_RX_ENABLED=y
CONFIG_ESP_WIFI_RX_BA_WIN=22
CONFIG_ESP_WIFI_NVS_ENABLED=n

CONFIG_LWIP_TCP_SND_BUF_DEFAULT=50400
CONFIG_LWIP_TCP_WND_DEFAULT=65535
CONFIG_LWIP_TCP_RECVMBOX_SIZE=48
CONFIG_LWIP_UDP_RECVMBOX_SIZE=64
CONFIG_LWIP_TCPIP_RECVMBOX_SIZE=48
CONFIG_LWIP_IP_REASS_MAX_PBUFS=15

#
# Serial flasher config
#
CONFIG_ESPTOOLPY_FLASHMODE_QIO=y
CONFIG_ESPTOOLPY_FLASHFREQ_80M=y

#
# Wi-Fi
#
CONFIG_ESP_WIFI_ENABLE_WIFI_TX_STATS=y
CONFIG_ESP_WIFI_ENABLE_WIFI_RX_STATS=y
CONFIG_ESP_WIFI_ENABLE_WIFI_RX_MU_STATS=n
CONFIG_ESP_WIFI_ENABLE_DUMP_HESIGB=n
CONFIG_ESP_WIFI_ENABLE_DUMP_MU_CFO=n
CONFIG_ESP_WIFI_ENABLE_DUMP_CTRL_NDPA=n
CONFIG_ESP_WIFI_ENABLE_DUMP_CTRL_BFRP=n
CONFIG_ESP_WIFI_SLP_IRAM_OPT=n
CONFIG_LWIP_EXTRA_IRAM_OPTIMIZATION=n

CONFIG_LWIP_TCPIP_CORE_LOCKING=y
CONFIG_LWIP_TCPIP_CORE_LOCKING_INPUT=y

CONFIG_IPERF_DEF_TCP_TX_BUFFER_LEN=2880
```

## examples/wifi/iperf/sdkconfig.defaults.esp32c6
```kconfig
#
# ESP32C6-Specific
#
CONFIG_ESP_WIFI_STATIC_RX_BUFFER_NUM=20
CONFIG_ESP_WIFI_DYNAMIC_RX_BUFFER_NUM=38
CONFIG_ESP_WIFI_DYNAMIC_TX_BUFFER_NUM=35
CONFIG_ESP_WIFI_AMPDU_TX_ENABLED=y
CONFIG_ESP_WIFI_TX_BA_WIN=20
CONFIG_ESP_WIFI_AMPDU_RX_ENABLED=y
CONFIG_ESP_WIFI_RX_BA_WIN=20
CONFIG_ESP_WIFI_NVS_ENABLED=n

CONFIG_LWIP_TCP_SND_BUF_DEFAULT=30000
CONFIG_LWIP_TCP_WND_DEFAULT=34000
CONFIG_LWIP_TCP_RECVMBOX_SIZE=64
CONFIG_LWIP_UDP_RECVMBOX_SIZE=64
CONFIG_LWIP_TCPIP_RECVMBOX_SIZE=64

CONFIG_LWIP_IP_REASS_MAX_PBUFS=15

CONFIG_ESP_WIFI_ENABLE_WIFI_RX_STATS=n
CONFIG_ESP_WIFI_ENABLE_WIFI_TX_STATS=n
```

## examples/wifi/iperf/sdkconfig.defaults.esp32p4
```kconfig
#
# ESP32-P4 specific
#

CONFIG_WIFI_RMT_STATIC_RX_BUFFER_NUM=16
CONFIG_WIFI_RMT_DYNAMIC_RX_BUFFER_NUM=64
CONFIG_WIFI_RMT_DYNAMIC_TX_BUFFER_NUM=64
CONFIG_WIFI_RMT_AMPDU_TX_ENABLED=y
CONFIG_WIFI_RMT_TX_BA_WIN=32
CONFIG_WIFI_RMT_AMPDU_RX_ENABLED=y
CONFIG_WIFI_RMT_RX_BA_WIN=32

CONFIG_LWIP_TCP_SND_BUF_DEFAULT=65534
CONFIG_LWIP_TCP_WND_DEFAULT=65534
CONFIG_LWIP_TCP_RECVMBOX_SIZE=64
CONFIG_LWIP_UDP_RECVMBOX_SIZE=64
CONFIG_LWIP_TCPIP_RECVMBOX_SIZE=64

CONFIG_LWIP_TCP_SACK_OUT=y
```

## examples/wifi/iperf/sdkconfig.defaults.esp32s2
```kconfig
#
# ESP32S2-specific
#
CONFIG_ESP_WIFI_STATIC_RX_BUFFER_NUM=8
CONFIG_ESP_WIFI_DYNAMIC_RX_BUFFER_NUM=24
CONFIG_ESP_WIFI_DYNAMIC_TX_BUFFER_NUM=24
CONFIG_ESP_WIFI_AMPDU_TX_ENABLED=y
CONFIG_ESP_WIFI_TX_BA_WIN=16
CONFIG_ESP_WIFI_AMPDU_RX_ENABLED=y
CONFIG_ESP_WIFI_RX_BA_WIN=16

CONFIG_LWIP_TCP_SND_BUF_DEFAULT=28000
CONFIG_LWIP_TCP_WND_DEFAULT=28000
CONFIG_LWIP_TCP_RECVMBOX_SIZE=32
CONFIG_LWIP_UDP_RECVMBOX_SIZE=32
CONFIG_LWIP_TCPIP_RECVMBOX_SIZE=32

CONFIG_ESP_DEFAULT_CPU_FREQ_MHZ_240=y
CONFIG_ESP_DEFAULT_CPU_FREQ_MHZ=240

CONFIG_ESPTOOLPY_FLASHMODE_QIO=y
CONFIG_ESPTOOLPY_FLASHFREQ_80M=y

CONFIG_ESP32S2_INSTRUCTION_CACHE_16KB=y
CONFIG_ESP32S2_INSTRUCTION_CACHE_LINE_16B=y
CONFIG_ESP32S2_INSTRUCTION_CACHE_WRAP=y

CONFIG_LWIP_TCPIP_CORE_LOCKING=y
CONFIG_LWIP_TCPIP_CORE_LOCKING_INPUT=y
```

## examples/wifi/iperf/sdkconfig.defaults.esp32s3
```kconfig
#
# ESP32S3-specific
#
CONFIG_ESP_WIFI_STATIC_RX_BUFFER_NUM=16
CONFIG_ESP_WIFI_DYNAMIC_RX_BUFFER_NUM=64
CONFIG_ESP_WIFI_DYNAMIC_TX_BUFFER_NUM=64
CONFIG_ESP_WIFI_AMPDU_TX_ENABLED=y
CONFIG_ESP_WIFI_TX_BA_WIN=32
CONFIG_ESP_WIFI_AMPDU_RX_ENABLED=y
CONFIG_ESP_WIFI_RX_BA_WIN=32

CONFIG_LWIP_TCP_SND_BUF_DEFAULT=65535
CONFIG_LWIP_TCP_WND_DEFAULT=65535
CONFIG_LWIP_TCP_RECVMBOX_SIZE=64
CONFIG_LWIP_UDP_RECVMBOX_SIZE=64
CONFIG_LWIP_TCPIP_RECVMBOX_SIZE=64

CONFIG_ESP_DEFAULT_CPU_FREQ_MHZ_240=y
CONFIG_ESP_DEFAULT_CPU_FREQ_MHZ=240

CONFIG_ESPTOOLPY_FLASHMODE_QIO=y
CONFIG_ESPTOOLPY_FLASHFREQ_80M=y

CONFIG_ESP32S3_INSTRUCTION_CACHE_32KB=y
CONFIG_ESP32S3_INSTRUCTION_CACHE_LINE_32B=y
CONFIG_ESP32S3_INSTRUCTION_CACHE_WRAP=y
```

## examples/wifi/iperf/sdkconfig.defaults.esp32s31
```kconfig
#
# ESP32S31-Specific
#

CONFIG_ESP_WIFI_STATIC_RX_BUFFER_NUM=48
CONFIG_ESP_WIFI_DYNAMIC_RX_BUFFER_NUM=72
CONFIG_ESP_WIFI_DYNAMIC_TX_BUFFER_NUM=64
CONFIG_ESP_WIFI_AMPDU_TX_ENABLED=y
CONFIG_ESP_WIFI_TX_BA_WIN=64
CONFIG_ESP_WIFI_AMPDU_RX_ENABLED=y
CONFIG_ESP_WIFI_RX_BA_WIN=64
CONFIG_ESP_WIFI_NVS_ENABLED=n

CONFIG_LWIP_TCP_SND_BUF_DEFAULT=65535
CONFIG_LWIP_TCP_WND_DEFAULT=65535
CONFIG_LWIP_TCP_RECVMBOX_SIZE=64
CONFIG_LWIP_UDP_RECVMBOX_SIZE=64
CONFIG_LWIP_TCPIP_RECVMBOX_SIZE=64
CONFIG_LWIP_IP_REASS_MAX_PBUFS=15

#
# Serial flasher config
#
CONFIG_ESPTOOLPY_FLASHMODE_QIO=y
CONFIG_ESPTOOLPY_FLASHFREQ_40M=y


CONFIG_PARTITION_TABLE_SINGLE_APP_LARGE=y
CONFIG_ESPTOOLPY_FLASHSIZE_4MB=y
#
# Wi-Fi
#
CONFIG_ESP_WIFI_ENABLE_WIFI_TX_STATS=y
CONFIG_ESP_WIFI_ENABLE_WIFI_RX_STATS=y
CONFIG_ESP_WIFI_ENABLE_WIFI_RX_MU_STATS=n
CONFIG_ESP_WIFI_ENABLE_DUMP_HESIGB=n
CONFIG_ESP_WIFI_ENABLE_DUMP_MU_CFO=n
CONFIG_ESP_WIFI_ENABLE_DUMP_CTRL_NDPA=y
CONFIG_ESP_WIFI_ENABLE_DUMP_CTRL_BFRP=y
CONFIG_ESP_WIFI_SLP_IRAM_OPT=y
CONFIG_LWIP_EXTRA_IRAM_OPTIMIZATION=y

#CONFIG_LWIP_TCPIP_CORE_LOCKING=y
#CONFIG_LWIP_TCPIP_CORE_LOCKING_INPUT=y
CONFIG_LWIP_TCPIP_TASK_AFFINITY_CPU1=y
CONFIG_LWIP_TCPIP_TASK_AFFINITY=0x1

CONFIG_IPERF_DEF_TCP_TX_BUFFER_LEN=2880
CONFIG_LWIP_TCP_OOSEQ_MAX_PBUFS=12

#TODO IDF-14625 IDF-14630 IDF-14631 IDF-14633
CONFIG_MBEDTLS_HARDWARE_AES=n
CONFIG_MBEDTLS_HARDWARE_MPI=n
CONFIG_MBEDTLS_HARDWARE_SHA=n
CONFIG_MBEDTLS_HARDWARE_ECC=n
#CONFIG_FREERTOS_UNICORE=y
```
