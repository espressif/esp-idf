## examples/wifi/itwt/main/Kconfig.projbuild
```kconfig
menu "Example Configuration"

    config EXAMPLE_WIFI_SSID
        string "WiFi SSID"
        default "myssid"
        help
            SSID (network name) for the example to connect to.

    config EXAMPLE_WIFI_PASSWORD
        string "WiFi Password"
        default "mypassword"
        help
            WiFi password (WPA or WPA2) for the example to use.

    config EXAMPLE_ENABLE_STATIC_IP
        bool "enable static ip"
        default y
        help
            Enable static IP
    config EXAMPLE_STATIC_IP_ADDR
        string "Static IP address"
        default "192.168.4.2"
        depends on EXAMPLE_ENABLE_STATIC_IP
        help
            Set static IP address.

    config EXAMPLE_STATIC_NETMASK_ADDR
        string "Static netmask address"
        default "255.255.255.0"
        depends on EXAMPLE_ENABLE_STATIC_IP
        help
            Set static netmask address.

    config EXAMPLE_STATIC_GW_ADDR
        string "Static gateway address"
        default "192.168.4.1"
        depends on EXAMPLE_ENABLE_STATIC_IP
        help
            Set static gateway address.

    menu "iTWT Configuration"
        config EXAMPLE_ITWT_TRIGGER_ENABLE
            bool "trigger-enabled"
            default y
            help
                0- a non-trigger-enabled TWT, 1-a trigger-enabled TWT

        config EXAMPLE_ITWT_ANNOUNCED
            bool "announced"
            default y
            help
                0- an unannounced TWT, 1-an announced TWT

        config EXAMPLE_ITWT_MIN_WAKE_DURA
            int "itwt minimum wake duration"
            range 1 255
            default 255
            help
                Nominal Minimum Wake Duration, indicates the minimum amount of time, in unit of 256 us, that the TWT
                requesting STA expects that it needs to be awake. The value range is [1, 255].

        config EXAMPLE_ITWT_WAKE_DURATION_UNIT
            int "itwt wake duration unit"
            range 0 1
            default 0
            help
                TWT wake duration unit, 0: 256us 1: TU (TU = 1024us)

        config EXAMPLE_ITWT_WAKE_INVL_EXPN
            int "itwt wake interval exponent"
            range 0 31
            default 10
            help
                TWT Wake Interval Exponent, in microseconds. The value range is [0, 31].

        config EXAMPLE_ITWT_WAKE_INVL_MANT
            int "itwt wake interval mantissa"
            range 1 65535
            default 512
            help
                TWT Wake Interval Mantissa, in microseconds. The value range is [1, 65535].

        config EXAMPLE_ITWT_ID
            int "itwt connection id"
            range 0 32767
            default 0
            help
                TWT Connection id. The value range is [0, 32767].

        config EXAMPLE_ITWT_SETUP_TIMEOUT_TIME_MS
            int "itwt setup timeout times"
            range 100 65535
            default 5000
            help
                TWT setup timeout time, in microseconds. The value range is [100, 65535].

    endmenu

    choice EXAMPLE_MAX_CPU_FREQ
        prompt "Maximum CPU frequency"
        default EXAMPLE_MAX_CPU_FREQ_80
        depends on PM_ENABLE
        help
            Maximum CPU frequency to use for dynamic frequency scaling.

        config EXAMPLE_MAX_CPU_FREQ_80
            bool "80 MHz"
        config EXAMPLE_MAX_CPU_FREQ_120
            bool "120 MHz"
            depends on IDF_TARGET_ESP32C2
        config EXAMPLE_MAX_CPU_FREQ_160
            bool "160 MHz"
            depends on !IDF_TARGET_ESP32C2
        config EXAMPLE_MAX_CPU_FREQ_240
            bool "240 MHz"
            depends on IDF_TARGET_ESP32 || IDF_TARGET_ESP32S2 || IDF_TARGET_ESP32S3
    endchoice

    config EXAMPLE_MAX_CPU_FREQ_MHZ
        int
        default 80 if EXAMPLE_MAX_CPU_FREQ_80
        default 120 if EXAMPLE_MAX_CPU_FREQ_120
        default 160 if EXAMPLE_MAX_CPU_FREQ_160
        default 240 if EXAMPLE_MAX_CPU_FREQ_240

    choice EXAMPLE_MIN_CPU_FREQ
        prompt "Minimum CPU frequency"
        default EXAMPLE_MIN_CPU_FREQ_10M
        depends on PM_ENABLE
        help
            Minimum CPU frequency to use for dynamic frequency scaling.
            Should be set to XTAL frequency or XTAL frequency divided by integer.

        config EXAMPLE_MIN_CPU_FREQ_40M
            bool "40 MHz (use with 40MHz XTAL)"
            depends on XTAL_FREQ_40 || XTAL_FREQ_AUTO
        config EXAMPLE_MIN_CPU_FREQ_20M
            bool "20 MHz (use with 40MHz XTAL)"
            depends on XTAL_FREQ_40 || XTAL_FREQ_AUTO
        config EXAMPLE_MIN_CPU_FREQ_10M
            bool "10 MHz (use with 40MHz XTAL)"
            depends on XTAL_FREQ_40 || XTAL_FREQ_AUTO
        config EXAMPLE_MIN_CPU_FREQ_26M
            bool "26 MHz (use with 26MHz XTAL)"
            depends on XTAL_FREQ_26 || XTAL_FREQ_AUTO
        config EXAMPLE_MIN_CPU_FREQ_13M
            bool "13 MHz (use with 26MHz XTAL)"
            depends on XTAL_FREQ_26 || XTAL_FREQ_AUTO
    endchoice

    config EXAMPLE_MIN_CPU_FREQ_MHZ
        int
        default 40 if EXAMPLE_MIN_CPU_FREQ_40M
        default 20 if EXAMPLE_MIN_CPU_FREQ_20M
        default 10 if EXAMPLE_MIN_CPU_FREQ_10M
        default 26 if EXAMPLE_MIN_CPU_FREQ_26M
        default 13 if EXAMPLE_MIN_CPU_FREQ_13M

endmenu
```

## examples/wifi/itwt/sdkconfig.defaults
```kconfig
# Enable support for power management
CONFIG_PM_ENABLE=y
# Enable tickless idle mode
CONFIG_FREERTOS_USE_TICKLESS_IDLE=y
# Put related source code in IRAM
CONFIG_PM_SLP_IRAM_OPT=y
CONFIG_PM_RTOS_IDLE_OPT=y
# Disable all GPIO at light sleep
CONFIG_PM_SLP_DISABLE_GPIO=y
# Enable wifi sleep iram optimization
CONFIG_ESP_WIFI_SLP_IRAM_OPT=y

CONFIG_LWIP_ESP_GRATUITOUS_ARP=n

CONFIG_FREERTOS_HZ=1000
# CONFIG_LWIP_ESP_GRATUITOUS_ARP is not set
# CONFIG_ESP_GRATUITOUS_ARP is not set

CONFIG_ESP_WIFI_ENABLE_WIFI_RX_STATS=n
CONFIG_ESP_WIFI_ENABLE_WIFI_TX_STATS=n

CONFIG_LWIP_IPV6=n

CONFIG_LWIP_DHCP_COARSE_TIMER_SECS=10
CONFIG_PM_POWER_DOWN_CPU_IN_LIGHT_SLEEP=y
CONFIG_PM_POWER_DOWN_PERIPHERAL_IN_LIGHT_SLEEP=y
CONFIG_ESP_SLEEP_POWER_DOWN_FLASH=y
CONFIG_ESP_MODEM_CLOCK_ENABLE_CHECKING=y
CONFIG_ESP_PHY_MAC_BB_PD=y
#CONFIG_ESP_WIFI_ENHANCED_LIGHT_SLEEP=y
```
