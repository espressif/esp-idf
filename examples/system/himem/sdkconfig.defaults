## examples/system/himem/sdkconfig.defaults
```kconfig
CONFIG_SPIRAM=y
CONFIG_SPIRAM_BOOT_INIT=y
CONFIG_SPIRAM_IGNORE_NOTFOUND=n
CONFIG_SPIRAM_USE_MALLOC=y
CONFIG_SPIRAM_TYPE_AUTO=y
CONFIG_SPIRAM_SPEED_40M=y
CONFIG_SPIRAM_MEMTEST=y
CONFIG_SPIRAM_CACHE_WORKAROUND=y
CONFIG_SPIRAM_BANKSWITCH_ENABLE=y
CONFIG_SPIRAM_BANKSWITCH_RESERVE=4
```

## examples/system/light_sleep/main/Kconfig.projbuild
```kconfig
menu "Example Configuration"

    orsource "$IDF_PATH/examples/common_components/env_caps/$IDF_TARGET/Kconfig.env_caps"

    choice EXAMPLE_UART_WAKEUP_MODE
        prompt "uart wakeup mode"
        default UART_WK_MODE_ACTIVE_THRESH
        help
            Uart wakeup MODE_ACTIVE_THRESH | MODE_FIFO_THRESH | MODE_START_BIT | MODE_CHAR_SEQ to be selected
            for uart wakeup during light sleep. Specifically, wakeup MODE_ACTIVE_THRESH doesn't require a clock.
            In contrast, the other three wakeup modes need XTAL (not RC FAST for instability) ungated during light
            sleep, where the chips used should support sleep clock icg control. However, they consume more power
            as XTAL must be powered on.

        config UART_WK_MODE_ACTIVE_THRESH
            bool "MODE_ACTIVE_THRESH"
        config UART_WK_MODE_FIFO_THRESH
            bool "MODE_FIFO_THRESH"
            depends on SOC_UART_WAKEUP_SUPPORT_FIFO_THRESH_MODE && SOC_PM_SUPPORT_PMU_CLK_ICG && SOC_PMU_SUPPORTED
        config UART_WK_MODE_START_BIT
            bool "MODE_START_BIT"
            depends on SOC_UART_WAKEUP_SUPPORT_START_BIT_MODE && SOC_PM_SUPPORT_PMU_CLK_ICG && SOC_PMU_SUPPORTED
        config UART_WK_MODE_CHAR_SEQ
            bool "MODE_CHAR_SEQ"
            depends on SOC_UART_WAKEUP_SUPPORT_CHAR_SEQ_MODE && SOC_PM_SUPPORT_PMU_CLK_ICG && SOC_PMU_SUPPORTED
    endchoice

    config EXAMPLE_UART_WAKEUP_MODE_SELCTED
        int
        default 0 if UART_WK_MODE_ACTIVE_THRESH
        default 1 if UART_WK_MODE_FIFO_THRESH
        default 2 if UART_WK_MODE_START_BIT
        default 3 if UART_WK_MODE_CHAR_SEQ

    config EXAMPLE_GPIO_WAKEUP_NUM
        int "gpio wakeup num"
        depends on IDF_TARGET_ESP32H4 || IDF_TARGET_ESP32H21
        default 0
        range ENV_GPIO_RANGE_MIN ENV_GPIO_IN_RANGE_MAX
        help
            GPIO pin number used as the light sleep wakeup source.
            Avoid console UART, MSPI, USB, and other pins already used by peripherals, as they may interfere
            with normal system operation.


endmenu
```

## examples/system/light_sleep/sdkconfig.defaults.esp32c5
```kconfig
CONFIG_ESP_DEFAULT_CPU_FREQ_MHZ_80=y
#TODO: update DEFAULT_SLEEP_OUT_OVERHEAD_US in previous chips (PM-209)
CONFIG_PM_SLP_IRAM_OPT=y
```

## examples/system/ota/advanced_https_ota/main/Kconfig.projbuild
```kconfig
menu "Example Configuration"

    config EXAMPLE_FIRMWARE_UPGRADE_URL
        string "Firmware Upgrade URL"
        default "https://192.168.2.106:8070/hello_world.bin"
        help
            URL of server which hosts the firmware image.

    config EXAMPLE_FIRMWARE_UPGRADE_URL_FROM_STDIN
        bool
        default y if EXAMPLE_FIRMWARE_UPGRADE_URL = "FROM_STDIN"

    config EXAMPLE_SKIP_COMMON_NAME_CHECK
        bool "Skip server certificate CN fieldcheck"
        default n
        help
            This allows you to skip the validation of OTA server certificate CN field.

    config EXAMPLE_SKIP_VERSION_CHECK
        bool "Skip firmware version check"
        default n
        help
            This allows you to skip the firmware version check.

    config EXAMPLE_OTA_RECV_TIMEOUT
        int "OTA Receive Timeout"
        default 5000
        help
            Maximum time for reception

    config EXAMPLE_ENABLE_PARTIAL_HTTP_DOWNLOAD
        bool "Enable partial HTTP download"
        default n
        select ESP_TLS_CLIENT_SESSION_TICKETS
        help
            This enables use of Range header in esp_https_ota component.
            The firmware image will be downloaded over multiple HTTP requests,
            with session resumption enabled between them.

    config EXAMPLE_HTTP_REQUEST_SIZE
        int "HTTP request size"
        default MBEDTLS_SSL_IN_CONTENT_LEN
        depends on EXAMPLE_ENABLE_PARTIAL_HTTP_DOWNLOAD
        help
            This options specifies HTTP request size. Number of bytes specified
            in this option will be downloaded in single HTTP request.

    config EXAMPLE_ENABLE_OTA_RESUMPTION
        bool "Enable OTA resumption"
        default n
        help
            This enables the OTA resumption feature.
            This option allows one to configure the OTA process to resume downloading the OTA image
            from where it left off in case of an error or reboot.

    config EXAMPLE_USE_CERT_BUNDLE
        bool "Enable certificate bundle"
        default y
        depends on MBEDTLS_CERTIFICATE_BUNDLE
        help
            Enable trusted root certificate bundle. This approach allows to have
            OTA updates functional with any public server without requirement
            to explicitly add its server certificate.

endmenu
```

## examples/system/ota/main/Kconfig.projbuild
```kconfig
menu "Example Configuration"

config WIFI_SSID
    string "WiFi SSID"
	default "myssid"
	help
		SSID (network name) for the example to connect to.

config WIFI_PASSWORD
    string "WiFi Password"
	default "myssid"
	help
		WiFi password (WPA or WPA2) for the example to use.

		Can be left blank if the network has no security set.

config SERVER_IP
    string "HTTP Server IP"
	default "192.168.0.3"
	help
		HTTP Server IP to download the image file from.

		See example README.md for details.

config SERVER_PORT
	string "HTTP Server Port"
	default "8070"
	help
		HTTP Server port to connect to.
		Should be chosen not to conflict with any other port used
		on the system.

config EXAMPLE_FILENAME
	string "HTTP GET Filename"
	default "/hello-world.bin"
	help
		Filename of the app image file to download for
		the OTA update.

endmenu
```

## examples/system/ota/native_ota_example/main/Kconfig.projbuild
```kconfig
menu "Example Configuration"

    orsource "$IDF_PATH/examples/common_components/env_caps/$IDF_TARGET/Kconfig.env_caps"

    config EXAMPLE_FIRMWARE_UPG_URL
        string "Firmware Upgrade URL"
        default "https://192.168.2.106:8070/hello_world.bin"
        help
            URL of server which hosts the firmware image.

    config EXAMPLE_FIRMWARE_UPGRADE_URL_FROM_STDIN
        bool
        default y if EXAMPLE_FIRMWARE_UPG_URL = "FROM_STDIN"

    config EXAMPLE_SKIP_COMMON_NAME_CHECK
        bool "Skip server certificate CN fieldcheck"
        default n
        help
            This allows you to skip the validation of OTA server certificate CN field.

    config EXAMPLE_SKIP_VERSION_CHECK
        bool "Skip firmware version check"
        default n
        help
            This allows you to skip the firmware version check.

    config EXAMPLE_GPIO_DIAGNOSTIC
        int "Number of the GPIO input for diagnostic"
        range ENV_GPIO_RANGE_MIN ENV_GPIO_IN_RANGE_MAX
        default 4
        help
            Used to demonstrate how a rollback works.
            The selected GPIO will be configured as an input with internal pull-up enabled.
            To trigger a rollback, this GPIO must be pulled low while the message
            `Diagnostics (5 sec)...` which will be on first boot.
            If GPIO is not pulled low then the operable of the app will be confirmed.

    config EXAMPLE_OTA_RECV_TIMEOUT
        int "OTA Receive Timeout"
        default 5000
        help
            Maximum time for reception

endmenu
```

## examples/system/ota/native_ota_example/sdkconfig.defaults
```kconfig
# Default sdkconfig parameters to use the OTA
# partition table layout, with a 4MB flash size
CONFIG_ESPTOOLPY_FLASHSIZE_4MB=y
CONFIG_PARTITION_TABLE_TWO_OTA=y
```

## examples/system/ota/pre_encrypted_ota/main/Kconfig.projbuild
```kconfig
menu "Example Configuration"

    config EXAMPLE_FIRMWARE_UPGRADE_URL
        string "firmware upgrade url endpoint"
        default "https://192.168.0.3:8070/hello_world.bin"
        help
            URL of server which hosts the encrypted firmware image.

    config EXAMPLE_FIRMWARE_UPGRADE_URL_FROM_STDIN
        bool
        default y if EXAMPLE_FIRMWARE_UPGRADE_URL = "FROM_STDIN"

    config EXAMPLE_SKIP_COMMON_NAME_CHECK
        bool "Skip server certificate CN fieldcheck"
        default n
        help
            This allows you to skip the validation of OTA server certificate CN field.

    config EXAMPLE_SKIP_VERSION_CHECK
        bool "Skip firmware version check"
        default n
        help
            This allows you to skip the firmware version check.

    config EXAMPLE_OTA_RECV_TIMEOUT
        int "OTA Receive Timeout"
        default 5000
        help
            Maximum time for reception

    config EXAMPLE_ENABLE_PARTIAL_HTTP_DOWNLOAD
        bool "Enable partial HTTP download"
        default n
        help
            This enables use of Range header in esp_https_ota component.
            Firmware image will be downloaded over multiple HTTP requests.

    config EXAMPLE_HTTP_REQUEST_SIZE
        int "HTTP request size"
        default MBEDTLS_SSL_IN_CONTENT_LEN
        depends on EXAMPLE_ENABLE_PARTIAL_HTTP_DOWNLOAD
        help
            This options specifies HTTP request size. Number of bytes specified
            in this option will be downloaded in single HTTP request.
endmenu
```

## examples/system/ota/pre_encrypted_ota/sdkconfig.defaults
```kconfig
# Defaults for generating a new "sdkconfig" file (project settings).
# https://docs.espressif.com/projects/esp-idf/en/latest/esp32/api-guides/build-system.html#custom-sdkconfig-defaults
#
# NOTE - if this file changes, to get new defaults, you must erase any existing
# "sdkconfig" file (this will undo manual settings from "idf.py menuconfig").

# Default sdkconfig parameters to use the OTA
# partition table layout, with a 4MB flash size
CONFIG_ESPTOOLPY_FLASHSIZE_4MB=y
CONFIG_PARTITION_TABLE_TWO_OTA=y
# Enable ESP HTTPS OTA decryption callback
CONFIG_ESP_HTTPS_OTA_DECRYPT_CB=y
```

## examples/system/ota/simple_mqtt_ota/main/Kconfig.projbuild
```kconfig
menu "MQTT OTA Example Configuration"

    config MQTT_BROKER_URI
        string "MQTT Broker URI"
        default "mqtt://test.mosquitto.org:1883"
        help
            URI of the MQTT broker the device connects to.

    config MQTT_TOPIC_FIRMWARE
        string "MQTT Topic for Firmware Data"
        default "ota/firmware"
        help
            Topic name where firmware data will be published.

    config MQTT_TOPIC_START_UPDATE
        string "MQTT Topic for Starting Update"
        default "ota/update"
        help
            Topic name to trigger OTA start.

    config MQTT_TOPIC_DONE
        string "MQTT Topic for OTA Done"
        default "ota/done"
        help
            Topic name that signals OTA completion.

endmenu
```

## examples/system/ota/simple_mqtt_ota/sdkconfig.defaults
```kconfig
# === Flash Configuration ===
CONFIG_ESPTOOLPY_FLASHSIZE_4MB=y  # Set flash size to 4MB

# === Partition Table ===
CONFIG_PARTITION_TABLE_TWO_OTA_LARGE=y  # Use two OTA partitions with larger sizes (suitable for OTA updates)

# === MQTT Configuration ===
CONFIG_MQTT_USE_CUSTOM_CONFIG=y   # Enable custom MQTT buffer config
CONFIG_MQTT_BUFFER_SIZE=4096      # Increase MQTT buffer to 4KB for larger firmware chunks
```

## examples/system/ota/simple_ota_example/main/Kconfig.projbuild
```kconfig
menu "Example Configuration"

    config EXAMPLE_FIRMWARE_UPGRADE_URL
        string "firmware upgrade url endpoint"
        default "https://192.168.0.3:8070/hello_world.bin"
        help
            URL of server which hosts the firmware
            image.

    config EXAMPLE_USE_CERT_BUNDLE
        bool "Enable certificate bundle"
        default y
        depends on MBEDTLS_CERTIFICATE_BUNDLE
        help
            Enable trusted root certificate bundle. This approach allows to have
            OTA updates functional with any public server without requirement
            to explicitly add its server certificate.

    config EXAMPLE_FIRMWARE_UPGRADE_URL_FROM_STDIN
        bool
        default y if EXAMPLE_FIRMWARE_UPGRADE_URL = "FROM_STDIN"

    config EXAMPLE_SKIP_COMMON_NAME_CHECK
        bool "Skip server certificate CN fieldcheck"
        default n
        help
            This allows you to skip the validation of OTA server certificate CN field.

    config EXAMPLE_FIRMWARE_UPGRADE_BIND_IF
        bool "Support firmware upgrade bind specified interface"
        default n
        help
            This allows you to bind specified interface in OTA example.

    choice EXAMPLE_FIRMWARE_UPGRADE_BIND_IF_TYPE
        prompt "Choose OTA data bind interface"
        default EXAMPLE_FIRMWARE_UPGRADE_BIND_IF_STA
        depends on EXAMPLE_FIRMWARE_UPGRADE_BIND_IF
        help
            Select which interface type of OTA data go through.

        config EXAMPLE_FIRMWARE_UPGRADE_BIND_IF_STA
            bool "Bind wifi station interface"
            depends on EXAMPLE_CONNECT_WIFI
            help
                Select wifi station interface to pass the OTA data.

        config EXAMPLE_FIRMWARE_UPGRADE_BIND_IF_ETH
            bool "Bind ethernet interface"
            depends on EXAMPLE_CONNECT_ETHERNET
            help
                Select ethernet interface to pass the OTA data.
    endchoice
endmenu
```

## examples/system/ota/simple_ota_example/sdkconfig.defaults
```kconfig
# Defaults for generating a new "sdkconfig" file (project settings).
# https://docs.espressif.com/projects/esp-idf/en/latest/esp32/api-guides/build-system.html#custom-sdkconfig-defaults
#
# NOTE - if this file changes, to get new defaults, you must erase any existing
# "sdkconfig" file (this will undo manual settings from "idf.py menuconfig").

# Default sdkconfig parameters to use the OTA
# partition table layout, with a 4MB flash size
CONFIG_ESPTOOLPY_FLASHSIZE_4MB=y
CONFIG_PARTITION_TABLE_TWO_OTA=y

# Certificate bundle configuration
CONFIG_MBEDTLS_CERTIFICATE_BUNDLE_DEFAULT_CMN=y
CONFIG_MBEDTLS_CUSTOM_CERTIFICATE_BUNDLE=y
CONFIG_MBEDTLS_CUSTOM_CERTIFICATE_BUNDLE_PATH="server_certs/ca_cert.pem"
```

## examples/system/startup_time/sdkconfig.defaults
```kconfig
# Set flash configuration as fast as possible (Quad I/O 80MHz)
#
# (Not all hardware may support this configuration.)
CONFIG_ESPTOOLPY_FLASHMODE_QIO=y
CONFIG_ESPTOOLPY_FLASHFREQ_80M=y

# These two settings mean that no logs are printed
# during startup, but it's possible to use esp_log_level_set("*", ESP_LOG_INFO)
# at runtime to get Info-level logging back
CONFIG_LOG_DEFAULT_LEVEL_WARN=y
CONFIG_LOG_MAXIMUM_LEVEL_INFO=y
CONFIG_BOOTLOADER_LOG_LEVEL_WARN=y

# at risk of not detecting flash corruption, skip bootloader
# verification of the app unless a soft reset or crash happened
#
# note: the larger the application, the bigger the time saved by
# from this option
CONFIG_BOOTLOADER_SKIP_VALIDATE_ON_POWER_ON=y

# Setting option to zero is only recommended if not using sleep modes, or
# if you don't need accurate sleep times.
CONFIG_RTC_CLK_CAL_CYCLES=0
```

## examples/system/startup_time/sdkconfig.defaults.esp32
```kconfig
# Not calibrating RTC_SLOW_CLK saves a small amount of time during boot.
#
# Setting option to zero is only recommended if not using sleep modes, or
# if you don't need accurate sleep times.
CONFIG_ESP32_RTC_CLK_CAL_CYCLES=0
```

## examples/system/sysview_tracing/main/Kconfig.projbuild
```kconfig
menu "Example Configuration"

    config USE_CUSTOM_EVENT_ID
        bool "Use custom SystemView event IDs"
        default "n"
        help
            Use custom IDs for user events. If it is enabled, replace `SYSVIEW_FreeRTOS.txt` in SystemView
            installation directory with the version from example's root directory.

            By default SYSVIEW_EVTID_MARK_START/STOP are used for tracing purposes of the example.

endmenu
```
