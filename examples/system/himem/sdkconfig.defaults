## examples/system/sysview_tracing/sdkconfig.defaults
```kconfig
# 1ms tick period
CONFIG_FREERTOS_HZ=1000
# Enable FreeRTOS SystemView Tracing by default
CONFIG_ESP_TRACE_ENABLE=y
CONFIG_ESP_TRACE_LIB_SEGGER_SYSVIEW=y
CONFIG_ESP_TRACE_TRANSPORT_APPTRACE=y
CONFIG_ESP_TRACE_TS_SOURCE_ESP_TIMER=y
CONFIG_SEGGER_SYSVIEW_EVT_OVERFLOW_ENABLE=y
CONFIG_SEGGER_SYSVIEW_EVT_ISR_ENTER_ENABLE=y
CONFIG_SEGGER_SYSVIEW_EVT_ISR_EXIT_ENABLE=y
CONFIG_SEGGER_SYSVIEW_EVT_ISR_TO_SCHED_ENABLE=y
CONFIG_SEGGER_SYSVIEW_EVT_TASK_START_EXEC_ENABLE=y
CONFIG_SEGGER_SYSVIEW_EVT_TASK_STOP_EXEC_ENABLE=y
CONFIG_SEGGER_SYSVIEW_EVT_TASK_START_READY_ENABLE=y
CONFIG_SEGGER_SYSVIEW_EVT_TASK_STOP_READY_ENABLE=y
CONFIG_SEGGER_SYSVIEW_EVT_TASK_CREATE_ENABLE=y
CONFIG_SEGGER_SYSVIEW_EVT_TASK_TERMINATE_ENABLE=y
CONFIG_SEGGER_SYSVIEW_EVT_IDLE_ENABLE=y
CONFIG_SEGGER_SYSVIEW_EVT_TIMER_ENTER_ENABLE=y
CONFIG_SEGGER_SYSVIEW_EVT_TIMER_EXIT_ENABLE=y
```

## examples/system/sysview_tracing/sdkconfig.defaults.esp32
```kconfig
CONFIG_IDF_TARGET="esp32"
CONFIG_APPTRACE_UART_TX_GPIO=1
CONFIG_APPTRACE_UART_RX_GPIO=3
```

## examples/system/sysview_tracing/sdkconfig.defaults.esp32c2
```kconfig
CONFIG_IDF_TARGET="esp32c2"
CONFIG_APPTRACE_UART_TX_GPIO=20
CONFIG_APPTRACE_UART_RX_GPIO=19
```

## examples/system/sysview_tracing/sdkconfig.defaults.esp32c3
```kconfig
CONFIG_IDF_TARGET="esp32c3"
CONFIG_APPTRACE_UART_TX_GPIO=21
CONFIG_APPTRACE_UART_RX_GPIO=20
```

## examples/system/sysview_tracing/sdkconfig.defaults.esp32c5
```kconfig
CONFIG_IDF_TARGET="esp32c5"
CONFIG_APPTRACE_UART_TX_GPIO=11
CONFIG_APPTRACE_UART_RX_GPIO=12
```

## examples/system/sysview_tracing/sdkconfig.defaults.esp32c6
```kconfig
CONFIG_IDF_TARGET="esp32c6"
CONFIG_APPTRACE_UART_TX_GPIO=16
CONFIG_APPTRACE_UART_RX_GPIO=17
```

## examples/system/sysview_tracing/sdkconfig.defaults.esp32c61
```kconfig
CONFIG_IDF_TARGET="esp32c61"
CONFIG_APPTRACE_UART_TX_GPIO=11
CONFIG_APPTRACE_UART_RX_GPIO=10
```
