## examples/peripherals/pcnt/rotary_encoder/main/Kconfig.projbuild
```kconfig
menu "Example Configuration"
    config EXAMPLE_ENABLE_INTERNAL_PULL_UPS
        bool "Enable internal pull-up resistors"
        default "n"
        help
            Enable the internal pull-up resistors for the EC11 A/B signal GPIOs.
            It is recommended to provide external pull-up resistors on the PCB.
            Enable this option only when external pull-up resistors are not available.

    config EXAMPLE_WAKE_UP_LIGHT_SLEEP
        bool "Configure the EC11 to wake up light sleep"
        default "n"
        help
            Whether to use one of the EC11 channel to wake up the chip from light sleep.
            The wake up is not triggered by PCNT peripheral, but by the digital GPIO.
endmenu
```

## examples/peripherals/ppa/ppa_dsi/main/Kconfig.projbuild
```kconfig
menu "Example Configuration"
    config EXAMPLE_USED_LDO_CHAN_ID
        int "example used LDO channel ID"
        default 3
        help
            Example used LDO channel ID, you may check datasheet to know more details.

    config EXAMPLE_USED_LDO_VOLTAGE_MV
        int "example used LDO voltage in mV"
        default 2500
        range 0 3300
        help
            Example used LDO voltage, in mV

    choice EXAMPLE_SOURCE_IMAGE_FORMAT
        prompt "Select source image format"
        default EXAMPLE_SOURCE_IMAGE_FORMAT_JPEG
        help
            Select the source image format

        config EXAMPLE_SOURCE_IMAGE_FORMAT_JPEG
            bool "JPEG"

        config EXAMPLE_SOURCE_IMAGE_FORMAT_RGB565
            bool "RGB565"
    endchoice

endmenu
```

## examples/peripherals/ppa/ppa_rgb_lcd/main/Kconfig.projbuild
```kconfig
menu "Example Configuration"
    choice EXAMPLE_SOURCE_IMAGE_FORMAT
        prompt "Select source image format"
        default EXAMPLE_SOURCE_IMAGE_FORMAT_JPEG
        help
            Select the source image format

        config EXAMPLE_SOURCE_IMAGE_FORMAT_JPEG
            bool "JPEG"

        config EXAMPLE_SOURCE_IMAGE_FORMAT_RGB565
            bool "RGB565"
    endchoice

endmenu
```

## examples/peripherals/ppa/ppa_rgb_lcd/sdkconfig.defaults.esp32p4
```kconfig
CONFIG_IDF_EXPERIMENTAL_FEATURES=y
CONFIG_SPIRAM=y
CONFIG_SPIRAM_MODE_HEX=y
CONFIG_SPIRAM_SPEED_200M=y

CONFIG_EXAMPLE_LCD_DATA_LINES_16=y

# RGB565 over 16 data lines uses B[4:0], G[5:0], R[4:0]
CONFIG_EXAMPLE_LCD_VSYNC_GPIO=41
CONFIG_EXAMPLE_LCD_HSYNC_GPIO=39
CONFIG_EXAMPLE_LCD_DE_GPIO=43
CONFIG_EXAMPLE_LCD_PCLK_GPIO=33

# B3:B7 <=> DATA0:DATA4
CONFIG_EXAMPLE_LCD_DATA0_GPIO=40
CONFIG_EXAMPLE_LCD_DATA1_GPIO=42
CONFIG_EXAMPLE_LCD_DATA2_GPIO=27
CONFIG_EXAMPLE_LCD_DATA3_GPIO=29
CONFIG_EXAMPLE_LCD_DATA4_GPIO=31

# G2:G7 <=> DATA5:DATA10
CONFIG_EXAMPLE_LCD_DATA5_GPIO=21
CONFIG_EXAMPLE_LCD_DATA6_GPIO=23
CONFIG_EXAMPLE_LCD_DATA7_GPIO=26
CONFIG_EXAMPLE_LCD_DATA8_GPIO=28
CONFIG_EXAMPLE_LCD_DATA9_GPIO=30
CONFIG_EXAMPLE_LCD_DATA10_GPIO=32

# R3:R7 <=> DATA11:DATA15
CONFIG_EXAMPLE_LCD_DATA11_GPIO=6
CONFIG_EXAMPLE_LCD_DATA12_GPIO=0
CONFIG_EXAMPLE_LCD_DATA13_GPIO=15
CONFIG_EXAMPLE_LCD_DATA14_GPIO=17
CONFIG_EXAMPLE_LCD_DATA15_GPIO=19
```

## examples/peripherals/ppa/ppa_rgb_lcd/sdkconfig.defaults.esp32s31
```kconfig
CONFIG_IDF_EXPERIMENTAL_FEATURES=y
CONFIG_SPIRAM=y
CONFIG_SPIRAM_MODE_OCT=y
CONFIG_SPIRAM_SPEED_250M=y

CONFIG_EXAMPLE_LCD_DATA_LINES_24=y

# Default GPIO assignment
CONFIG_EXAMPLE_LCD_VSYNC_GPIO=45
CONFIG_EXAMPLE_LCD_HSYNC_GPIO=44
CONFIG_EXAMPLE_LCD_DE_GPIO=43
CONFIG_EXAMPLE_LCD_PCLK_GPIO=40

# B0:B7 <=> DATA0:DATA7
CONFIG_EXAMPLE_LCD_DATA0_GPIO=8
CONFIG_EXAMPLE_LCD_DATA1_GPIO=9
CONFIG_EXAMPLE_LCD_DATA2_GPIO=10
CONFIG_EXAMPLE_LCD_DATA3_GPIO=11
CONFIG_EXAMPLE_LCD_DATA4_GPIO=12
CONFIG_EXAMPLE_LCD_DATA5_GPIO=13
CONFIG_EXAMPLE_LCD_DATA6_GPIO=14
CONFIG_EXAMPLE_LCD_DATA7_GPIO=15

# G0:G7 <=> DATA8:DATA15
CONFIG_EXAMPLE_LCD_DATA8_GPIO=16
CONFIG_EXAMPLE_LCD_DATA9_GPIO=17
CONFIG_EXAMPLE_LCD_DATA10_GPIO=18
CONFIG_EXAMPLE_LCD_DATA11_GPIO=19
CONFIG_EXAMPLE_LCD_DATA12_GPIO=33
CONFIG_EXAMPLE_LCD_DATA13_GPIO=34
CONFIG_EXAMPLE_LCD_DATA14_GPIO=35
CONFIG_EXAMPLE_LCD_DATA15_GPIO=36

# R0:R7 <=> DATA16:DATA23
CONFIG_EXAMPLE_LCD_DATA16_GPIO=37
CONFIG_EXAMPLE_LCD_DATA17_GPIO=38
CONFIG_EXAMPLE_LCD_DATA18_GPIO=39
CONFIG_EXAMPLE_LCD_DATA19_GPIO=2
CONFIG_EXAMPLE_LCD_DATA20_GPIO=3
CONFIG_EXAMPLE_LCD_DATA21_GPIO=4
CONFIG_EXAMPLE_LCD_DATA22_GPIO=5
CONFIG_EXAMPLE_LCD_DATA23_GPIO=7
```

## examples/peripherals/rmt/ir_protocols/main/Kconfig.projbuild
```kconfig
menu "Example Configuration"
    choice EXAMPLE_IR_PROTOCOL
        prompt "Infrared Protocol"
        default EXAMPLE_IR_PROTOCOL_NEC
        help
            Choose the IR protocol used in the example.

        config EXAMPLE_IR_PROTOCOL_NEC
            bool "NEC"
            help
                NEC is a kind of Pulse Distance Protocol.
                It uses ASK modulation and pulse distance encoding with a carrier frequency of 38 kHz.

        config EXAMPLE_IR_PROTOCOL_RC5
            bool "RC5"
            help
                The RC5 protocol was introduced by Philips.
                It uses ASK modulation and Manchester encoding with carrier frequency fixed at 36 kHz.

    endchoice

    config EXAMPLE_RMT_TX_GPIO
        int "RMT TX GPIO"
        default 18
        help
            Set the GPIO number used for transmitting the RMT signal.

    config EXAMPLE_RMT_RX_GPIO
        int "RMT RX GPIO"
        default 19
        help
            Set the GPIO number used for receiving the RMT signal.

    config EXAMPLE_RMT_TX_CHANNEL
        int "RMT TX Channel Number"
        default 0
        help
            Set the RMT TX channel number.

    config EXAMPLE_RMT_RX_CHANNEL
        int "RMT RX Channel Number"
        default 4 if IDF_TARGET_ESP32S3
        default 2
        help
            Set the RMT RX channel number.
endmenu
```

## examples/peripherals/rmt/led_strip/main/Kconfig.projbuild
```kconfig
menu "Example Configuration"
    config EXAMPLE_RMT_TX_GPIO
        int "RMT TX GPIO"
        default 18
        help
            Set the GPIO number used for transmitting the RMT signal.

    config EXAMPLE_STRIP_LED_NUMBER
        int "Number of LEDS in a strip"
        default 24
        help
            A single RGB strip contains several LEDs.
endmenu
```

## examples/peripherals/rmt/morse_code/main/Kconfig.projbuild
```kconfig
menu "Example Configuration"
    config EXAMPLE_RMT_TX_GPIO
        int "RMT TX GPIO"
        default 18
        help
            Set the GPIO number used for transmitting the RMT signal.
endmenu
```

## examples/peripherals/sdio/host/Kconfig.projbuild
```kconfig
menu "Example Configuration"

choice EXAMPLE_SLAVE
    prompt "Id of Slave used in Espressif master-slave board."
    default EXAMPLE_SLAVE_NONE
    help
        If Espressif master-slave board is used, select which slave is used.

config EXAMPLE_SLAVE_NONE
    bool "Not using Espressif master-slave board."
config EXAMPLE_SLAVE_B1
    bool "Using slave B1"
config EXAMPLE_SLAVE_B2
    bool "Using slave B2"
config EXAMPLE_SLAVE_B3
    bool "Using slave B3"
endchoice

endmenu
```

## examples/peripherals/sdio/host/main/Kconfig.projbuild
```kconfig
menu "Example Configuration"

    orsource "$IDF_PATH/examples/common_components/env_caps/$IDF_TARGET/Kconfig.env_caps"

    choice EXAMPLE_SDIO_INTERFACE
        prompt "Interface to communicate with slave"
        default EXAMPLE_SDIO_OVER_SDMMC
        help
            There are two interfaces to communicate with the SDIO slave: SDMMC and SPI.
            The SDMMC interface is 8 times faster than the SPI interface. However not all Espressif chips have this
            interface.

            Alternatively you can use the SPI interface.

        config EXAMPLE_SDIO_OVER_SDMMC
            bool "SDMMC host"
            depends on SOC_SDMMC_HOST_SUPPORTED

        config EXAMPLE_SDIO_OVER_SPI
            bool "SPI"
            depends on IDF_TARGET_ESP32
    endchoice

    config EXAMPLE_SDIO_4BIT
        bool "Host tries using 4-bit mode to communicate with slave"
        default n
        depends on !EXAMPLE_SDIO_OVER_SPI
        help
            If this is set, the host tries using 4-bit mode to communicate with
            slave. If failed, the communication falls back to 1-bit mode.

            If this is not set, the host uses 1-bit mode. However, CMD1 is still
            mandatory for interrupts.

            Note that 4-bit mode is not compatible (by default) if the slave is
            using 3.3V flash which requires a pull-down on the MTDI pin.

    config EXAMPLE_SDIO_HIGHSPEED
        bool "Host tries using HS mode to communicate with slave"
        default y
        depends on EXAMPLE_SDIO_OVER_SDMMC
        help
            If this is set, the host tries using high-speed mode to communicate
            with slave. If the slave doesn't support high-speed mode, the
            communication falls back to default-speed mode. If this is not set,
            the host uses DS mode.

            If the example does not work, please try disabling the HS mode.

    config EXAMPLE_ADJUSTABLE_PIN
        bool
        default EXAMPLE_SDIO_OVER_SPI || SOC_SDMMC_USE_GPIO_MATRIX

    config EXAMPLE_PIN_CMD
        int "CMD (MOSI) GPIO number"
        depends on EXAMPLE_ADJUSTABLE_PIN
        range ENV_GPIO_RANGE_MIN ENV_GPIO_OUT_RANGE_MAX
        default 15

    config EXAMPLE_PIN_CLK
        int "CLK GPIO number"
        depends on EXAMPLE_ADJUSTABLE_PIN
        range ENV_GPIO_RANGE_MIN ENV_GPIO_OUT_RANGE_MAX
        default 14

    config EXAMPLE_PIN_D0
        int "D0 (MISO) GPIO number"
        depends on EXAMPLE_ADJUSTABLE_PIN
        range ENV_GPIO_RANGE_MIN ENV_GPIO_OUT_RANGE_MAX
        default 2

    config EXAMPLE_PIN_D1
        int "D1 (INTR) GPIO number"
        depends on EXAMPLE_ADJUSTABLE_PIN
        range ENV_GPIO_RANGE_MIN ENV_GPIO_OUT_RANGE_MAX
        default 4

    config EXAMPLE_PIN_D2
        int "D2 GPIO number"
        depends on EXAMPLE_ADJUSTABLE_PIN
        range ENV_GPIO_RANGE_MIN ENV_GPIO_OUT_RANGE_MAX
        default 12

    config EXAMPLE_PIN_D3
        int "D3 (CS) GPIO number"
        depends on EXAMPLE_ADJUSTABLE_PIN
        range ENV_GPIO_RANGE_MIN ENV_GPIO_OUT_RANGE_MAX
        default 13

    choice EXAMPLE_SLAVE
        prompt "GPIO to control slave EN in Espressif master-slave board."
        default EXAMPLE_SLAVE_NONE
        help
            If Espressif master-slave board is used, select the correct GPIO to control slave's EN.

        config EXAMPLE_SLAVE_NONE
            bool "Not using Espressif master-slave board."
        config EXAMPLE_SLAVE_B1
            bool "Using slave B1"
    endchoice

    config EXAMPLE_SLAVE_PWR_NEGTIVE_ACTIVE
        bool "Slave power control pin is negtive active, otherwise postive active"
        depends on !EXAMPLE_SLAVE_NONE
        default n
        help
            Slave power control pin is negtive active, otherwise postive active

    config EXAMPLE_NO_INTR_LINE
        bool "The host is not connected to the interrupt line (DAT1) of slave"
        default n
        help
            If this is set, the host example will not check the interrupt line but poll slave
            registers to see whether the slave has interrupts for the host.

            Working without the interrupt line may increase the CPU load of the host, and do harm
            to the response speed to slave events, though can save 1 GPIO for other purposes in
            non-4-bit mode.

endmenu
```

## examples/peripherals/sdio/host/sdkconfig.defaults.esp32p4
```kconfig
## On P4-SDMMC + C5 SDIO test runner environment, hardware delay needs to be considered
CONFIG_EXAMPLE_SDIO_HOST_DELAY=2
```

## examples/peripherals/sdio/slave/main/Kconfig.projbuild
```kconfig
menu "Example Configuration"

    config SDIO_DAT2_DISABLED
        bool "Disable the DAT2 in SDIO slave"
        default n
        help
            SDIO slave DAT pin is unfortunately the same pin as MTDI, which
            controls the flash power voltage. For 3.3v flash devkits / modules /
            kits, it conflicts with the DAT2 pullups required by the
            specification.

            This disables the peripheral input from the DAT2 so that we can work
            in 1-bit mode when DAT2 is floating (pulled down). 4-bit mode is
            therefore unavailable.

endmenu
```

## examples/peripherals/secure_element/atecc608_ecdsa/sdkconfig.defaults
```kconfig
CONFIG_ATCA_MBEDTLS_ECDSA=y
CONFIG_ATCA_MBEDTLS_ECDSA_SIGN=y
CONFIG_ATCA_MBEDTLS_ECDSA_VERIFY=y
```

## examples/peripherals/security/atecc608_ecdsa/sdkconfig.defaults
```kconfig
# Enable Cryptoauthlib hardware acceleration of mbedtls
CONFIG_ATCA_MBEDTLS_ECDSA=y
CONFIG_ATCA_MBEDTLS_ECDSA_SIGN=y
CONFIG_ATCA_MBEDTLS_ECDSA_VERIFY=y
```

## examples/peripherals/spi_master/hd_eeprom/main/Kconfig.projbuild
```kconfig
menu "Example Configuration"

    config EXAMPLE_USE_SPI1_PINS
        bool "The example uses SPI1 shared pins for EEPROM connection"
        default n
        depends on SPI_FLASH_SHARE_SPI1_BUS
        select GPIO_CTRL_FUNC_IN_IRAM
        select COMPILER_OPTIMIZATION_CHECKS_SILENT # silent the error check, as the error string are stored in rodata
        help
            Enable this option will make the EEPROM use SPI1 pins, which is shared with the main
            flash chip. Therefore, when doing transaction on SPI1 bus, data cannot be fetched
            from the flash, so all the data used during this time should be put into the internal RAM.

            Currently this example hasn't supported SPI1 pins on other chips yet.

    config EXAMPLE_INTR_USED
        bool "Use the interrupt to detect the eeprom busy"
        default y
        depends on !EXAMPLE_USE_SPI1_PINS
        help
            Enable this option will allow the example to be blocked while the EEPROM is working
            in progress, and unblocked by GPIO interrupt. Otherwise the example will keep polling
            until the EEPROM is idle.

    config EXAMPLE_5V_COMMANDS
        bool "The EEPROM is supplied by 5V power"
        default n
        help
            The Erase_All and Write_All commands of EEPROM are only supported when EEPROM is
            supplied by 5V power. Enable this to use those two commands.

            But please note that ESP chips don't support 5V IO, you need to add external
            level-shifting circuits between ESP chip to the EEPROM.

endmenu
```

## examples/peripherals/spi_master/main/Kconfig.projbuild
```kconfig
menu "Example Configuration"

choice LCD_TYPE
	prompt "LCD module type"
	default LCD_TYPE_AUTO
	help
		The type of LCD on the evaluation board.

config LCD_TYPE_AUTO
	bool "Auto detect"
config LCD_TYPE_ST7789V
	bool "ST7789V (WROVER Kit v2 or v3)"
config LCD_TYPE_ILI9341
	bool "ILI9341 (WROVER Kit v1 or DevKitJ v1)"
endchoice

config LCD_OVERCLOCK
	bool
	prompt "Run LCD at higher clock speed than allowed"
	default "n"
	help
		The ILI9341 and ST7789 specify that the maximum clock speed for the SPI interface is 10MHz. However,
		in practice the driver chips work fine with a higher clock rate, and using that gives a better framerate.
		Select this to try using the out-of-spec clock rate.

endmenu
```

## examples/peripherals/timer_group/wiegand_interface/sdkconfig.defaults
```kconfig
CONFIG_GPIO_CTRL_FUNC_IN_IRAM=y
CONFIG_GPTIMER_CTRL_FUNC_IN_IRAM=y
CONFIG_GPTIMER_ISR_HANDLER_IN_IRAM=y
```

## examples/peripherals/touch_element/touch_element_sleep/touch_elem_auto_sleep/main/Kconfig.projbuild
```kconfig
menu "Example Configuration"

    config TE_PM_ENABLE
        bool "Touch Element power management"
        default y

    config TE_MAX_CPU_FREQ
        int "Touch Element sleep DFS maximum cpu frequency"
        depends on PM_DFS_INIT_AUTO
        default ESP32S2_DEFAULT_CPU_FREQ_MHZ

    config TE_MIN_CPU_FREQ
        int "Touch Element sleep DFS minimum cpu frequency"
        depends on PM_DFS_INIT_AUTO
        default 10

endmenu
```
