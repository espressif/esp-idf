## examples/peripherals/touch_sensor/touch_element/touch_element_waterproof/main/Kconfig.projbuild
```kconfig
menu "Example Configuration"

    config TOUCH_WATERPROOF_GUARD_ENABLE
        bool "Enable touch sense waterproof guard sensor"
        default y
        help
                This option enables touch sense waterproof guard sensor,
                while the shield sensor is not optional.

endmenu
```

## examples/peripherals/touch_sensor/touch_sens_sleep/main/Kconfig.projbuild
```kconfig
menu "Example Configuration"

    choice EXAMPLE_TOUCH_SLP_WAKEUP
        prompt "Touch Sensor wakeup level"
        default EXAMPLE_TOUCH_LIGHT_SLEEP_WAKEUP
        help
            Select the touch sensor can wakeup from light sleep or deep sleep.

        config EXAMPLE_TOUCH_LIGHT_SLEEP_WAKEUP
            bool "Light sleep wakeup"
        config EXAMPLE_TOUCH_DEEP_SLEEP_WAKEUP
            bool "Deep sleep wakeup"
    endchoice

    config EXAMPLE_TOUCH_DEEP_SLEEP_PD
        prompt "Allow touch sensor power down during the deep sleep"
        bool
        depends on EXAMPLE_TOUCH_DEEP_SLEEP_WAKEUP && !IDF_TARGET_ESP32
        default "n"
        help
            Whether to allow the touch sensor power down during the deep sleep.
            If enabled, the touch sensor will be powered down during the deep sleep,
            only one specified touch channel can wakeup the chip from deep sleep.
            If disabled, the touch sensor will keep working during the deep sleep,
            any enabled touch channel can wakeup the chip from deep sleep.

endmenu
```

## examples/peripherals/twai/cybergear/main/Kconfig.projbuild
```kconfig
menu "Example Configuration"

    orsource "$IDF_PATH/examples/common_components/env_caps/$IDF_TARGET/Kconfig.env_caps"

    config EXAMPLE_TWAI_TX_GPIO_NUM
        int "TX GPIO number"
        range ENV_GPIO_RANGE_MIN ENV_GPIO_OUT_RANGE_MAX
        default 0
        help
            This option selects the GPIO pin used for the TWAI TX signal. Connect the
            TWAI TX signal to your transceiver.

    config EXAMPLE_TWAI_RX_GPIO_NUM
        int "RX GPIO number"
        range ENV_GPIO_RANGE_MIN ENV_GPIO_IN_RANGE_MAX
        default 2
        help
            This option selects the GPIO pin used for the TWAI RX signal. Connect the
            TWAI RX signal to your transceiver.

    config EXAMPLE_TWAI_ESP_NODE_ID
        int "TWAI ESP Node ID"
        range 0 256
        default 254
        help
            This option selects the ESP Node ID of the ESP Controller.

    config EXAMPLE_TWAI_MOTOR_ID
        int "TWAI CyberGear motor ID"
        range 0 256
        default 127
        help
            This option selects the motor ID of the CyberGear. 127 is the factory value.
            Check the README if you don't know how to get the motor ID.

    choice EXAMPLE_TWAI_MOTOR_BITRATE_CHOICE
        prompt "TWAI CyberGear motor bitrate"
        default EXAMPLE_TWAI_MOTOR_BITRATE_1M
        help
            This option selects the bitrate of the CyberGear.

        config EXAMPLE_TWAI_MOTOR_BITRATE_1M
            bool "1M"
        config EXAMPLE_TWAI_MOTOR_BITRATE_500K
            bool "500K"
        config EXAMPLE_TWAI_MOTOR_BITRATE_250K
            bool "250K"
        config EXAMPLE_TWAI_MOTOR_BITRATE_125K
            bool "125K"
    endchoice

    config EXAMPLE_TWAI_MOTOR_BITRATE
        int
        default 1000000 if EXAMPLE_TWAI_MOTOR_BITRATE_1M
        default 500000 if EXAMPLE_TWAI_MOTOR_BITRATE_500K
        default 250000 if EXAMPLE_TWAI_MOTOR_BITRATE_250K
        default 125000 if EXAMPLE_TWAI_MOTOR_BITRATE_125K

endmenu
```

## examples/peripherals/twai/twai_network/twai_listen_only/main/Kconfig.projbuild
```kconfig
menu "Example Configuration"

    config EXAMPLE_TWAI_TX_GPIO
        int "TWAI TX GPIO Num"
        range 0 SOC_GPIO_OUT_RANGE_MAX
        default 4
        help
            GPIO number for TWAI TX to transceiver.

    config EXAMPLE_TWAI_RX_GPIO
        int "TWAI RX GPIO Num"
        range 0 SOC_GPIO_IN_RANGE_MAX
        default 5
        help
            GPIO number for TWAI RX from transceiver.

endmenu
```

## examples/peripherals/twai/twai_network/twai_network_listen_only/main/Kconfig.projbuild
```kconfig
menu "Example Configuration"

    config EXAMPLE_TX_GPIO_NUM
        int "TX GPIO number"
        default 21 if IDF_TARGET_ESP32
        default 0
        help
            This option selects the GPIO pin used for the TX signal. Connect the
            TX signal to your transceiver.

    config EXAMPLE_RX_GPIO_NUM
        int "RX GPIO number"
        default 22 if IDF_TARGET_ESP32
        default 2
        help
            This option selects the GPIO pin used for the RX signal. Connect the
            RX signal to your transceiver.

endmenu
```

## examples/peripherals/twai/twai_self_test/main/Kconfig.projbuild
```kconfig
menu "Example Configuration"

    orsource "$IDF_PATH/examples/common_components/env_caps/$IDF_TARGET/Kconfig.env_caps"

    config EXAMPLE_TX_GPIO_NUM
        int "TX GPIO number"
        range ENV_GPIO_RANGE_MIN ENV_GPIO_OUT_RANGE_MAX
        default 21 if IDF_TARGET_ESP32
        default 0
        help
            This option selects the GPIO pin used for the TX signal. Connect the
            TX signal to your transceiver.

    config EXAMPLE_RX_GPIO_NUM
        int "RX GPIO number"
        range ENV_GPIO_RANGE_MIN ENV_GPIO_IN_RANGE_MAX
        default 22 if IDF_TARGET_ESP32
        default 2
        help
            This option selects the GPIO pin used for the RX signal. Connect the
            RX signal to your transceiver.

endmenu
```

## examples/peripherals/twai/twai_utils/main/Kconfig.projbuild
```kconfig
menu "TWAI Configuration"
    depends on SOC_TWAI_SUPPORTED

    orsource "$IDF_PATH/examples/common_components/env_caps/$IDF_TARGET/Kconfig.env_caps"

    config EXAMPLE_ENABLE_TWAI_FD
        bool "Enable TWAI-FD Support"
        depends on SOC_TWAI_FD_SUPPORTED
        default false
        help
            Enable TWAI-FD (Flexible Data-rate) support.
            Allows up to 64 bytes of data per frame and dual bit rates.
            Only available on chips that support TWAI-FD.

    config EXAMPLE_DEFAULT_BITRATE
        int "Default Arbitration Bitrate"
        default 500000
        help
            Default arbitration bitrate in bits per second (bps).

    config EXAMPLE_DEFAULT_FD_BITRATE
        int "Default FD Data Bitrate"
        depends on EXAMPLE_ENABLE_TWAI_FD
        default 1000000
        help
            Default data bitrate for TWAI-FD in bits per second (bps).

    config EXAMPLE_TX_QUEUE_LEN
        int "TX Queue Length"
        range 1 100
        default 10
        help
            Length of the transmission queue for TWAI messages.

    config EXAMPLE_DUMP_QUEUE_SIZE
        int "TWAI Dump Queue Size"
        default 32
        help
            Size of the queue used to store received TWAI frames for dump task.

    config EXAMPLE_DUMP_TASK_STACK_SIZE
        int "TWAI Dump Task Stack Size"
        default 4096
        help
            Stack size of the TWAI dump task.

    config EXAMPLE_DUMP_TASK_PRIORITY
        int "TWAI Dump Task Priority"
        default 10
        range 0 24
        help
            Priority of the TWAI dump task.

    config EXAMPLE_DUMP_TASK_TIMEOUT_MS
        int "TWAI Dump Task Timeout"
        default 300
        help
            Timeout for the TWAI dump task.

endmenu
```

## examples/peripherals/uart/nmea0183_parser/main/Kconfig.projbuild
```kconfig
menu "Example Configuration"

    orsource "$IDF_PATH/examples/common_components/env_caps/$IDF_TARGET/Kconfig.env_caps"

    config NMEA_PARSER_UART_RXD
        int "UART RXD pin number"
        range ENV_GPIO_RANGE_MIN ENV_GPIO_IN_RANGE_MAX
        default 5
        help
            GPIO number for UART RX pin. See UART documentation for more information
            about available pin numbers for UART.

    config NMEA_PARSER_RING_BUFFER_SIZE
        int "NMEA Parser Ring Buffer Size"
        range 0 2048
        default 1024
        help
            Size of the ring buffer used for UART Rx channel.

    config NMEA_PARSER_TASK_STACK_SIZE
        int "NMEA Parser Task Stack Size"
        range 0 4096
        default 3072
        help
            Stack size of NMEA Parser task.

    config NMEA_PARSER_TASK_PRIORITY
        int "NMEA Parser Task Priority"
        range 0 24
        default 2
        help
            Priority of NMEA Parser task.

    menu "NMEA Statement Support"
        comment "At least one statement must be selected"
        config NMEA_STATEMENT_GGA
            bool "GGA Statement"
            default y
            help
                Enabling this option will parse the following parameter from GGA statement:

                - Latitude, Longitude, Altitude;
                - Number of satellites in use, fix status (no fix, GPS, DGPS), UTC time;

        config NMEA_STATEMENT_GSA
            bool "GSA Statement"
            default y
            help
                Enabling this option will parse the following parameter from GSA statement:

                - Position/Vertical/Horizontal dilution of precision;
                - Fix mode (no fix, 2D, 3D fix);
                - IDs of satellites in use;

        config NMEA_STATEMENT_GSV
            bool "GSV Statement"
            default y
            help
                Enabling this option will parse the following parameter from GSV statement:

                - Number of satellites in view;
                - Optional details of each satellite in view;

        config NMEA_STATEMENT_RMC
            bool "RMC Statement"
            default y
            help
                Enabling this option will parse the following parameter from RMC statement:

                - Validity of GPS signal;
                - Ground speed (knots) and course over ground (degrees);
                - Magnetic variation;
                - UTC date;

        config NMEA_STATEMENT_GLL
            bool "GLL Statement"
            default y
            help
                Enabling this option will parse the following parameter from GLL statement:

                - Latitude, Longitude;
                - UTC time;

        config NMEA_STATEMENT_VTG
            bool "VTG Statement"
            default y
            help
                Enabling this option will parse the following parameter from VTG statement:

                - Ground speed (knots, km/h) and course over ground (degrees);
                - Magnetic variation;

    endmenu

endmenu
```

## examples/peripherals/uart/uart_async_rxtxtasks/main/Kconfig.projbuild
```kconfig
menu "Example Configuration"

    orsource "$IDF_PATH/examples/common_components/env_caps/$IDF_TARGET/Kconfig.env_caps"

    config EXAMPLE_UART_BAUD_RATE
        int "UART communication speed"
        range 1200 115200
        default 115200
        help
            UART communication speed for the example.

    config EXAMPLE_UART_RXD
        int "UART RXD pin number"
        range ENV_GPIO_RANGE_MIN ENV_GPIO_IN_RANGE_MAX
        default 5
        help
            GPIO number for UART RX pin. See UART documentation for more information
            about available pin numbers for UART.

    config EXAMPLE_UART_TXD
        int "UART TXD pin number"
        range ENV_GPIO_RANGE_MIN ENV_GPIO_OUT_RANGE_MAX
        default 4
        help
            GPIO number for UART TX pin. See UART documentation for more information
            about available pin numbers for UART.

    config EXAMPLE_TASK_STACK_SIZE
        int "Example task stack size"
        range 1024 16384
        default 3072
        help
            Defines stack size for UART TX and RX tasks. Insufficient stack size can cause crash.

endmenu
```

## examples/peripherals/uart/uart_dma_ota/main/Kconfig.projbuild
```kconfig
menu "Example Configuration"

    config UART_RX_IO
        int "UART RX GPIO Num"
        default 2
        help
            GPIO number for UART RX line.

    config UART_PORT_NUM
        int "UART port number"
        default 1
        help
            The UART device attached to DMA.

    config UART_BAUD_RATE
        int "uart baud rate"
        default 1000000
        help
            Uart baud rate.

endmenu
```

## examples/peripherals/uart/uart_echo/main/Kconfig.projbuild
```kconfig
menu "Echo Example Configuration"

    config EXAMPLE_UART_PORT_NUM
        int "UART port number"
        range 0 2 if IDF_TARGET_ESP32
        range 0 1 if IDF_TARGET_ESP32S2 || IDF_TARGET_ESP32C3
        default 2 if IDF_TARGET_ESP32
        default 1 if IDF_TARGET_ESP32S2 || IDF_TARGET_ESP32C3
        help
            UART communication port number for the example.
            See UART documentation for available port numbers.

    config EXAMPLE_UART_BAUD_RATE
        int "UART communication speed"
        range 1200 115200
        default 115200
        help
            UART communication speed for Modbus example.

    config EXAMPLE_UART_RXD
        int "UART RXD pin number"
        range 0 34 if IDF_TARGET_ESP32
        range 0 46 if IDF_TARGET_ESP32S2
        range 0 19 if IDF_TARGET_ESP32C3
        default 5
        help
            GPIO number for UART RX pin. See UART documentation for more information
            about available pin numbers for UART.

    config EXAMPLE_UART_TXD
        int "UART TXD pin number"
        range 0 34 if IDF_TARGET_ESP32
        range 0 46 if IDF_TARGET_ESP32S2
        range 0 19 if IDF_TARGET_ESP32C3
        default 4
        help
            GPIO number for UART TX pin. See UART documentation for more information
            about available pin numbers for UART.

    config EXAMPLE_TASK_STACK_SIZE
        int "UART echo example task stack size"
        range 1024 16384
        default 2048
        help
            Defines stack size for UART echo example. Insufficient stack size can cause crash.

endmenu
```
