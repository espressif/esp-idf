## examples/peripherals/uart/uart_echo_rs485/main/Kconfig.projbuild
```kconfig
menu "Echo RS485 Example Configuration"

    orsource "$IDF_PATH/examples/common_components/env_caps/$IDF_TARGET/Kconfig.env_caps"

    config ECHO_UART_PORT_NUM
        int "UART port number"
        range 0 2 if IDF_TARGET_ESP32 || IDF_TARGET_ESP32S3
        default 2 if IDF_TARGET_ESP32 || IDF_TARGET_ESP32S3
        range 0 1
        default 1
        help
            UART communication port number for the example.
            See UART documentation for available port numbers.

    config ECHO_UART_BAUD_RATE
        int "UART communication speed"
        range 1200 115200
        default 115200
        help
            UART communication speed.

    config ECHO_RS485_RX_IO
        int "RS485 RXD pin number"
        range ENV_GPIO_RANGE_MIN ENV_GPIO_IN_RANGE_MAX
        default 22 if IDF_TARGET_ESP32
        default 8 if !IDF_TARGET_ESP32
        help
            GPIO number for RS485 RO pin. See UART documentation for more information
            about available pin numbers for UART.

    config ECHO_RS485_TX_IO
        int "RS485 TXD pin number"
        range ENV_GPIO_RANGE_MIN ENV_GPIO_OUT_RANGE_MAX
        default 23 if IDF_TARGET_ESP32
        default 9 if !IDF_TARGET_ESP32
        help
            GPIO number for RS485 DI pin. See UART documentation for more information
            about available pin numbers for UART.

    config ECHO_RS485_DIRECTION_IO
        int "RS485 ~RE/DE pin number"
        range ENV_GPIO_RANGE_MIN ENV_GPIO_OUT_RANGE_MAX
        default 18 if IDF_TARGET_ESP32
        default 13 if IDF_TARGET_ESP32C6 || IDF_TARGET_ESP32C61 || IDF_TARGET_ESP32H4
        default 10
        help
            GPIO number for the pin to connected to
            ~RE/DE pin of RS485 transceiver to switch direction.
            See UART documentation for more information about available pin
            numbers for UART.

    config ECHO_TASK_STACK_SIZE
        int "UART echo RS485 example task stack size"
        range 1024 16384
        default 3072
        help
            Defines stack size for UART echo RS485 example. Insufficient stack size can cause crash.

endmenu
```

## examples/peripherals/usb/device/cherryusb_serial_device/main/Kconfig.projbuild
```kconfig
menu "Example Configuration"

    choice EXAMPLE_USB_DEVICE_RHPORT
        prompt "USB Device Peripheral"
        default EXAMPLE_USB_DEVICE_RHPORT_HS if IDF_TARGET_ESP32P4
        default EXAMPLE_USB_DEVICE_RHPORT_FS
        help
            Allows set the USB Peripheral Controller for USB device.

            - High-speed (USB OTG2.0 Peripheral for High-, Full- and Low-speed)
            - Full-speed (USB OTG1.1 Peripheral for Full- and Low-speed)

        config EXAMPLE_USB_DEVICE_RHPORT_HS
            bool "OTG2.0"
            depends on IDF_TARGET_ESP32P4
        config EXAMPLE_USB_DEVICE_RHPORT_FS
            bool "OTG1.1"

    endchoice

    config EXAMPLE_CHERRYUSB_CDC_ACM_TWO_CHANNEL
        bool "Enable usb cdc acm two channel"
        default n

    config EXAMPLE_CHERRYUSB_INIT_DEINIT_LOOP
        bool "Perform init deinit of cherryusb stack in a loop"
        default n

    config EXAMPLE_CHERRYUSB_SET_READ_BUFFER_SIZE_MPS
        bool "set usb read buffer size to MPS"
        default y
        help
            If this option is disabled, a larger receive buffer will be configured for DMA at a time,
            which may improve efficiency a little. However, when the host sends data with a length that
            is an integer multiple of MPS, the host may not send ZLP, resulting in failure to report
            the receipt of data in a timely manner.

endmenu
```

## examples/peripherals/usb/device/cherryusb_serial_device/sdkconfig.defaults
```kconfig
CONFIG_CHERRYUSB=y
CONFIG_CHERRYUSB_DEVICE=y
CONFIG_CHERRYUSB_DEVICE_DWC2_ESP=y
CONFIG_CHERRYUSB_DEVICE_CDC_ACM=y
```

## examples/peripherals/usb/device/tusb_msc/sdkconfig.defaults.esp32p4
```kconfig
CONFIG_EXAMPLE_PIN_CMD=44
CONFIG_EXAMPLE_PIN_CLK=43
CONFIG_EXAMPLE_PIN_D0=39
CONFIG_EXAMPLE_PIN_D1=40
CONFIG_EXAMPLE_PIN_D2=41
CONFIG_EXAMPLE_PIN_D3=42
CONFIG_EXAMPLE_SD_PWR_CTRL_LDO_INTERNAL_IO=y
CONFIG_EXAMPLE_SD_PWR_CTRL_LDO_IO_ID=4
```

## examples/peripherals/usb/device/tusb_msc/sdkconfig.defaults.esp32s3
```kconfig
CONFIG_EXAMPLE_PIN_CMD=35
CONFIG_EXAMPLE_PIN_CLK=36
CONFIG_EXAMPLE_PIN_D0=37
CONFIG_EXAMPLE_PIN_D1=38
CONFIG_EXAMPLE_PIN_D2=33
CONFIG_EXAMPLE_PIN_D3=34
```
