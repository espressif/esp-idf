/* led_matrix - Example
   For other examples please check:
   https://github.com/espressif/esp-idf/tree/master/examples
   This example code is in the Public Domain (or CC0 licensed, at your option.)
   Unless required by applicable law or agreed to in writing, this
   software is distributed on an "AS IS" BASIS, WITHOUT WARRANTIES OR
   CONDITIONS OF ANY KIND, either express or implied.
*/

#include "freertos/FreeRTOS.h"
#include "esp_wifi.h"
#include "esp_system.h"
#include "esp_event.h"
#include "esp_event_loop.h"
#include "nvs_flash.h"
#include "driver/gpio.h"
#include <stdio.h>
#include "freertos/event_groups.h"
#include "lwip/sockets.h"


#include "lwip/err.h"
#include "lwip/sockets.h"
#include "lwip/sys.h"
#include "lwip/netdb.h"
#include "lwip/dns.h"
#include <string.h>
#include "driver/gpio.h"

#include <math.h>       /* ceil */

#include "LEDMatrix.h"
#include <stdint.h>

#define A GPIO_NUM_19
#define B GPIO_NUM_21
#define C GPIO_NUM_23
#define D GPIO_NUM_27
#define OE GPIO_NUM_26
#define CLK GPIO_NUM_25
#define R1 GPIO_NUM_22
#define R2 GPIO_NUM_2
#define STB GPIO_NUM_4



#define WIDTH   64
#define HEIGHT  32

uint8_t blinktime = 4;
uint8_t blinkinterval = 80;
uint8_t displaybufg[256];


//"closed" text  drawed if cant get data from internet or in case of some errors
uint8_t closed[256] = {

0x00, 0x00, 0x00, 0x00, 0x00, 0x00, 0x00, 0x00,
0x00, 0x00, 0x00, 0x00, 0x00, 0x00, 0x00, 0x00,
0x00, 0x00, 0x00, 0x00, 0x00, 0x00, 0x00, 0x00,
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0x00, 0x00, 0x00, 0x00, 0x00, 0x00, 0x00, 0x00

};



// fonts diigts 0-9 and characters : ; < = > ? -
uint8_t fonts[] = {

0x00,0x00,0x00,0x00,0x00,0x00,0x00,0x00,0x07,0xe0,0x0f,0xf0,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0x00,
0x00, 0x00, 0x00, 0x00, 0x00, 0x00, 0x00, 0x00, 0x00, 0x60, 0x00, 0xe0,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 0x00,
0x00, 0x00, 0x00, 0x00, 0x00, 0x00, 0x00, 0x00, 0x03, 0xe0, 0x0f, 0xf0,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 0x00,
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0x00,0x00,0x00,0x00,0x00,0x00, 0x00,0x00,0x00,0x00,0x00,0x00,0x00,0x00,0x00,0x00,0x00,0x00,0x00,0x00,0x00,0x00,0x00,0x00,0x00,0x00,0x00,0x00

};




//defoult wifi config
wifi_config_t sta_config = {
    .sta = {
    .ssid = "testsssid2",
    .password = "testpasswd2",
    .bssid_set = false
     }
};

const struct addrinfo hints = {
    .ai_family = AF_INET,
    .ai_socktype = SOCK_STREAM,
};

struct addrinfo *res;
struct in_addr *addr;


//array to save already received data to compare new data
char olddigit[5];

void http_polling();
void led_matrix();
void drawd(int,int,char);




//task which scan buffer and turn leds on
void led_matrix()
{

	while (true){
        scan();
    }
}

static esp_err_t event_handler(void *ctx, system_event_t *event)
{
    switch(event->event_id) {

        case SYSTEM_EVENT_STA_GOT_IP:

            break;
    
        case SYSTEM_EVENT_STA_DISCONNECTED:

            //if cant connect to default wifi config,use other wifi password and ssid 
            strcpy((char*)sta_config.sta.ssid,"testssid");
            strcpy((char*)sta_config.sta.password,"testpsswd");
            ESP_ERROR_CHECK( esp_wifi_stop() );
            ESP_ERROR_CHECK( esp_wifi_set_config(WIFI_IF_STA, &sta_config) );
            ESP_ERROR_CHECK( esp_wifi_start() );
            ESP_ERROR_CHECK( esp_wifi_connect() );
            break;

        default:

            break;
    }

    return ESP_OK;
}



//task which poll data from web server
void http_polling()
{	

    //reverse mask
    extern uint8_t mask;

    //led matrix status
    extern uint8_t enable;


    har *REQUEST ="GET /data HTTP/1.1\r\nHost: test.com\r\nConnection: close\r\n\r\n";
    char recv_buf[2000];
    int err = getaddrinfo("test.com", "80", &hints, &res);
    
    while (true) {

 	 		//sleep 400 ms
        vTaskDelay(400 / portTICK_PERIOD_MS);
        if(err != 0){
                
                //while error try again
                freeaddrinfo(res);
                err = getaddrinfo("test.com", "80", &hints, &res);
                continue;
        }

        ///clear receive buffer
        bzero(recv_buf,sizeof(recv_buf));
        int s = socket(AF_INET, SOCK_STREAM, 0);
        if(connect(s, res->ai_addr, res->ai_addrlen)<0) {

            continue;
        }


        if(write(s, REQUEST, strlen(REQUEST)) < 0) {

            close(s);
            continue;
        }

        int full_size = 0;
        int r = 0;
        do {

            r = read(s, recv_buf+full_size, 1000);
            full_size+=r;

        } 
        while(r > 0);

        close(s);
        if(full_size > 0) {

            //my data pattern is t=1234,i draw number or chars after '='
            char *number=strrchr(recv_buf,'=');
            int ds=strlen(number);
            char *substr=malloc(ds);

            if(ds) {

                bzero(substr,ds);

                //i dont want to draw '=',for that, increment number .number+1
                strncpy(substr, number + 1,ds);
                //check if received data match old data
                if(strcmp(olddigit,substr) != 0) {

                    //copy new data to old data
                    bzero(olddigit,sizeof(olddigit));
                    strncpy(olddigit,substr,ds);

                    //clear display buffer
                    clear();

                    int n = strlen(olddigit);
                    int i = 0;
                    int st = (4 * 16 - n * 16) / 2;
                    
                    //fill buffer with new data
                    while(i<n) {

                        drawd(st,0,olddigit[i]);
                        st+=16;
                        i+=1;
                    }

                    //blink led,when change data
                    for(i = 0;i < blinktime; i++) {
                        
                        vTaskDelay(blinkinterval / portTICK_PERIOD_MS);
                        enable = 0;
                        vTaskDelay(blinkinterval / portTICK_PERIOD_MS);
                        enable = 0xff;
 

               		}



            	}

                /clear dynamic alocated memory
                free(substr);

	    	  }

	    	}



    };

}


//function which draw char in display buffer
void drawd(int x,int y,char n){


    switch(n) {
	
        case ':':

            n=10;
            break;
	
        case ';':

            n=11;
            break;
	
        case '<':

            n=12;
            break;
	
        case '=':

            n=12;
            break;
	
        case '>':

            n = 14;
            break;
	
        case '?':

            n=15;
            break;
	
        case '-':

            n=16;
            break;

        default:

            n=n - '0';
            break;
	}

    int dsti = y * 8 + x / 8;
    int src = n * 64;
	int i = 0;
    for (i = 0;i < 32;i++) {
        displaybufg[dsti]=fonts[src];
        displaybufg[dsti+1]=fonts[src+1];
        dsti+=8;
        src+=2;

	}

}


void app_main(void)
{


    nvs_flash_init();
    tcpip_adapter_init();
    configure(A,B,C,D,OE,R1,R2,STB,CLK);
    memcpy(displaybufg, closed, 256);
    begin(displaybufg, WIDTH, HEIGHT);
    ESP_ERROR_CHECK( esp_event_loop_init(event_handler, NULL) );
    wifi_init_config_t cfg = WIFI_INIT_CONFIG_DEFAULT();
    ESP_ERROR_CHECK( esp_wifi_init(&cfg) );
    ESP_ERROR_CHECK( esp_wifi_set_storage(WIFI_STORAGE_RAM) );
    ESP_ERROR_CHECK( esp_wifi_set_mode(WIFI_MODE_STA) );
    ESP_ERROR_CHECK( esp_wifi_set_config(WIFI_IF_STA, &sta_config) );
    ESP_ERROR_CHECK( esp_wifi_start() );
    ESP_ERROR_CHECK( esp_wifi_connect() );
    xTaskCreatePinnedToCore(led_matrix,"led_matrix",4000,NULL,configMAX_PRIORITIES-1,NULL,1);
    xTaskCreatePinnedToCore(http_polling,"http_polling",10000,NULL,configMAX_PRIORITIES-1,NULL,0);


}

