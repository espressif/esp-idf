## examples/peripherals/lcd/parlio_simulate/sdkconfig.defaults
```kconfig
CONFIG_LV_CONF_SKIP=y
CONFIG_LV_USE_OBSERVER=y
CONFIG_LV_USE_SYSMON=y
CONFIG_LV_USE_PERF_MONITOR=y
CONFIG_FREERTOS_HZ=1000
```

## examples/peripherals/lcd/parlio_simulate/sdkconfig.defaults.esp32c5
```kconfig
CONFIG_SPIRAM=y
CONFIG_SPIRAM_SPEED_80M=y
# Enabling the following configurations can help increase the PCLK frequency in the case when
# the Frame Buffer is allocated from the PSRAM and fetched by EDMA
CONFIG_SPIRAM_XIP_FROM_PSRAM=y

CONFIG_EXAMPLE_PIN_NUM_BK_LIGHT=5
CONFIG_EXAMPLE_PIN_NUM_RST=2
CONFIG_EXAMPLE_PIN_NUM_PCLK=1
CONFIG_EXAMPLE_PIN_NUM_CS=0
CONFIG_EXAMPLE_PIN_NUM_DC=3
CONFIG_EXAMPLE_PIN_NUM_DATA0=4
CONFIG_EXAMPLE_PIN_NUM_DATA1=9
CONFIG_EXAMPLE_PIN_NUM_DATA2=28
CONFIG_EXAMPLE_PIN_NUM_DATA3=24
CONFIG_EXAMPLE_PIN_NUM_DATA4=14
CONFIG_EXAMPLE_PIN_NUM_DATA5=23
CONFIG_EXAMPLE_PIN_NUM_DATA6=13
CONFIG_EXAMPLE_PIN_NUM_DATA7=27
```

## examples/peripherals/lcd/parlio_simulate/sdkconfig.defaults.esp32h2
```kconfig
CONFIG_EXAMPLE_PIN_NUM_BK_LIGHT=2
CONFIG_EXAMPLE_PIN_NUM_RST=14
CONFIG_EXAMPLE_PIN_NUM_PCLK=5
CONFIG_EXAMPLE_PIN_NUM_CS=3
CONFIG_EXAMPLE_PIN_NUM_DC=13
CONFIG_EXAMPLE_PIN_NUM_DATA0=4
```

## examples/peripherals/lcd/parlio_simulate/sdkconfig.defaults.esp32h21
```kconfig
CONFIG_EXAMPLE_PIN_NUM_BK_LIGHT=6
CONFIG_EXAMPLE_PIN_NUM_RST=2
CONFIG_EXAMPLE_PIN_NUM_PCLK=4
CONFIG_EXAMPLE_PIN_NUM_CS=0
CONFIG_EXAMPLE_PIN_NUM_DC=1
CONFIG_EXAMPLE_PIN_NUM_DATA0=3
```

## examples/peripherals/lcd/parlio_simulate/sdkconfig.defaults.esp32h4
```kconfig
CONFIG_SPIRAM=y
# Enabling the following configurations can help increase the PCLK frequency in the case when
# the Frame Buffer is allocated from the PSRAM and fetched by EDMA
CONFIG_SPIRAM_XIP_FROM_PSRAM=y

CONFIG_EXAMPLE_PIN_NUM_BK_LIGHT=13
CONFIG_EXAMPLE_PIN_NUM_RST=39
CONFIG_EXAMPLE_PIN_NUM_PCLK=15
CONFIG_EXAMPLE_PIN_NUM_CS=14
CONFIG_EXAMPLE_PIN_NUM_DC=38
CONFIG_EXAMPLE_PIN_NUM_DATA0=16
CONFIG_EXAMPLE_PIN_NUM_DATA1=37
CONFIG_EXAMPLE_PIN_NUM_DATA2=17
CONFIG_EXAMPLE_PIN_NUM_DATA3=36
CONFIG_EXAMPLE_PIN_NUM_DATA4=18
CONFIG_EXAMPLE_PIN_NUM_DATA5=35
CONFIG_EXAMPLE_PIN_NUM_DATA6=19
CONFIG_EXAMPLE_PIN_NUM_DATA7=34
```

## examples/peripherals/lcd/parlio_simulate/sdkconfig.defaults.esp32p4
```kconfig
CONFIG_SPIRAM=y
CONFIG_SPIRAM_MODE_HEX=y
CONFIG_SPIRAM_SPEED_200M=y
CONFIG_IDF_EXPERIMENTAL_FEATURES=y

CONFIG_EXAMPLE_PIN_NUM_BK_LIGHT=48
CONFIG_EXAMPLE_PIN_NUM_RST=35
CONFIG_EXAMPLE_PIN_NUM_PCLK=33
CONFIG_EXAMPLE_PIN_NUM_CS=32
CONFIG_EXAMPLE_PIN_NUM_DC=34
CONFIG_EXAMPLE_PIN_NUM_DATA0=24
CONFIG_EXAMPLE_PIN_NUM_DATA1=25
CONFIG_EXAMPLE_PIN_NUM_DATA2=26
CONFIG_EXAMPLE_PIN_NUM_DATA3=27
CONFIG_EXAMPLE_PIN_NUM_DATA4=28
CONFIG_EXAMPLE_PIN_NUM_DATA5=29
CONFIG_EXAMPLE_PIN_NUM_DATA6=30
CONFIG_EXAMPLE_PIN_NUM_DATA7=31
```

## examples/peripherals/lcd/rgb_panel/main/Kconfig.projbuild
```kconfig
menu "Example Configuration"
    choice EXAMPLE_LCD_BUFFER_MODE
        prompt "RGB LCD Buffer Mode"
        default EXAMPLE_USE_SINGLE_FB
        help
            Select the LCD buffer mode.

        config EXAMPLE_USE_SINGLE_FB
            bool "Use single frame buffer"
            help
                Allocate one frame buffer in the driver.
                Allocate one draw buffer in LVGL.

        config EXAMPLE_USE_DOUBLE_FB
            bool "Use double frame buffer"
            help
                Allocate two frame buffers in the driver.
                The frame buffers also work as ping-pong draw buffers in LVGL.

        config EXAMPLE_USE_BOUNCE_BUFFER
            bool "Use bounce buffer"
            help
                Allocate one frame buffer in the driver.
                Allocate two bounce buffers in the driver.
                Allocate one draw buffer in LVGL.
    endchoice

    choice EXAMPLE_LCD_DATA_LINES
        prompt "RGB LCD Data Lines"
        default EXAMPLE_LCD_DATA_LINES_16
        help
            Select the number of data lines of the RGB LCD.

        config EXAMPLE_LCD_DATA_LINES_16
            bool "16 data lines"

        config EXAMPLE_LCD_DATA_LINES_24
            bool "24 data lines"
    endchoice

    config EXAMPLE_LCD_DATA_LINES
        int
        default 16 if EXAMPLE_LCD_DATA_LINES_16
        default 24 if EXAMPLE_LCD_DATA_LINES_24

    menu "GPIO assignment"
        config EXAMPLE_LCD_VSYNC_GPIO
            int "VSYNC GPIO"
            help
                GPIO pin number for VSYNC signal.
        config EXAMPLE_LCD_HSYNC_GPIO
            int "HSYNC GPIO"
            help
                GPIO pin number for HSYNC signal.
        config EXAMPLE_LCD_DE_GPIO
            int "DE GPIO"
            help
                GPIO pin number for DE signal.
        config EXAMPLE_LCD_PCLK_GPIO
            int "PCLK GPIO"
            help
                GPIO pin number for PCLK signal.
        config EXAMPLE_LCD_DATA0_GPIO
            int "DATA0 GPIO"
            help
                GPIO pin number for data bus[0].
        config EXAMPLE_LCD_DATA1_GPIO
            int "DATA1 GPIO"
            help
                GPIO pin number for data bus[1].
        config EXAMPLE_LCD_DATA2_GPIO
            int "DATA2 GPIO"
            help
                GPIO pin number for data bus[2].
        config EXAMPLE_LCD_DATA3_GPIO
            int "DATA3 GPIO"
            help
                GPIO pin number for data bus[3].
        config EXAMPLE_LCD_DATA4_GPIO
            int "DATA4 GPIO"
            help
                GPIO pin number for data bus[4].
        config EXAMPLE_LCD_DATA5_GPIO
            int "DATA5 GPIO"
            help
                GPIO pin number for data bus[5].
        config EXAMPLE_LCD_DATA6_GPIO
            int "DATA6 GPIO"
            help
                GPIO pin number for data bus[6].
        config EXAMPLE_LCD_DATA7_GPIO
            int "DATA7 GPIO"
            help
                GPIO pin number for data bus[7].
        config EXAMPLE_LCD_DATA8_GPIO
            int "DATA8 GPIO"
            help
                GPIO pin number for data bus[8].
        config EXAMPLE_LCD_DATA9_GPIO
            int "DATA9 GPIO"
            help
                GPIO pin number for data bus[9].
        config EXAMPLE_LCD_DATA10_GPIO
            int "DATA10 GPIO"
            help
                GPIO pin number for data bus[10].
        config EXAMPLE_LCD_DATA11_GPIO
            int "DATA11 GPIO"
            help
                GPIO pin number for data bus[11].
        config EXAMPLE_LCD_DATA12_GPIO
            int "DATA12 GPIO"
            help
                GPIO pin number for data bus[12].
        config EXAMPLE_LCD_DATA13_GPIO
            int "DATA13 GPIO"
            help
                GPIO pin number for data bus[13].
        config EXAMPLE_LCD_DATA14_GPIO
            int "DATA14 GPIO"
            help
                GPIO pin number for data bus[14].
        config EXAMPLE_LCD_DATA15_GPIO
            int "DATA15 GPIO"
            help
                GPIO pin number for data bus[15].
        config EXAMPLE_LCD_DATA16_GPIO
            int "DATA16 GPIO"
            depends on EXAMPLE_LCD_DATA_LINES > 16
            help
                GPIO pin number for data bus[16].
        config EXAMPLE_LCD_DATA17_GPIO
            int "DATA17 GPIO"
            depends on EXAMPLE_LCD_DATA_LINES > 16
            help
                GPIO pin number for data bus[17].
        config EXAMPLE_LCD_DATA18_GPIO
            int "DATA18 GPIO"
            depends on EXAMPLE_LCD_DATA_LINES > 16
            help
                GPIO pin number for data bus[18].
        config EXAMPLE_LCD_DATA19_GPIO
            int "DATA19 GPIO"
            depends on EXAMPLE_LCD_DATA_LINES > 16
            help
                GPIO pin number for data bus[19].
        config EXAMPLE_LCD_DATA20_GPIO
            int "DATA20 GPIO"
            depends on EXAMPLE_LCD_DATA_LINES > 16
            help
                GPIO pin number for data bus[20].
        config EXAMPLE_LCD_DATA21_GPIO
            int "DATA21 GPIO"
            depends on EXAMPLE_LCD_DATA_LINES > 16
            help
                GPIO pin number for data bus[21].
        config EXAMPLE_LCD_DATA22_GPIO
            int "DATA22 GPIO"
            depends on EXAMPLE_LCD_DATA_LINES > 16
            help
                GPIO pin number for data bus[22].
        config EXAMPLE_LCD_DATA23_GPIO
            int "DATA23 GPIO"
            depends on EXAMPLE_LCD_DATA_LINES > 16
            help
                GPIO pin number for data bus[23].
    endmenu
endmenu
```

## examples/peripherals/lcd/rgb_panel/sdkconfig.defaults
```kconfig
CONFIG_LV_MEM_CUSTOM=y
CONFIG_LV_MEMCPY_MEMSET_STD=y
CONFIG_LV_USE_USER_DATA=y
CONFIG_LV_USE_CHART=y
CONFIG_LV_USE_PERF_MONITOR=y
```

## examples/peripherals/lcd/rgb_panel/sdkconfig.defaults.esp32p4
```kconfig
# enable the experimental features for higher PSRAM speed
CONFIG_IDF_EXPERIMENTAL_FEATURES=y

CONFIG_SPIRAM=y
CONFIG_SPIRAM_MODE_HEX=y
CONFIG_SPIRAM_SPEED_200M=y

# LCD_CAM support 24 data lines at most
CONFIG_EXAMPLE_LCD_DATA_LINES_24=y
CONFIG_LV_COLOR_DEPTH_24=y

# Default GPIO assignment
CONFIG_EXAMPLE_LCD_VSYNC_GPIO=41
CONFIG_EXAMPLE_LCD_HSYNC_GPIO=39
CONFIG_EXAMPLE_LCD_DE_GPIO=43
CONFIG_EXAMPLE_LCD_PCLK_GPIO=33

# B0:B7 <=> DATA0:DATA7
CONFIG_EXAMPLE_LCD_DATA0_GPIO=34
CONFIG_EXAMPLE_LCD_DATA1_GPIO=12
CONFIG_EXAMPLE_LCD_DATA2_GPIO=10
CONFIG_EXAMPLE_LCD_DATA3_GPIO=40
CONFIG_EXAMPLE_LCD_DATA4_GPIO=42
CONFIG_EXAMPLE_LCD_DATA5_GPIO=27
CONFIG_EXAMPLE_LCD_DATA6_GPIO=29
CONFIG_EXAMPLE_LCD_DATA7_GPIO=31

# G0:G7 <=> DATA8:DATA15
CONFIG_EXAMPLE_LCD_DATA8_GPIO=16
CONFIG_EXAMPLE_LCD_DATA9_GPIO=14
CONFIG_EXAMPLE_LCD_DATA10_GPIO=21
CONFIG_EXAMPLE_LCD_DATA11_GPIO=23
CONFIG_EXAMPLE_LCD_DATA12_GPIO=26
CONFIG_EXAMPLE_LCD_DATA13_GPIO=28
CONFIG_EXAMPLE_LCD_DATA14_GPIO=30
CONFIG_EXAMPLE_LCD_DATA15_GPIO=32

# R0:R7 <=> DATA16:DATA23
CONFIG_EXAMPLE_LCD_DATA16_GPIO=22
CONFIG_EXAMPLE_LCD_DATA17_GPIO=20
CONFIG_EXAMPLE_LCD_DATA18_GPIO=18
CONFIG_EXAMPLE_LCD_DATA19_GPIO=6
CONFIG_EXAMPLE_LCD_DATA20_GPIO=0
CONFIG_EXAMPLE_LCD_DATA21_GPIO=15
CONFIG_EXAMPLE_LCD_DATA22_GPIO=17
CONFIG_EXAMPLE_LCD_DATA23_GPIO=19
```

## examples/peripherals/lcd/rgb_panel/sdkconfig.defaults.esp32s3
```kconfig
CONFIG_SPIRAM=y
CONFIG_SPIRAM_MODE_OCT=y
CONFIG_SPIRAM_SPEED_80M=y

# LCD_CAM support 16 data lines at most
CONFIG_EXAMPLE_LCD_DATA_LINES_16=y
CONFIG_LV_COLOR_DEPTH_16=y

# Enabling the following configurations can help increase the PCLK frequency in the case when
# the Frame Buffer is allocated from the PSRAM and fetched by EDMA
CONFIG_SPIRAM_XIP_FROM_PSRAM=y

# Default GPIO assignment
CONFIG_EXAMPLE_LCD_VSYNC_GPIO=3
CONFIG_EXAMPLE_LCD_HSYNC_GPIO=46
CONFIG_EXAMPLE_LCD_DE_GPIO=0
CONFIG_EXAMPLE_LCD_PCLK_GPIO=9

# B3:B7 <=> DATA0:DATA4
CONFIG_EXAMPLE_LCD_DATA0_GPIO=14
CONFIG_EXAMPLE_LCD_DATA1_GPIO=13
CONFIG_EXAMPLE_LCD_DATA2_GPIO=12
CONFIG_EXAMPLE_LCD_DATA3_GPIO=11
CONFIG_EXAMPLE_LCD_DATA4_GPIO=10

# G2:G7 <=> DATA5:DATA10
CONFIG_EXAMPLE_LCD_DATA5_GPIO=39
CONFIG_EXAMPLE_LCD_DATA6_GPIO=38
CONFIG_EXAMPLE_LCD_DATA7_GPIO=45
CONFIG_EXAMPLE_LCD_DATA8_GPIO=48
CONFIG_EXAMPLE_LCD_DATA9_GPIO=47
CONFIG_EXAMPLE_LCD_DATA10_GPIO=21

# R3:R7 <=> DATA11:DATA15
CONFIG_EXAMPLE_LCD_DATA11_GPIO=1
CONFIG_EXAMPLE_LCD_DATA12_GPIO=2
CONFIG_EXAMPLE_LCD_DATA13_GPIO=42
CONFIG_EXAMPLE_LCD_DATA14_GPIO=41
CONFIG_EXAMPLE_LCD_DATA15_GPIO=40
```

## examples/peripherals/lcd/spi_lcd_touch/main/Kconfig.projbuild
```kconfig
menu "Example Configuration"

    config EXAMPLE_LCD_TOUCH_ENABLED
        bool "Enable LCD touch"
        default n
        help
            Enable this option if you wish to use display touch. You can select from touch controllers.

    choice EXAMPLE_LCD_TOUCH_CONTROLLER
        prompt "LCD touch controller model"
        depends on EXAMPLE_LCD_TOUCH_ENABLED
        default EXAMPLE_LCD_TOUCH_CONTROLLER_STMPE610
        help
            Select LCD touch controller model

        config EXAMPLE_LCD_TOUCH_CONTROLLER_STMPE610
            bool "STMPE610"
            help
                Touch controller STMPE610 connected via SPI.

        config EXAMPLE_LCD_TOUCH_CONTROLLER_XPT2046
            bool "XPT2046"
            help
                Touch controller XPT2046 connected via SPI.
    endchoice

    config EXAMPLE_LCD_MIRROR_Y
        int
        default 1 if EXAMPLE_LCD_TOUCH_ENABLED && EXAMPLE_LCD_TOUCH_CONTROLLER_XPT2046
        default 0
        help
            This value is 1 if XPT2046 touch controller is selected, 0 otherwise.

endmenu
```

## examples/peripherals/lcd/tjpgd/main/Kconfig.projbuild
```kconfig
menu "Example Configuration"
    config EXAMPLE_LCD_SPI_8_LINE_MODE
        bool
        prompt "Drive a LCD with 8 data lines"
        depends on IDF_TARGET_ESP32S2 || IDF_TARGET_ESP32S3
        default "n"
        help
            This option can be chosen when using 8-line lcd.

    config EXAMPLE_LCD_FLUSH_PARALLEL_LINES
        int "LCD flush parallel lines"
        default 12 if IDF_TARGET_ESP32C2
        default 16
        help
            To speed up transfers, every SPI transfer sends a bunch of lines.

endmenu
```

## examples/peripherals/ledc/ledc_gamma_curve_fade/main/Kconfig.projbuild
```kconfig
menu "Example Configuration"

    config GAMMA_CORRECTION_WITH_LUT
        bool "Use look up table to do gamma correction"
        default n
        help
            By default, the gamma correction in the example is through math power operation. This requires computation
            on embedded system. With this option enabled, gamma correction will be based on a look up table. Note that,
            the look up table provided in the example is only for a Gamma factor of 2.6.

endmenu
```

## examples/peripherals/mcpwm/mcpwm_bdc_speed_control/main/Kconfig.projbuild
```kconfig
menu "Example Configuration"

    config SERIAL_STUDIO_DEBUG
        bool "Enable log that can be parsed by Serial Studio"
        default "n"
        help
            Enable this option, the example will print a string at runtime with a specific format,
            which can be parsed by the Serial Studio tool.
            With the "serial-studio-dashboard.json" template file provided in this example,
            user can observe the speed in a curve window in the Serial Studio.

endmenu
```

## examples/peripherals/mcpwm/mcpwm_foc_svpwm_open_loop/main/Kconfig.projbuild
```kconfig
menu "ESP FOC Settings"

    config ESP_FOC_USE_SVPWM
        bool "Use SVPWM modulation, if not, use SPWM"
        default y
        help
            SVPWM will output saddle wave, which have higher power usage ratio,
            But not follow 'sin signal' on phase voltage, and neutral line not zero.

            SPWM output a standard 3-phase sin signal modulated pwm, but not fully use the
            input power. Please turn off this config if the `neutral line` is required.
endmenu
```

## examples/peripherals/mcpwm/mcpwm_sync/main/Kconfig.projbuild
```kconfig
menu "Example Configuration"

    choice EXAMPLE_SYNC_FROM
        prompt "Where the sync event is generated from"
        default EXAMPLE_SYNC_FROM_GPIO
        help
            Select MCPWM sync source.

        config EXAMPLE_SYNC_FROM_GPIO
            bool "GPIO"

        config EXAMPLE_SYNC_FROM_TEZ
            bool "Timer TEZ"

        config EXAMPLE_SYNC_FROM_SOFT
            bool "Software"
            depends on SOC_MCPWM_SWSYNC_CAN_PROPAGATE
    endchoice

endmenu
```
