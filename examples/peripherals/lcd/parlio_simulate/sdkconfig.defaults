## examples/peripherals/parlio/parlio_rx/logic_analyzer/main/Kconfig.projbuild
```kconfig
menu "ESP probe configurations"

    choice EXAMPLE_SIGNAL_SRC
        prompt "Select signal source"
        default EXAMPLE_INTERNAL_SIGNAL
        config EXAMPLE_INTERNAL_SIGNAL
            bool "Probing the internal signals"
        config EXAMPLE_EXTERNAL_SIGNAL
            bool "Probing the External signals"
    endchoice

    choice EXAMPLE_DATA_DUMP_MODE
        prompt "Select ESP probe dump mode"
        default EXAMPLE_DATA_BUFFER_MODE
        help
            Select how to dump the data. Different modes have different requirements.
        config EXAMPLE_DATA_BUFFER_MODE
            bool "Buffer mode (recommended)"
            help
                The buffer mode will store the data onto the heap storage first,
                and output all of them to the stream in once.
                The probe will stop if run out of the given storage on the heap.
                So that to guarantee a reliable data storing during the sampling period.
                However, the disadvantage is that, the probing time is limited by the available heap size,
                the higher the sample rate is, the shorter time the sampling last.
        config EXAMPLE_DATA_STREAM_MODE
            bool "Stream mode"
            help
                The stream mode relies heavily on the bandwidth of the output stream.
                Stream mode can only achieve a relatively low sample rate to guarantee no samples are dropped,
                but it can keep sampling continuously for a long time.
        config EXAMPLE_DATA_BUFFER_STREAM_MODE
            bool "Buffer + Stream mode"
            help
                The buffer stream mode will store the data onto heap storage first,
                and output them to the stream every half of the storage.
                Buffer stream mode means the probe will loop to use the given storage on heap.
                So that we can also sample the data continuously for a long time.
                However, while the data outputting rate can't catch the data producing rate,
                data will still be dropped.
                The difference comparing to the stream mode is that, it sends a larger block in every output,
                i.e., it can hold more reliable samples for a time
    endchoice

    choice EXAMPLE_DATA_IO_DEVICE
        prompt "Select ESP probe dump stream"
        default EXAMPLE_DUMP_VIA_FS if !SOC_WIFI_SUPPORTED && !SOC_EMAC_SUPPORTED
        default EXAMPLE_DUMP_VIA_TCP if SOC_WIFI_SUPPORTED || SOC_EMAC_SUPPORTED
        help
            Select the dump stream for the sampled data
        config EXAMPLE_DUMP_VIA_FS
            bool "Dump data to the flash via file stream"
        config EXAMPLE_DUMP_VIA_TCP
            depends on SOC_WIFI_SUPPORTED || SOC_EMAC_SUPPORTED
            bool "Dump data to the host via TCP stream"
    endchoice

    config EXAMPLE_HOST_IP_ADDR
        depends on EXAMPLE_DUMP_VIA_TCP
        default "192.168.1.100"
        string "TCP server IP address"
    config EXAMPLE_HOST_PORT
        depends on EXAMPLE_DUMP_VIA_TCP
        default 8888
        int "TCP server port"

    config EXAMPLE_PARTITION_LABEL
        depends on EXAMPLE_DUMP_VIA_FS
        default "storage"
        string "The label of the data storage partition"

endmenu
```

## examples/peripherals/parlio/parlio_rx/logic_analyzer/sdkconfig.defaults
```kconfig
CONFIG_ESP_TASK_WDT_EN=n
CONFIG_FREERTOS_HZ=1000
CONFIG_PARTITION_TABLE_CUSTOM=y
CONFIG_PARTITION_TABLE_CUSTOM_FILENAME="partitions.csv"
CONFIG_FATFS_LFN_STACK=y
CONFIG_VFS_SUPPORT_IO=y
```

## examples/peripherals/parlio/parlio_tx/advanced_rgb_led_matrix/main/Kconfig.projbuild
```kconfig
menu "Example Configuration"

    config EXAMPLE_PIN_NUM_R1
        int "Red Pin 1"
        default 7

    config EXAMPLE_PIN_NUM_G1
        int "Green Pin 1"
        default 4

    config EXAMPLE_PIN_NUM_B1
        int "Blue Pin 1"
        default 1

    config EXAMPLE_PIN_NUM_R2
        int "Red Pin 2"
        default 6

    config EXAMPLE_PIN_NUM_G2
        int "Green Pin 2"
        default 3

    config EXAMPLE_PIN_NUM_B2
        int "Blue Pin 2"
        default 0

    config EXAMPLE_PIN_NUM_LATCH
        int "Latch Pin"
        default 5

    config EXAMPLE_PIN_NUM_PCLK
        int "PCLK Pin"
        default 10

    config EXAMPLE_PIN_NUM_OE
        int "OE Pin"
        default 2

    config EXAMPLE_PIN_NUM_A
        int "A Pin"
        default 20

    config EXAMPLE_PIN_NUM_B
        int "B Pin"
        default 21

    config EXAMPLE_PIN_NUM_C
        int "C Pin"
        default 22

    config EXAMPLE_PIN_NUM_D
        int "D Pin"
        default 23

endmenu
```

## examples/peripherals/parlio/parlio_tx/simple_rgb_led_matrix/sdkconfig.defaults.esp32c6
```kconfig
CONFIG_EXAMPLE_PIN_NUM_R1=7
CONFIG_EXAMPLE_PIN_NUM_G1=4
CONFIG_EXAMPLE_PIN_NUM_B1=1
CONFIG_EXAMPLE_PIN_NUM_R2=6
CONFIG_EXAMPLE_PIN_NUM_G2=3
CONFIG_EXAMPLE_PIN_NUM_B2=0
CONFIG_EXAMPLE_PIN_NUM_LATCH=5
CONFIG_EXAMPLE_PIN_NUM_OE=2
CONFIG_EXAMPLE_PIN_NUM_PCLK=10
CONFIG_EXAMPLE_PIN_NUM_A=20
CONFIG_EXAMPLE_PIN_NUM_B=21
CONFIG_EXAMPLE_PIN_NUM_C=22
CONFIG_EXAMPLE_PIN_NUM_D=23
```

## examples/peripherals/parlio/parlio_tx/simple_rgb_led_matrix/sdkconfig.defaults.esp32h2
```kconfig
CONFIG_EXAMPLE_PIN_NUM_R1=12
CONFIG_EXAMPLE_PIN_NUM_G1=0
CONFIG_EXAMPLE_PIN_NUM_B1=22
CONFIG_EXAMPLE_PIN_NUM_R2=2
CONFIG_EXAMPLE_PIN_NUM_G2=1
CONFIG_EXAMPLE_PIN_NUM_B2=3
CONFIG_EXAMPLE_PIN_NUM_LATCH=11
CONFIG_EXAMPLE_PIN_NUM_OE=26
CONFIG_EXAMPLE_PIN_NUM_PCLK=27
CONFIG_EXAMPLE_PIN_NUM_A=8
CONFIG_EXAMPLE_PIN_NUM_B=5
CONFIG_EXAMPLE_PIN_NUM_C=9
CONFIG_EXAMPLE_PIN_NUM_D=10
```

## examples/peripherals/parlio/parlio_tx/simple_rgb_led_matrix/sdkconfig.defaults.esp32p4
```kconfig
CONFIG_EXAMPLE_PIN_NUM_R1=25
CONFIG_EXAMPLE_PIN_NUM_G1=3
CONFIG_EXAMPLE_PIN_NUM_B1=29
CONFIG_EXAMPLE_PIN_NUM_R2=27
CONFIG_EXAMPLE_PIN_NUM_G2=1
CONFIG_EXAMPLE_PIN_NUM_B2=31
CONFIG_EXAMPLE_PIN_NUM_LATCH=0
CONFIG_EXAMPLE_PIN_NUM_OE=30
CONFIG_EXAMPLE_PIN_NUM_PCLK=28
CONFIG_EXAMPLE_PIN_NUM_A=24
CONFIG_EXAMPLE_PIN_NUM_B=4
CONFIG_EXAMPLE_PIN_NUM_C=26
CONFIG_EXAMPLE_PIN_NUM_D=2
```

## examples/peripherals/parlio/parlio_tx/simple_rgb_led_matrix/sdkconfig.defaults.esp32s31
```kconfig
CONFIG_EXAMPLE_PIN_NUM_R1=14
CONFIG_EXAMPLE_PIN_NUM_G1=8
CONFIG_EXAMPLE_PIN_NUM_B1=12
CONFIG_EXAMPLE_PIN_NUM_R2=7
CONFIG_EXAMPLE_PIN_NUM_G2=11
CONFIG_EXAMPLE_PIN_NUM_B2=9
CONFIG_EXAMPLE_PIN_NUM_LATCH=1
CONFIG_EXAMPLE_PIN_NUM_OE=0
CONFIG_EXAMPLE_PIN_NUM_PCLK=3
CONFIG_EXAMPLE_PIN_NUM_A=10
CONFIG_EXAMPLE_PIN_NUM_B=5
CONFIG_EXAMPLE_PIN_NUM_C=4
CONFIG_EXAMPLE_PIN_NUM_D=2
```
