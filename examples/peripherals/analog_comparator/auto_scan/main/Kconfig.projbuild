## examples/peripherals/dedicated_gpio/soft_spi/main/Kconfig.projbuild
```kconfig
menu "Example Configuration"

    orsource "$IDF_PATH/examples/common_components/env_caps/$IDF_TARGET/Kconfig.env_caps"

    config EMULATE_SPI_GPIO_CLOCK
        int "GPIO pin for SPI Clock"
        range ENV_GPIO_RANGE_MIN ENV_GPIO_OUT_RANGE_MAX
        default 0 if IDF_TARGET_ARCH_RISCV
        default 16
        help
            GPIO pin number to be used as emulated SPI Clock.

    config EMULATE_SPI_GPIO_MOSI
        int "GPIO pin for SPI MOSI"
        range ENV_GPIO_RANGE_MIN ENV_GPIO_OUT_RANGE_MAX
        default 2 if IDF_TARGET_ARCH_RISCV
        default 17
        help
            GPIO pin number to be used as emulated SPI MOSI (Master Out Slave In).

    config EMULATE_SPI_GPIO_CS
        int "GPIO pin for SPI Chip Select"
        range ENV_GPIO_RANGE_MIN ENV_GPIO_OUT_RANGE_MAX
        default 3 if IDF_TARGET_ARCH_RISCV
        default 18
        help
            GPIO pin number to be used as emulated SPI Chip Select.

    config EMULATE_SPI_GPIO_MISO
        int "GPIO pin for SPI MISO"
        range ENV_GPIO_RANGE_MIN ENV_GPIO_OUT_RANGE_MAX
        default 4 if IDF_TARGET_ARCH_RISCV
        default 19
        help
            GPIO pin number to be used as emulated SPI MISO (Master In Slave Out).


endmenu
```

## examples/peripherals/dedicated_gpio/soft_spi/sdkconfig.defaults
```kconfig
# Check the README.md file for more info about why we need to disable these options
CONFIG_ESP_INT_WDT=n
CONFIG_ESP_TASK_WDT_EN=n
```
