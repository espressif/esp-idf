## examples/peripherals/analog_comparator/auto_scan/main/Kconfig.projbuild
```kconfig
menu "Example Configuration"

    choice EXAMPLE_MONITOR_IO_FROM
        prompt "Monitor IO signal comes from"
        default EXAMPLE_MONITOR_IO_FROM_ETM if SOC_ANA_CMPR_SUPPORT_ETM && SOC_GPIO_SUPPORT_ETM
        default EXAMPLE_MONITOR_IO_FROM_INTR

        config EXAMPLE_MONITOR_IO_FROM_INTR
            bool "Analog Comparator Interrupt"
            help
                Enable to set the monitor GPIO via interrupt callback

        config EXAMPLE_MONITOR_IO_FROM_ETM
            depends on SOC_ANA_CMPR_SUPPORT_ETM && SOC_GPIO_SUPPORT_ETM
            bool "Analog Comparator Event-Task-Matrix"
            help
                Enable to set the monitor GPIO via Event Task Matrix
    endchoice

    choice EXAMPLE_REF_FROM
        prompt "Analog Comparator reference voltage comes from"
        default EXAMPLE_REF_FROM_INTERNAL
        help
            Decide the reference voltage comes from internal or external

        config EXAMPLE_REF_FROM_INTERNAL
            bool "Internal"
            help
                The source signal will refer to an internal voltage, which is divided from VDD.

        config EXAMPLE_REF_FROM_EXTERNAL
            bool "External pin"
            help
                The source signal will refer to the external signal on a specific GPIO.
    endchoice

    config EXAMPLE_HYSTERESIS_COMPARATOR
        depends on EXAMPLE_REF_FROM_INTERNAL && EXAMPLE_MONITOR_IO_FROM_INTR
        bool "Enable hysteresis comparator"
        default n
        help
            The internal reference voltage will be set to 30% VDD and 70% VDD alternately
            every time the interrupt triggered.

endmenu
```

## examples/peripherals/analog_comparator/etm_periodic_scan/main/Kconfig.projbuild
```kconfig
menu "Example Configuration"

    config EXAMPLE_SRC_GPIO_NUM
        int "Source GPIO number"
        default 0
        help
            GPIO connected to analog comparator source channel 0.

    config EXAMPLE_MONITOR_GPIO_NUM
        int "Monitor GPIO number"
        default 4
        range 0 SOC_GPIO_OUT_RANGE_MAX
        help
            GPIO that outputs the square wave converted from the analog comparator result.

    config EXAMPLE_SCAN_PERIOD_US
        int "Comparator scan period (us)"
        default 50
        range 10 1000000
        help
            Period of the GPTimer ETM event that triggers the analog comparator scan task.

endmenu
```

## examples/peripherals/analog_comparator/main/Kconfig.projbuild
```kconfig
menu "Analog Comparator Example Configuration"

    choice EXAMPLE_REALIZATION
        prompt "Analog Comparator example realization methods"
        default EXAMPLE_USE_ETM if SOC_ANA_CMPR_SUPPORT_ETM && SOC_GPIO_SUPPORT_ETM
        default EXAMPLE_USE_INTR if !SOC_ANA_CMPR_SUPPORT_ETM || !SOC_GPIO_SUPPORT_ETM
        config EXAMPLE_USE_INTR
            bool "Use Interrupt"
            help
                Enable to set the monitor GPIO via interrupt callback
        config EXAMPLE_USE_ETM
            depends on SOC_ANA_CMPR_SUPPORT_ETM && SOC_GPIO_SUPPORT_ETM
            bool "Use ETM"
            help
                Enable to set the monitor GPIO via Event Task Matrix
    endchoice

    choice EXAMPLE_REFERENCE_SOURCE
        prompt "Analog Comparator reference source"
        default EXAMPLE_INTERNAL_REF
        help
            Decide the reference signal comes from internal or external

        config EXAMPLE_INTERNAL_REF
            bool "Internal reference"
            help
                The source signal will refer to an internal voltage, which related to VDD.

        config EXAMPLE_EXTERNAL_REF
            bool "External reference"
            help
                The source signal will refer to the external signal on a specific GPIO.
    endchoice

    config EXAMPLE_HYSTERESIS_COMPARATOR
        depends on EXAMPLE_INTERNAL_REF && !EXAMPLE_USE_ETM
        bool "Enable hysteresis comparator"
        default n
        help
            The internal reference voltage will be set to 30% VDD and 70% VDD alternately
            every time the interrupt triggered.

endmenu
```

## examples/peripherals/camera/common_components/dsi_init/Kconfig.projbuild
```kconfig
menu "Example DSI Configuration"

    choice EXAMPLE_LCD_PATTERN
        prompt "Select MIPI LCD model"
        default EXAMPLE_LCD_PATTERN_EK79007
        help
            Select LCD controller model.

        config EXAMPLE_LCD_PATTERN_EK79007
            bool "EK79007"
        config EXAMPLE_LCD_PATTERN_ILI9881C
            bool "ILI9881C"
    endchoice

    choice EXAMPLE_MIPI_DSI_DISP_HRES
        bool "Set MIPI DSI horizontal resolution"
        default EXAMPLE_MIPI_DSI_DISP_HRES_800 if EXAMPLE_LCD_PATTERN_ILI9881C
        default EXAMPLE_MIPI_DSI_DISP_HRES_1024 if EXAMPLE_LCD_PATTERN_EK79007
        default EXAMPLE_MIPI_DSI_DISP_HRES_800

        config EXAMPLE_MIPI_DSI_DISP_HRES_800
            bool "800"
        config EXAMPLE_MIPI_DSI_DISP_HRES_1024
            bool "1024"
    endchoice

    config EXAMPLE_MIPI_DSI_DISP_HRES
        int
        default 800 if EXAMPLE_MIPI_DSI_DISP_HRES_800
        default 1024 if EXAMPLE_MIPI_DSI_DISP_HRES_1024

    choice EXAMPLE_MIPI_DSI_DISP_VRES
        bool "Set MIPI DSI vertical resolution"
        default EXAMPLE_MIPI_DSI_DISP_VRES_1280 if EXAMPLE_LCD_PATTERN_ILI9881C
        default EXAMPLE_MIPI_DSI_DISP_VRES_600 if EXAMPLE_LCD_PATTERN_EK79007
        default EXAMPLE_MIPI_DSI_DISP_VRES_1280

        config EXAMPLE_MIPI_DSI_DISP_VRES_600
            bool "600"
        config EXAMPLE_MIPI_DSI_DISP_VRES_1280
            bool "1280"
    endchoice

    config EXAMPLE_MIPI_DSI_DISP_VRES
        int
        default 600 if EXAMPLE_MIPI_DSI_DISP_VRES_600
        default 1280 if EXAMPLE_MIPI_DSI_DISP_VRES_1280
endmenu
```

## examples/peripherals/camera/dvp_dsi/main/Kconfig.projbuild
```kconfig
menu "Example Configuration"
    config EXAMPLE_USED_LDO_CHAN_ID
        int "Occupied channel ID of the LDO to power on the MIPI DSI PHY"
        default 3
        help
            Example used LDO channel ID, you may check datasheet to know more details.

    config EXAMPLE_USED_LDO_VOLTAGE_MV
        int "Occupied LDO voltage in mV"
        default 2500
        range 0 3300
        help
            Example used LDO voltage, in mV

    choice EXAMPLE_CAM_HRES
        bool "Set camera horizontal resolution"
        default EXAMPLE_CAM_HRES_640

        config EXAMPLE_CAM_HRES_640
            bool "640"
        config EXAMPLE_CAM_HRES_240
            bool "240"
    endchoice

    config EXAMPLE_CAM_HRES
        int
        default 640 if EXAMPLE_CAM_HRES_640
        default 240 if EXAMPLE_CAM_HRES_240

    choice EXAMPLE_CAM_VRES
        bool "Set camera vertical resolution"
        default EXAMPLE_CAM_VRES_480 if EXAMPLE_CAM_HRES_640
        default EXAMPLE_CAM_VRES_240 if EXAMPLE_CAM_HRES_240

        config EXAMPLE_CAM_VRES_480
            bool "480"
        config EXAMPLE_CAM_VRES_240
            bool "240"
    endchoice

    config EXAMPLE_CAM_VRES
        int
        default 480 if EXAMPLE_CAM_VRES_480
        default 240 if EXAMPLE_CAM_VRES_240
endmenu
```

## examples/peripherals/camera/dvp_dsi/sdkconfig.defaults
```kconfig
CONFIG_CAMERA_OV2640=y
CONFIG_CAMERA_OV2640_DVP_RGB565_640X480_6FPS=y
CONFIG_CAMERA_OV2640_DVP_RGB565_240X240_25FPS=y
CONFIG_CAM_CTRL_SPI_ENABLE=n
```

## examples/peripherals/camera/dvp_dsi/sdkconfig.defaults.esp32p4
```kconfig
CONFIG_IDF_EXPERIMENTAL_FEATURES=y
CONFIG_SPIRAM=y
CONFIG_SPIRAM_SPEED_200M=y
CONFIG_EXAMPLE_MIPI_DSI_DISP_USE_DMA2D=y
```

## examples/peripherals/camera/dvp_isp_dsi/main/Kconfig.projbuild
```kconfig
menu "Example Configuration"
    config EXAMPLE_USED_LDO_CHAN_ID
        int "Occupied channel ID of the LDO to power on the MIPI DSI PHY"
        default 3
        help
            Example used LDO channel ID, you may check datasheet to know more details.

    config EXAMPLE_USED_LDO_VOLTAGE_MV
        int "Occupied LDO voltage in mV"
        default 2500
        range 0 3300
        help
            Example used LDO voltage, in mV

    config EXAMPLE_CAM_PORT_ISP_DVP
        bool
        default y

    choice EXAMPLE_CAM_HRES
        bool "Set camera horizontal resolution"
        default EXAMPLE_CAM_HRES_640

        config EXAMPLE_CAM_HRES_1024
            depends on EXAMPLE_MIPI_DSI_DISP_HRES >= 1024
            bool "1024"
        config EXAMPLE_CAM_HRES_800
            depends on EXAMPLE_MIPI_DSI_DISP_HRES >= 800
            bool "800"
        config EXAMPLE_CAM_HRES_640
            depends on EXAMPLE_MIPI_DSI_DISP_HRES >= 640
            bool "640"
    endchoice

    config EXAMPLE_CAM_HRES
        int
        default 1024 if EXAMPLE_CAM_HRES_1024
        default 800 if EXAMPLE_CAM_HRES_800
        default 640 if EXAMPLE_CAM_HRES_640

    choice EXAMPLE_CAM_VRES
        bool "Set camera vertical resolution"
        default EXAMPLE_CAM_VRES_600 if EXAMPLE_CAM_HRES_1024
        default EXAMPLE_CAM_VRES_640 if EXAMPLE_CAM_HRES_800
        default EXAMPLE_CAM_VRES_480 if EXAMPLE_CAM_HRES_640

        config EXAMPLE_CAM_VRES_480
            depends on EXAMPLE_MIPI_DSI_DISP_VRES >= 480
            bool "480"
        config EXAMPLE_CAM_VRES_600
            depends on EXAMPLE_MIPI_DSI_DISP_VRES >= 600
            bool "600"
        config EXAMPLE_CAM_VRES_640
            depends on EXAMPLE_MIPI_DSI_DISP_VRES >= 640
            bool "640"
        config EXAMPLE_CAM_VRES_800
            depends on EXAMPLE_MIPI_DSI_DISP_VRES >= 800
            bool "800"
    endchoice

    config EXAMPLE_CAM_VRES
        int
        default 480 if EXAMPLE_CAM_VRES_480
        default 600 if EXAMPLE_CAM_VRES_600
        default 640 if EXAMPLE_CAM_VRES_640
        default 800 if EXAMPLE_CAM_VRES_800
endmenu
```

## examples/peripherals/camera/dvp_isp_dsi/sdkconfig.defaults
```kconfig
CONFIG_CAMERA_OV2640=y
CONFIG_CAMERA_SC030IOT=y
CONFIG_CAMERA_SC030IOT_DVP_RAW8_640X480_26FPS=y
CONFIG_CAMERA_OV2640_DVP_RAW8_800X640_15FPS=y
CONFIG_CAMERA_OV2640_DVP_RAW8_800X800_15FPS=y
CONFIG_CAMERA_OV2640_DVP_RAW8_1024X600_15FPS=y
CONFIG_EXAMPLE_MIPI_DSI_DISP_USE_DMA2D=y
CONFIG_CAM_CTRL_SPI_ENABLE=n
```

## examples/peripherals/camera/dvp_spi_lcd/main/Kconfig.projbuild
```kconfig
menu "Example Configuration"

    choice EXAMPLE_CAM_HRES
        bool "Set camera horizontal resolution"
        default EXAMPLE_CAM_HRES_240

        config EXAMPLE_CAM_HRES_640
            bool "640"
        config EXAMPLE_CAM_HRES_240
            bool "240"
    endchoice

    config EXAMPLE_CAM_HRES
        int
        default 640 if EXAMPLE_CAM_HRES_640
        default 240 if EXAMPLE_CAM_HRES_240

    choice EXAMPLE_CAM_VRES
        bool "Set camera vertical resolution"
        default EXAMPLE_CAM_VRES_480 if EXAMPLE_CAM_HRES_640
        default EXAMPLE_CAM_VRES_240 if EXAMPLE_CAM_HRES_240

        config EXAMPLE_CAM_VRES_480
            bool "480"
        config EXAMPLE_CAM_VRES_240
            bool "240"
    endchoice

    config EXAMPLE_CAM_VRES
        int
        default 480 if EXAMPLE_CAM_VRES_480
        default 240 if EXAMPLE_CAM_VRES_240

    choice EXAMPLE_CAM_INPUT_FORMAT
        bool "Set camera input format"
        default EXAMPLE_CAM_INPUT_FORMAT_YUV422

        config EXAMPLE_CAM_INPUT_FORMAT_RGB565
            bool "RGB565"
        config EXAMPLE_CAM_INPUT_FORMAT_YUV422
            bool "YUV422"
    endchoice

endmenu
```

## examples/peripherals/camera/mipi_isp_dsi/main/Kconfig.projbuild
```kconfig
menu "Example Configuration"
    config EXAMPLE_USED_LDO_CHAN_ID
        int "example used LDO channel ID"
        default 3
        help
            Example used LDO channel ID, you may check datasheet to know more details.

    config EXAMPLE_USED_LDO_VOLTAGE_MV
        int "example used LDO voltage in mV"
        default 2500
        range 0 3300
        help
            Example used LDO voltage, in mV

    config EXAMPLE_CAM_PORT_ISP_MIPI
        bool
        default y

    choice EXAMPLE_MIPI_CSI_DISP_HRES
        bool "Set MIPI CSI horizontal resolution"
        default EXAMPLE_MIPI_CSI_HRES_1024

        config EXAMPLE_MIPI_CSI_HRES_800
            bool "800"
        config EXAMPLE_MIPI_CSI_HRES_1024
            bool "1024"
    endchoice

    config EXAMPLE_MIPI_CSI_DISP_HRES
        int
        default 800 if EXAMPLE_MIPI_CSI_HRES_800
        default 1024 if EXAMPLE_MIPI_CSI_HRES_1024

    choice EXAMPLE_MIPI_CSI_DISP_VRES
        bool "Set MIPI CSI vertical resolution"
        default EXAMPLE_MIPI_CSI_VRES_600

        config EXAMPLE_MIPI_CSI_VRES_600
            bool "600"
        config EXAMPLE_MIPI_CSI_VRES_640
            bool "640"
        config EXAMPLE_MIPI_CSI_VRES_800
            bool "800"
        config EXAMPLE_MIPI_CSI_VRES_1280
            bool "1280"
    endchoice

    config EXAMPLE_MIPI_CSI_DISP_VRES
        int
        default 600 if EXAMPLE_MIPI_CSI_VRES_600
        default 640 if EXAMPLE_MIPI_CSI_VRES_640
        default 800 if EXAMPLE_MIPI_CSI_VRES_800
        default 1280 if EXAMPLE_MIPI_CSI_VRES_1280
endmenu
```

## examples/peripherals/camera/mipi_isp_dsi/sdkconfig.defaults
```kconfig
CONFIG_CAMERA_SC2336=y
CONFIG_CAMERA_OV5647=y
CONFIG_CAMERA_OV5647_MIPI_RAW8_800X640_50FPS=y
CONFIG_CAMERA_OV5647_MIPI_RAW8_800X800_50FPS=y
CONFIG_CAMERA_OV5647_MIPI_RAW8_800X1280_50FPS=y
CONFIG_CAMERA_SC2336_MIPI_RAW8_1024X600_30FPS=y
CONFIG_CAM_CTRL_SPI_ENABLE=n
```

## examples/peripherals/dac/dac_continuous/signal_generator/main/Kconfig.projbuild
```kconfig
menu "Example Configuration"

    choice EXAMPLE_DAC_CONTINUOUS_MODE
        prompt "Select DAC continuous example mode"
        default EXAMPLE_DAC_CONTINUOUS_BY_DMA
        help
            DAC output continuous data by DMA or timer

        config EXAMPLE_DAC_CONTINUOUS_BY_DMA
            bool "By DMA"
        config EXAMPLE_DAC_CONTINUOUS_BY_TIMER
            bool "By Timer"
    endchoice

    config EXAMPLE_WAVE_PERIOD_SEC
        int "Period of switching the waveform (Unit: Sec)"
        default 2
        help
            The waveforms will switch every several seconds,
            this configuration is to specify the switching period

endmenu
```

## examples/peripherals/dedicated_gpio/soft_i2c/main/Kconfig.projbuild
```kconfig
menu "Example Configuration"

    orsource "$IDF_PATH/examples/common_components/env_caps/$IDF_TARGET/Kconfig.env_caps"

    config EXAMPLE_TARGET_SCL
        int "GPIO pin for SCL"
        range ENV_GPIO_RANGE_MIN ENV_GPIO_OUT_RANGE_MAX
        default 0 if IDF_TARGET_ARCH_RISCV
        default 16
        help
            GPIO pin number to be used as I2C SCL.

    config EXAMPLE_TARGET_SDA
        int "GPIO pin for SDA"
        range ENV_GPIO_RANGE_MIN ENV_GPIO_OUT_RANGE_MAX
        default 2 if IDF_TARGET_ARCH_RISCV
        default 17
        help
            GPIO pin number to be used as I2C SDA.

endmenu
```
