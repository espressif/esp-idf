## examples/protocols/http_server/ws_echo_server/main/Kconfig.projbuild
```kconfig
menu "Example Configuration"

    config EXAMPLE_ENABLE_WS_PRE_HANDSHAKE_CB
        bool "Enable WebSocket pre-handshake callback"
        select HTTPD_WS_PRE_HANDSHAKE_CB_SUPPORT
        default y
        help
            Enable this option to use WebSocket pre-handshake callback.
            This will allow the server to register a callback function that will be
            called before the WebSocket handshake is processed.

    config EXAMPLE_ENABLE_WS_POST_HANDSHAKE_CB
        bool "Enable WebSocket post-handshake callback"
        select HTTPD_WS_POST_HANDSHAKE_CB_SUPPORT
        default y
        help
            Enable this option to use WebSocket post-handshake callback.
            This will allow the server to register a callback function that will be
            called after the WebSocket handshake is processed.
            In this example, the post-handshake callback is used to send a welcome message
            to the client after the handshake is complete.

    config EXAMPLE_ENABLE_WS_CONTROL_FRAME_HANDLER
        bool "Enable dedicated WebSocket control-frame handler"
        default y
        help
            Enable this option to register a dedicated handler for WebSocket
            control frames (PING, PONG, CLOSE) on the /ws endpoint. The handler
            only observes the frames (e.g. for heartbeat tracking or logging);
            the server still sends the protocol replies (PONG for PING, CLOSE
            for CLOSE) itself.

endmenu
```

## examples/protocols/sockets/tcp_client_multi_net/sdkconfig.defaults
```kconfig
CONFIG_EXAMPLE_CONNECT_WIFI=y
CONFIG_EXAMPLE_CONNECT_ETHERNET=y
CONFIG_PARTITION_TABLE_SINGLE_APP_LARGE=y
```

## examples/storage/generic_partition_bdl/main/Kconfig.projbuild
```kconfig
menu "Example Configuration"

    choice EXAMPLE_STORAGE_MEDIA
        prompt "Whole-disk block device"
        default EXAMPLE_STORAGE_MEDIA_SPIFLASH
        help
            Select the underlying "whole-disk" block device that gets partitioned
            with an MBR and split into a FAT and a LittleFS partition using the
            generic-partition Block Device Layer (BDL).

        config EXAMPLE_STORAGE_MEDIA_SPIFLASH
            bool "SPI flash 'storage' data partition"
            help
                Use a SPI flash data partition (labelled "storage") as the whole disk.
                No extra hardware is required, so this option also works in QEMU/CI.

        config EXAMPLE_STORAGE_MEDIA_SDCARD
            bool "SD/eMMC card"
            help
                Use an SD/eMMC card as the whole disk. The card can be accessed
                through the SDMMC host or over the generic SPI bus (SDSPI); pick
                the peripheral below.
                WARNING: running the example overwrites the card's partition table.
    endchoice

    choice EXAMPLE_SD_HOST
        prompt "SD card host peripheral"
        depends on EXAMPLE_STORAGE_MEDIA_SDCARD
        default EXAMPLE_SD_HOST_SDMMC if SOC_SDMMC_HOST_SUPPORTED
        default EXAMPLE_SD_HOST_SDSPI
        help
            Select the peripheral used to talk to the SD/eMMC card.

        config EXAMPLE_SD_HOST_SDMMC
            bool "SDMMC host"
            depends on SOC_SDMMC_HOST_SUPPORTED
            help
                Access the card through the dedicated SDMMC host controller.

        config EXAMPLE_SD_HOST_SDSPI
            bool "SD SPI (SD card over the SPI bus)"
            help
                Access the card over the generic SPI bus using the SDSPI protocol.
                Works on any target with a free SPI host, but is slower and always
                uses a 1-line data bus.
    endchoice

    choice EXAMPLE_SDMMC_BUS_WIDTH
        prompt "SDMMC bus width"
        depends on EXAMPLE_SD_HOST_SDMMC
        default EXAMPLE_SDMMC_BUS_WIDTH_4

        config EXAMPLE_SDMMC_BUS_WIDTH_4
            bool "4 lines (D0 - D3)"

        config EXAMPLE_SDMMC_BUS_WIDTH_1
            bool "1 line (D0)"
    endchoice

    config EXAMPLE_SDMMC_INTERNAL_PULLUP
        bool "Enable internal pull-ups on the SDMMC lines"
        depends on EXAMPLE_SD_HOST_SDMMC
        default n
        help
            Enable the internal pull-ups on the SDMMC CMD/DATA lines. The SD
            specification requires external 10 kOhm pull-ups; the internal ones are
            weak and only adequate for boards that do not provide external pull-ups
            (for example the ESP32-S3-USB-OTG devkit). Prefer external pull-ups when
            the board has them.

    # On SoCs whose SDMMC controller routes through the GPIO matrix (e.g. ESP32-S3,
    # ESP32-P4) the slot pins are freely assignable, so expose them here. On SoCs
    # with a fixed SDMMC IO_MUX (e.g. ESP32) the slot default pins are used instead.
    config EXAMPLE_SDMMC_PIN_CLK
        int "SDMMC CLK GPIO number"
        depends on EXAMPLE_SD_HOST_SDMMC && SOC_SDMMC_USE_GPIO_MATRIX
        default 36 if IDF_TARGET_ESP32S3
        default 43 if IDF_TARGET_ESP32P4
        default -1
        help
            GPIO for the SDMMC CLK line. The ESP32-S3-USB-OTG devkit uses GPIO 36.

    config EXAMPLE_SDMMC_PIN_CMD
        int "SDMMC CMD GPIO number"
        depends on EXAMPLE_SD_HOST_SDMMC && SOC_SDMMC_USE_GPIO_MATRIX
        default 35 if IDF_TARGET_ESP32S3
        default 44 if IDF_TARGET_ESP32P4
        default -1
        help
            GPIO for the SDMMC CMD line. The ESP32-S3-USB-OTG devkit uses GPIO 35.

    config EXAMPLE_SDMMC_PIN_D0
        int "SDMMC D0 GPIO number"
        depends on EXAMPLE_SD_HOST_SDMMC && SOC_SDMMC_USE_GPIO_MATRIX
        default 37 if IDF_TARGET_ESP32S3
        default 39 if IDF_TARGET_ESP32P4
        default -1
        help
            GPIO for the SDMMC D0 line. The ESP32-S3-USB-OTG devkit uses GPIO 37.

    config EXAMPLE_SDMMC_PIN_D1
        int "SDMMC D1 GPIO number"
        depends on EXAMPLE_SD_HOST_SDMMC && SOC_SDMMC_USE_GPIO_MATRIX && EXAMPLE_SDMMC_BUS_WIDTH_4
        default 38 if IDF_TARGET_ESP32S3
        default 40 if IDF_TARGET_ESP32P4
        default -1
        help
            GPIO for the SDMMC D1 line (4-line mode only). The ESP32-S3-USB-OTG
            devkit uses GPIO 38.

    config EXAMPLE_SDMMC_PIN_D2
        int "SDMMC D2 GPIO number"
        depends on EXAMPLE_SD_HOST_SDMMC && SOC_SDMMC_USE_GPIO_MATRIX && EXAMPLE_SDMMC_BUS_WIDTH_4
        default 33 if IDF_TARGET_ESP32S3
        default 41 if IDF_TARGET_ESP32P4
        default -1
        help
            GPIO for the SDMMC D2 line (4-line mode only). The ESP32-S3-USB-OTG
            devkit uses GPIO 33.

    config EXAMPLE_SDMMC_PIN_D3
        int "SDMMC D3 GPIO number"
        depends on EXAMPLE_SD_HOST_SDMMC && SOC_SDMMC_USE_GPIO_MATRIX && EXAMPLE_SDMMC_BUS_WIDTH_4
        default 34 if IDF_TARGET_ESP32S3
        default 42 if IDF_TARGET_ESP32P4
        default -1
        help
            GPIO for the SDMMC D3 line (4-line mode only). The ESP32-S3-USB-OTG
            devkit uses GPIO 34.

    config EXAMPLE_SDSPI_PIN_MOSI
        int "SDSPI MOSI GPIO number"
        depends on EXAMPLE_SD_HOST_SDSPI
        default 15 if IDF_TARGET_ESP32
        default 35 if IDF_TARGET_ESP32S2
        default 4 if IDF_TARGET_ESP32S3
        default 5 if IDF_TARGET_ESP32H2
        default 36 if IDF_TARGET_ESP32P4
        default 4

    config EXAMPLE_SDSPI_PIN_MISO
        int "SDSPI MISO GPIO number"
        depends on EXAMPLE_SD_HOST_SDSPI
        default 2 if IDF_TARGET_ESP32
        default 37 if IDF_TARGET_ESP32S2
        default 5 if IDF_TARGET_ESP32S3
        default 0 if IDF_TARGET_ESP32H2
        default 47 if IDF_TARGET_ESP32P4
        default 6

    config EXAMPLE_SDSPI_PIN_CLK
        int "SDSPI CLK GPIO number"
        depends on EXAMPLE_SD_HOST_SDSPI
        default 14 if IDF_TARGET_ESP32
        default 36 if IDF_TARGET_ESP32S2
        default 2 if IDF_TARGET_ESP32S3
        default 4 if IDF_TARGET_ESP32H2
        default 53 if IDF_TARGET_ESP32P4
        default 5

    config EXAMPLE_SDSPI_PIN_CS
        int "SDSPI CS GPIO number"
        depends on EXAMPLE_SD_HOST_SDSPI
        default 13 if IDF_TARGET_ESP32
        default 34 if IDF_TARGET_ESP32S2
        default 8 if IDF_TARGET_ESP32S3
        default 33 if IDF_TARGET_ESP32P4
        default 1

    config EXAMPLE_SD_PWR_CTRL_LDO_INTERNAL_IO
        depends on EXAMPLE_STORAGE_MEDIA_SDCARD
        depends on SOC_SDMMC_IO_POWER_EXTERNAL || SOC_SDMMC_IO_UHS_POWER_EXTERNAL
        bool "SD power supply comes from internal LDO IO (READ HELP!)"
        default y
        help
            Only needed when the SD card is connected to specific IO pins which can be used for high-speed SDMMC.
            Please read the schematic first and check if the SD VDD is connected to any internal LDO output.
            Unselect this option if the SD card is powered by an external power supply.

    config EXAMPLE_SD_PWR_CTRL_LDO_IO_ID
        depends on EXAMPLE_SD_PWR_CTRL_LDO_INTERNAL_IO
        int "LDO ID"
        default 4 if IDF_TARGET_ESP32P4
        default 1 if IDF_TARGET_ESP32S31
        help
            Please read the schematic first and input your LDO ID.

endmenu
```

## examples/storage/nvs/nvs_statistics/main/Kconfig.projbuild
```kconfig
menu "Example Configuration"

    config EXAMPLE_RUN_OVERHEAD_MEASUREMENT
        bool "Run NVS blob storage-overhead measurement"
        default n
        help
            When enabled, the example sweeps several partition size / blob size
            combinations. For each combination it pre-populates every NVS page
            with strings up to a set of population levels, writes a single blob
            and reports its ideal vs. real entry consumption (and the resulting
            overhead) in a table.

endmenu
```

## examples/storage/spi_nand_flash/littlefs/main/Kconfig.projbuild
```kconfig
menu "Example Configuration"

    config EXAMPLE_FORMAT_IF_MOUNT_FAILED
        bool "Format the flash if mount failed"
        default n
        help
             If this config item is set, format_if_mount_failed will be set to true
             and the filesystem will be formatted if the mount has failed.

endmenu
```

## examples/wifi/roaming/fast_connect/main/Kconfig.projbuild
```kconfig
menu "Example Configuration"

    config EXAMPLE_WIFI_SSID
        string "Wi-Fi SSID"
        default "myssid"
        help
            SSID (network name) for the example to connect to.

    config EXAMPLE_WIFI_PASSWORD
        string "Wi-Fi Password"
        default "mypassword"
        help
            Wi-Fi password (WPA or WPA2) for the example to use.

    config EXAMPLE_RESTART_INTERVAL
        int "Restart this long after each boot's IP address (s)"
        range 0 3600
        default 0
        help
            Restart this many seconds after the boot's first IP address, so that boot to IP can be
            measured over many boots, with the AP remembered. 0 never restarts.
endmenu
```

## examples/wifi/softap_sta/main/Kconfig.projbuild
```kconfig
menu "Example Configuration"

    menu "SoftAP Configuration"
        comment "SoftAP Configuration"

        config ESP_WIFI_AP_SSID
            string "WiFi AP SSID"
            default "myssid"
            help
                SSID (network name) of the AP for the example to connect to.

        config ESP_WIFI_AP_PASSWORD
            string "WiFi AP Password"
            default "mypassword"
            help
                WiFi password of the AP for the example to use.

        config ESP_WIFI_AP_CHANNEL
            int "WiFi AP Channel"
            range 1 14
            default 1
            help
                WiFi channel (network channel) of the AP for the example to use.

        config ESP_MAX_STA_CONN_AP
            int "Maximal STA connections"
            default 4
            range 1 4 if IDF_TARGET_ESP32C2
            range 1 15
            help
                Maximum number of STAs allowed to connect to the soft-AP (wifi_config_t.ap.max_connection).
                Upper bound matches ESP_WIFI_MAX_CONN_NUM in esp_wifi_types_native.h:
                1-4 on ESP32-C2, 1-15 on other Wi-Fi chips.
                Soft-AP and ESP-NOW share encryption keys; see Wi-Fi driver documentation
                if ESP-NOW is enabled.
    endmenu

    menu "STA Configuration"
        comment "STA Configuration"

        config ESP_WIFI_REMOTE_AP_SSID
            string "WiFi Remote AP SSID"
            default "otherapssid"
            help
                SSID (network name) for the example's sta to connect to.

        config ESP_WIFI_REMOTE_AP_PASSWORD
            string "WiFi Remote AP Password"
            default "otherappassword"
            help
                WiFi password for the example to use.

        config ESP_MAXIMUM_STA_RETRY
            int "Maximum retry"
            default 5
            help
                Set the maximum retry value to prevent the station from continuously
                attempting to reconnect to the Access Point (AP) when the AP doesn't exist.

        choice ESP_WIFI_SCAN_AUTH_MODE_THRESHOLD
            prompt "WiFi Scan auth mode threshold"
            default ESP_WIFI_AUTH_WPA2_PSK
            help
                The weakest authmode to accept in the scan mode.
                This value defaults to ESP_WIFI_AUTH_WPA2_PSK in case password is present
                and ESP_WIFI_AUTH_OPEN is used. Please select ESP_WIFI_AUTH_WEP / ESP_WIFI_AUTH_WPA_PSK
                in case AP is operating in WEP / WPA mode.

            config ESP_WIFI_AUTH_OPEN
                bool "OPEN"
            config ESP_WIFI_AUTH_WEP
                bool "WEP"
            config ESP_WIFI_AUTH_WPA_PSK
                bool "WPA PSK"
            config ESP_WIFI_AUTH_WPA2_PSK
                bool "WPA2 PSK"
            config ESP_WIFI_AUTH_WPA_WPA2_PSK
                bool "WPA/WPA2 PSK"
            config ESP_WIFI_AUTH_WPA3_PSK
                bool "WPA3 PSK"
            config ESP_WIFI_AUTH_WPA2_WPA3_PSK
                bool "WPA2/WPA3 PSK"
            config ESP_WIFI_AUTH_WAPI_PSK
                bool "WAPI PSK"
        endchoice

    endmenu

    menu "DFS Channel Configuration"
        depends on SOC_WIFI_SUPPORT_5G
        comment "DFS Channel Configuration (5 GHz capable chips only)"

        config ESP_WIFI_COUNTRY_CODE
            string "Country code"
            default "01"
            help
                Country code used to configure the regulatory domain (e.g. "US" for FCC, "DE" for CE,
                "01" for world safe mode). The set of DFS channels depends on this regulatory domain.

        config ESP_WIFI_DISABLE_DFS_CHANNELS
            bool "Disable DFS channels"
            default n
            help
                If enabled, the device (both STA and SoftAP) will not use any DFS channel of the
                configured regulatory domain. As a result, STA cannot connect to an AP that operates
                on a DFS channel. The non-DFS channels are derived by looking up the country in the
                esp_wifi regulatory table, and the 5 GHz channel bitmask
                (wifi_country_t.wifi_5g_channel_mask) is restricted to them with the country policy
                switched to manual. This can be useful for certification setups (e.g. FCC, CE)
                where DFS channels must be avoided.
    endmenu
endmenu
```

## examples/zigbee/esp_zigbee_gateway/main/Kconfig.projbuild
```kconfig
choice ZB_GW_RCP_CHIP
    depends on AUTO_UPDATE_RCP
    prompt "Zigbee gateway RCP chip for auto update"
    default ZB_GW_RCP_CHIP_ESP32H2
    help
        Select the RCP chip connected to the Zigbee gateway.

    config ZB_GW_RCP_CHIP_ESP32H2
        bool "ESP32-H2"
        help
            ESP32-H2 is the RCP chip connected to the Zigbee gateway.

    config ZB_GW_RCP_CHIP_ESP32C6
        bool "ESP32-C6"
        help
            ESP32-C6 is the RCP chip connected to the Zigbee gateway.
endchoice
```
