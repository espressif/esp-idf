## examples/zigbee/esp_zigbee_gateway/sdkconfig.defaults
```kconfig
#
# Partition Table
#
CONFIG_PARTITION_TABLE_CUSTOM=y
CONFIG_PARTITION_TABLE_CUSTOM_FILENAME="partitions.csv"
CONFIG_PARTITION_TABLE_FILENAME="partitions.csv"
CONFIG_PARTITION_TABLE_OFFSET=0x8000
CONFIG_PARTITION_TABLE_MD5=y
# end of Partition Table

#
# Serial flasher config
#
CONFIG_ESPTOOLPY_FLASHSIZE_4MB=y
# end of Serial flasher config

#
# Event
#
CONFIG_ESP_SYSTEM_EVENT_TASK_STACK_SIZE=4096
#end of Event


#
# Zigbee
#
CONFIG_ZB_ENABLED=y
CONFIG_ZB_ZCZR=y
# end of Zigbee

#
# ESP Zigbee gateway RCP update
#
CONFIG_AUTO_UPDATE_RCP=n
# end of ESP Zigbee gateway RCP update
```

## examples/zigbee/zb_common_components/example_common/Kconfig
```kconfig
menu "Zigbee Example Configuration"

    config ZB_EXAMPLE_PRIMARY_CHANNEL
        int "Zigbee primary channel"
        range 11 26
        default 13

    config ZB_EXAMPLE_SECONDARY_CHANNEL_MASK
        hex "Zigbee secondary channel mask"
        default 0x07FFF800

endmenu
```

## proj_s31/main/common/Kconfig
```kconfig
menu "common"

    config COMMON_ENABLE
        bool "Enable common"
        default y

if COMMON_ENABLE

    config FTP_SERVER_SUPPORT
        bool "Enable FTP server support"
        default n
        help
            Enable FTP server support
    
    menu "OTA"
    config OTA_SUPPORT
        bool "Enable OTA support"
        default y
        help
            Enable OTA support
        
        if OTA_SUPPORT
            menu "HTTPS OTA"
            config HTTPS_OTA_SUPPORT
                bool "Enable HTTPS OTA support"
                default y
                help
                    Enable HTTPS OTA support

                if HTTPS_OTA_SUPPORT
                    config HTTPS_OTA_SERVER_IP
                        string "HTTPS OTA server IP"
                        default "192.168.1.100"
                        help
                            HTTPS OTA server IP
                endif
            endmenu

            menu "XMODEM OTA"
            config XMODEM_OTA_SUPPORT
                bool "Enable XMODEM OTA support"
                default y
                help
                    Enable XMODEM OTA support
                
                if XMODEM_OTA_SUPPORT
                    config XMODEM_OTA_UART_PORT
                        int "XMODEM OTA UART port"
                        default 1
                        help
                            XMODEM OTA UART port

                    config XMODEM_OTA_UART_BAUD_RATE
                        int "XMODEM OTA UART baud rate"
                        default 115200
                        help
                            XMODEM OTA UART baud rate

                    config XMODEM_OTA_UART_RX_PIN
                        int "XMODEM OTA UART RX pin"
                        default 48
                        help
                            XMODEM OTA UART RX pin

                    config XMODEM_OTA_UART_TX_PIN
                        int "XMODEM OTA UART TX pin"
                        default 47
                        help
                            XMODEM OTA UART TX pin
                endif
            endmenu
        endif
    endmenu
endif


endmenu
```
