## examples/phy/cert_test/main/Kconfig.projbuild
```kconfig
menu "Example Configuration"

    choice COMMANDS_FORMAT
        prompt "PHY Commands Format"
        default ESP_PHY_NEW_COMMANDS
        config ESP_PHY_LEGACY_COMMANDS
            bool "Legacy Commands Format"

        config ESP_PHY_NEW_COMMANDS
            bool "New Commands Format"

    endchoice

    config COMMANDS_ENABLE_BLE_DTM_TEST
        bool "Enable BLE DTM Test Mode"
        depends on IDF_TARGET_ESP32C6 || IDF_TARGET_ESP32H2
        default n
        help
            Enable this option to support BLE Direct Test Mode (DTM) for RF testing and validation.

endmenu
```

## examples/phy/cert_test/sdkconfig.defaults.esp32h2
```kconfig
#
# ESP32C6-specific
#
CONFIG_COMMANDS_ENABLE_BLE_DTM_TEST=y
CONFIG_BT_CONTROLLER_ONLY=y
CONFIG_BT_LE_HCI_INTERFACE_USE_UART=y
CONFIG_BT_LE_HCI_UART_TX_PIN=8
CONFIG_BT_LE_HCI_UART_RX_PIN=9
CONFIG_BT_LE_HCI_UART_BAUD=115200
```
