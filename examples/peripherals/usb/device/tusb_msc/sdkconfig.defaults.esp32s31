## examples/peripherals/usb/device/tusb_msc/sdkconfig.defaults.esp32s31
```kconfig
CONFIG_EXAMPLE_SD_PWR_CTRL_LDO_INTERNAL_IO=y
CONFIG_EXAMPLE_SD_PWR_CTRL_LDO_IO_ID=1
```

## examples/peripherals/usb/device/tusb_ncm/main/Kconfig.projbuild
```kconfig
menu "Example Configuration"

    config ESP_WIFI_SSID
        string "WiFi SSID"
        default "myssid"
        help
            SSID (network name) for the example to connect to.

    config ESP_WIFI_PASSWORD
        string "WiFi Password"
        default "mypassword"
        help
            WiFi password (WPA or WPA2) for the example to use.

    config ESP_USB_NCM_USE_WIFI_REMOTE
        int
        default 1 if !SOC_WIFI_SUPPORTED
        default 0

endmenu
```

## examples/peripherals/usb/device/tusb_sample_descriptor/sdkconfig.defaults
```kconfig
# Defaults for generating a new "sdkconfig" file (project settings).
# https://docs.espressif.com/projects/esp-idf/en/latest/esp32/api-guides/build-system.html#custom-sdkconfig-defaults
#
# NOTE - if this file changes, to get new defaults, you must erase any existing
# "sdkconfig" file (this will undo manual settings from "idf.py menuconfig").

CONFIG_TINYUSB=y
CONFIG_TINYUSB_DESC_USE_ESPRESSIF_VID=n
CONFIG_TINYUSB_DESC_CUSTOM_VID=0x303A
CONFIG_TINYUSB_DESC_USE_DEFAULT_PID=n
CONFIG_TINYUSB_DESC_CUSTOM_PID=0x3000
```

## examples/peripherals/usb/host/cdc/cdc_acm_vcp/main/Kconfig.projbuild
```kconfig
menu "Example Configuration"

    choice
        prompt "USB-to-UART device type"
        default EXAMPLE_USE_CP210X
        help
            Type of UART converter to use in this example.

        config EXAMPLE_USE_FTDI
            bool "FT232"
        config EXAMPLE_USE_CP210X
            bool "CP2012"
    endchoice

endmenu
```

## examples/peripherals/usb/host/cdc/main/Kconfig.projbuild
```kconfig
menu "Example Configuration"

    orsource "$IDF_PATH/examples/common_components/env_caps/$IDF_TARGET/Kconfig.env_caps"

    config APP_QUIT_PIN
        int "APP Quit button GPIO pin"
        range ENV_GPIO_RANGE_MIN ENV_GPIO_IN_RANGE_MAX
        default 35 if IDF_TARGET_ESP32P4
        default 0
        help
            GPIO pin number to be used as APP_QUIT button.

endmenu
```

## examples/peripherals/usb/host/cherryusb_host/main/Kconfig.projbuild
```kconfig
menu "Example Configuration"

    choice EXAMPLE_USB_HOST_RHPORT
        prompt "USB Host Peripheral"
        default EXAMPLE_USB_HOST_RHPORT_HS if IDF_TARGET_ESP32P4
        default EXAMPLE_USB_HOST_RHPORT_FS
        help
            Allows set the USB Peripheral Controller for USB host.

            - High-speed (USB OTG2.0 Peripheral for High-, Full- and Low-speed)
            - Full-speed (USB OTG1.1 Peripheral for Full- and Low-speed)

        config EXAMPLE_USB_HOST_RHPORT_HS
            bool "OTG2.0"
            depends on IDF_TARGET_ESP32P4
        config EXAMPLE_USB_HOST_RHPORT_FS
            bool "OTG1.1"

    endchoice

    config EXAMPLE_HAL_USE_ESP32_S3_USB_OTG
        bool "Use dev kit ESP32-S3-USB-OTG"
        depends on IDF_TARGET_ESP32S3
        default y

    config EXAMPLE_FORMAT_IF_MOUNT_FAILED
        bool "Format the card if mount failed"
        depends on CHERRYUSB_HOST_MSC
        default n
        help
            If this config item is set, format_if_mount_failed will be set to true and the card will be formatted if
            the mount has failed.

    config EXAMPLE_CHERRYUSB_INIT_DEINIT_LOOP
        bool "Perform init deinit of cherryusb stack in a loop"
        default n

endmenu
```

## examples/peripherals/usb/host/uvc/main/Kconfig.projbuild
```kconfig
menu "Example Configuration"
    config EXAMPLE_ENABLE_STREAMING
        bool "Enable streaming"
        default n
        help
            Enables streaming of captured video.

    choice EXAMPLE_UVC_PROTOCOL_MODE
        prompt "UVC Protocol mode"
        default EXAMPLE_UVC_PROTOCOL_MODE_AUTO

        config EXAMPLE_UVC_PROTOCOL_MODE_AUTO
            bool "Auto"
            help
                When protocol mode set to Auto, the example tries to make three attempts to negotiate
                the protocol with following parameters:
                1 Attempt: 640x480, 15 FPS, MJPEG
                2 Attempt: 320x240, 30 FPS, MJPEG
                3 Attempt: 320x240, first available FPS, MJPEG
                If all three attempts result in an error, the example displays the error message and
                suggests to try another USB UVC Device.

        config EXAMPLE_UVC_PROTOCOL_MODE_CUSTOM
            bool "Custom"
            help
                When protocol mode set to Custom, the example tries to negotiate protocol with
                configured parameters: Attempts, Width, Height, FPS, Frame Coding format.
                After all attempts result in an error, the example displays the error message and
                suggests to try another USB UVC Device.

    endchoice

    config EXAMPLE_NEGOTIATION_ATTEMPTS
        int "Negotiation attempts"
        default 3
        help
            Number of attempts to negotiate custom protocol parameters.

    menu "UVC Protocol parameters"
        depends on EXAMPLE_UVC_PROTOCOL_MODE_CUSTOM

        config EXAMPLE_WIDTH_PARAM
            int "Width resolution in pixels"
            default 320
            help
                Configure the negotiation width parameter during UVC device stream getting.
        config EXAMPLE_HEIGHT_PARAM
            int "Height resolution in pixels"
            default 240
            help
                Configure the negotiation height parameter during UVC device stream getting.
        config EXAMPLE_FPS_PARAM
            int "FPS"
            default 30
            help
                Configure the negotiation FPS parameter during UVC device stream getting.
                Can be any value, available from the Frame Descriptor of the UVC device.
                When 0 - negotiation accept the first rate available.

        choice EXAMPLE_NEGOTIATION_FORMAT
            prompt "Frame coding format of the stream, transport-independent"
            default UVC_FRAME_FORMAT_MJPEG
            help
                Configure the negotiation frame coding of stream.

            config UVC_FRAME_FORMAT_UNKNOWN
                bool "Unknown"
            config UVC_FRAME_FORMAT_UNCOMPRESSED
                bool "Uncompressed"
            config UVC_FRAME_FORMAT_COMPRESSED
                bool "Compressed"
            config UVC_FRAME_FORMAT_YUYV
                bool "YUYV"
            config UVC_FRAME_FORMAT_UYVY
                bool "UYVY"
            config UVC_FRAME_FORMAT_RGB
                bool "RGB"
            config UVC_FRAME_FORMAT_BGR
                bool "BGR"
            config UVC_FRAME_FORMAT_MJPEG
                bool "MJPEG"
            config UVC_FRAME_FORMAT_GRAY8
                bool "GRAY8"
            config UVC_FRAME_FORMAT_GRAY16
                bool "GRAY16"
            config UVC_FRAME_FORMAT_NV12
                bool "NV12"

        endchoice

        config EXAMPLE_FORMAT_PARAM
            int
            default 0  if UVC_FRAME_FORMAT_UNKNOWN
            default 1  if UVC_FRAME_FORMAT_UNCOMPRESSED
            default 2  if UVC_FRAME_FORMAT_COMPRESSED
            default 3  if UVC_FRAME_FORMAT_YUYV
            default 4  if UVC_FRAME_FORMAT_UYVY
            default 5  if UVC_FRAME_FORMAT_RGB
            default 6  if UVC_FRAME_FORMAT_BGR
            default 7  if UVC_FRAME_FORMAT_MJPEG
            default 9  if UVC_FRAME_FORMAT_GRAY8
            default 10 if UVC_FRAME_FORMAT_GRAY16
            default 17 if UVC_FRAME_FORMAT_NV12
    endmenu

endmenu
```

## examples/peripherals/usb/host/uvc/sdkconfig.defaults
```kconfig
#
# SPIRAM
#
CONFIG_SPIRAM=y
CONFIG_SPIRAM_MALLOC_RESERVE_INTERNAL=150000
CONFIG_SPIRAM_TRY_ALLOCATE_WIFI_LWIP=y

#
# USB
#
CONFIG_USB_HOST_CONTROL_TRANSFER_MAX_SIZE=3000
CONFIG_USB_HOST_HW_BUFFER_BIAS_IN=y
CONFIG_PRINTF_UVC_CONFIGURATION_DESCRIPTOR=y
```

## examples/peripherals/usb/host/uvc/sdkconfig.defaults.esp32s2
```kconfig
#
# SPIRAM
#
CONFIG_SPIRAM_SPEED_80M=y

#
# SYSTEM
#
CONFIG_ESP_DEFAULT_CPU_FREQ_MHZ_240=y
```

## examples/peripherals/usb/tusb_cdc_ecm/main/Kconfig.projbuild
```kconfig
menu "Example Configuration"

    config EXAMPLE_STATIC_IP
        bool "Set static IP Address"
        default n
        help
            Set static IP Address. If this option is disabled, a DHCP client is started instead.
    
    if EXAMPLE_STATIC_IP

        menu "IP Address"

            config EXAMPLE_IP_ADDRESS_1
                int "IP Address 1 ([].xxx.xxx.xxx)"
                range 0 255
                default 192
                help 
                    IP Address Part 1: This option sets the first byte of the static IP Address
                    of the internal cdc-ecm network interface.

            config EXAMPLE_IP_ADDRESS_2
                int "IP Address 2 (xxx.[].xxx.xxx)"
                range 0 255
                default 168
                help 
                    IP Address Part 2: This option sets the second byte of the static IP Address
                    of the internal cdc-ecm network interface.

            config EXAMPLE_IP_ADDRESS_3
                int "IP Address 3 (xxx.xxx.[].xxx)"
                range 0 255
                default 7
                help 
                    IP Address Part 3: This option sets the third byte of the static IP Address
                    of the internal cdc-ecm network interface.

            config EXAMPLE_IP_ADDRESS_4
                int "IP Address 4 (xxx.xxx.xxx.[])"
                range 0 255
                default 1
                help 
                    IP Address Part 4: This option sets the fourth byte of the static IP Address
                    of the internal cdc-ecm network interface.

        endmenu


    endif # EXAMPLE_STATIC_IP

endmenu
```

## examples/peripherals/usb/tusb_cdc_ecm/sdkconfig.defaults
```kconfig
CONFIG_IDF_TARGET="esp32s2"
CONFIG_TINYUSB=y
CONFIG_TINYUSB_NET_ENABLED=y
CONFIG_FREERTOS_HZ=1000
```

## examples/peripherals/usb/tusb_sample_cdc/sdkconfig.defaults
```kconfig
CONFIG_IDF_TARGET="esp32s2"
CONFIG_USB_ENABLED=y
CONFIG_USB_DESC_USE_ESPRESSIF_VID=n
CONFIG_USB_DESC_CUSTOM_VID=0x303A
CONFIG_USB_DESC_USE_DEFAULT_PID=n
CONFIG_USB_DESC_CUSTOM_PID=0x3000
CONFIG_USB_CDC_ENABLED=y
CONFIG_USB_CDC_RX_BUFSIZE=64
CONFIG_USB_CDC_TX_BUFSIZE=64
```

## examples/peripherals/usb/tusb_sample_descriptor/main/Kconfig.projbuild
```kconfig
menu "Example Configuration"

    config EXAMPLE_MANUAL_DESC
        bool "Set up a USB descriptor manually in code"
        default y
        help
            You can set up a descriptor using Menuconfig or independently of
            your project configuration - manually in code

endmenu
```

## examples/peripherals/usb/tusb_sample_descriptor/sdkconfig.defaults
```kconfig
CONFIG_TINYUSB=y
CONFIG_TINYUSB_DESC_USE_ESPRESSIF_VID=n
CONFIG_TINYUSB_DESC_CUSTOM_VID=0x303A
CONFIG_TINYUSB_DESC_USE_DEFAULT_PID=n
CONFIG_TINYUSB_DESC_CUSTOM_PID=0x3000
```

## examples/peripherals/wave_gen/main/Kconfig.projbuild
```kconfig
menu "Example Configuration"

    choice EXAMPLE_DAC_CHANNEL
        bool "DAC Channel Num"
        default EXAMPLE_DAC_CHANNEL_1
        help
            Select DAC channel used by the wave generator.

        config EXAMPLE_DAC_CHANNEL_1
            bool "DAC Channel 1 (GPIO25)"
        config EXAMPLE_DAC_CHANNEL_2
            bool "DAC Channel 2 (GPIO26)"
    endchoice

    config EXAMPLE_DAC_CHANNEL
        int
        default 0 if EXAMPLE_DAC_CHANNEL_1
        default 1 if EXAMPLE_DAC_CHANNEL_2

    choice EXAMPLE_WAVEFORM
        bool "Waveform"
        default EXAMPLE_WAVEFORM_SINE
        help
            Select waveform
        config EXAMPLE_WAVEFORM_SINE
            bool "Sine selected"
        config EXAMPLE_WAVEFORM_TRIANGLE
            bool "Triangle selected"
        config EXAMPLE_WAVEFORM_SAWTOOTH
            bool "Sawtooth selected"
        config EXAMPLE_WAVEFORM_SQUARE
            bool "Square selected"
    endchoice

    choice EXAMPLE_WAVE_FREQUENCY
        bool "Wave frequency"
        default EXAMPLE_WAVE_FREQ_3000
        help
            Select output wave frequency.

        config EXAMPLE_WAVE_FREQ_1000
            bool "1000 Hz"
        config EXAMPLE_WAVE_FREQ_2000
            bool "2000 Hz"
        config EXAMPLE_WAVE_FREQ_3000
            bool "3000 Hz"
        config EXAMPLE_WAVE_FREQ_4000
            bool "4000 Hz"
        config EXAMPLE_WAVE_FREQ_5000
            bool "5000 Hz"
        config EXAMPLE_WAVE_FREQ_6000
            bool "6000 Hz"
        config EXAMPLE_WAVE_FREQ_7000
            bool "7000 Hz"
        config EXAMPLE_WAVE_FREQ_8000
            bool "8000 Hz"
        config EXAMPLE_WAVE_FREQ_9000
            bool "9000 Hz"
        config EXAMPLE_WAVE_FREQ_10000
            bool "10000 Hz"
        config EXAMPLE_WAVE_FREQ_11000
            bool "11000 Hz"
        config EXAMPLE_WAVE_FREQ_12000
            bool "12000 Hz"
        config EXAMPLE_WAVE_FREQ_13000
            bool "13000 Hz"
        config EXAMPLE_WAVE_FREQ_14000
            bool "14000 Hz"
        config EXAMPLE_WAVE_FREQ_15000
            bool "15000 Hz"
        config EXAMPLE_WAVE_FREQ_16000
            bool "16000 Hz"
        config EXAMPLE_WAVE_FREQ_17000
            bool "17000 Hz"
    endchoice

    config EXAMPLE_WAVE_FREQUENCY
        int
        default 1000 if EXAMPLE_WAVE_FREQ_1000
        default 2000 if EXAMPLE_WAVE_FREQ_2000
        default 3000 if EXAMPLE_WAVE_FREQ_3000
        default 4000 if EXAMPLE_WAVE_FREQ_4000
        default 5000 if EXAMPLE_WAVE_FREQ_5000
        default 6000 if EXAMPLE_WAVE_FREQ_6000
        default 7000 if EXAMPLE_WAVE_FREQ_7000
        default 8000 if EXAMPLE_WAVE_FREQ_8000
        default 9000 if EXAMPLE_WAVE_FREQ_9000
        default 10000 if EXAMPLE_WAVE_FREQ_10000
        default 11000 if EXAMPLE_WAVE_FREQ_11000
        default 12000 if EXAMPLE_WAVE_FREQ_12000
        default 13000 if EXAMPLE_WAVE_FREQ_13000
        default 14000 if EXAMPLE_WAVE_FREQ_14000
        default 15000 if EXAMPLE_WAVE_FREQ_15000
        default 16000 if EXAMPLE_WAVE_FREQ_16000
        default 17000 if EXAMPLE_WAVE_FREQ_17000

    config EXAMPLE_LOG_VOLTAGE
        bool "Enable output voltage log"
        default n
        help
            If enabled, the output voltage(in mV) will show in log.

endmenu
```

## examples/phy/antenna/main/Kconfig.projbuild
```kconfig
menu "Example Configuration"

    config ESP_WIFI_SSID
        string "WiFi SSID"
        default "myssid"
        help
            SSID (network name) for the example to connect to.

    config ESP_WIFI_PASSWORD
        string "WiFi Password"
        default "mypassword"
        help
            WiFi password (WPA or WPA2) for the example to use.

    config ESP_MAXIMUM_RETRY
        int "Maximum retry"
        default 5
        help
            Set the Maximum retry to avoid station reconnecting to the AP unlimited when the AP is really inexistent.

    choice ESP_WIFI_SCAN_AUTH_MODE_THRESHOLD
        prompt "WiFi Scan auth mode threshold"
        default ESP_WIFI_AUTH_WPA2_PSK
        help
            The weakest authmode to accept in the scan mode.
            This value defaults to ESP_WIFI_AUTH_WPA2_PSK in case password is present and ESP_WIFI_AUTH_OPEN is used.
            Please select ESP_WIFI_AUTH_WEP/ESP_WIFI_AUTH_WPA_PSK in case AP is operating in WEP/WPA mode.

        config ESP_WIFI_AUTH_OPEN
            bool "OPEN"
        config ESP_WIFI_AUTH_WEP
            bool "WEP"
        config ESP_WIFI_AUTH_WPA_PSK
            bool "WPA PSK"
        config ESP_WIFI_AUTH_WPA2_PSK
            bool "WPA2 PSK"
        config ESP_WIFI_AUTH_WPA_WPA2_PSK
            bool "WPA/WPA2 PSK"
        config ESP_WIFI_AUTH_WPA3_PSK
            bool "WPA3 PSK"
        config ESP_WIFI_AUTH_WPA2_WPA3_PSK
            bool "WPA2/WPA3 PSK"
        config ESP_WIFI_AUTH_WAPI_PSK
            bool "WAPI PSK"
    endchoice

endmenu
```
