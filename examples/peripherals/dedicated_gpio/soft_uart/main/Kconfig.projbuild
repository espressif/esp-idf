## examples/peripherals/dedicated_gpio/soft_uart/main/Kconfig.projbuild
```kconfig
menu "Example Configuration"

    orsource "$IDF_PATH/examples/common_components/env_caps/$IDF_TARGET/Kconfig.env_caps"

    config EMULATE_UART_GPIO_TX
        int "GPIO pin for UART TX"
        range ENV_GPIO_RANGE_MIN ENV_GPIO_OUT_RANGE_MAX
        default 0 if IDF_TARGET_ARCH_RISCV
        default 16
        help
            GPIO pin number to be used as UART TX.

    config EMULATE_UART_GPIO_RX
        int "GPIO pin for UART RX"
        range ENV_GPIO_RANGE_MIN ENV_GPIO_OUT_RANGE_MAX
        default 2 if IDF_TARGET_ARCH_RISCV
        default 17
        help
            GPIO pin number to be used as UART RX.

endmenu
```

## examples/peripherals/gpio/generic_gpio/main/Kconfig.projbuild
```kconfig
menu "Example Configuration"

    orsource "$IDF_PATH/examples/common_components/env_caps/$IDF_TARGET/Kconfig.env_caps"

    config GPIO_OUTPUT_0
        int "GPIO output pin 0"
        range ENV_GPIO_RANGE_MIN ENV_GPIO_OUT_RANGE_MAX
        default 8 if IDF_TARGET_ESP32C2 || IDF_TARGET_ESP32H2 || IDF_TARGET_ESP32C5 || IDF_TARGET_ESP32C61
        default 18
        help
            GPIO pin number to be used as GPIO_OUTPUT_IO_0.

    config GPIO_OUTPUT_1
        int "GPIO output pin 1"
        range ENV_GPIO_RANGE_MIN ENV_GPIO_OUT_RANGE_MAX
        default 9 if IDF_TARGET_ESP32C2 || IDF_TARGET_ESP32H2 || IDF_TARGET_ESP32C5 || IDF_TARGET_ESP32C61
        default 19
        help
            GPIO pin number to be used as GPIO_OUTPUT_IO_1.

    config GPIO_INPUT_0
        int "GPIO input pin 0"
        range ENV_GPIO_RANGE_MIN ENV_GPIO_IN_RANGE_MAX
        default 4
        help
            GPIO pin number to be used as GPIO_INPUT_IO_0.

    config GPIO_INPUT_1
        int "GPIO input pin 1"
        range ENV_GPIO_RANGE_MIN ENV_GPIO_IN_RANGE_MAX
        default 5
        help
            GPIO pin number to be used as GPIO_INPUT_IO_1.

endmenu
```

## examples/peripherals/h264/main/Kconfig.projbuild
```kconfig
menu "H.264 Example Configuration"

    choice H264_ENCODER_TYPE
        prompt "H.264 Encoder Type"
        default H264_ENCODER_HARDWARE if IDF_TARGET_ESP32P4
        default H264_ENCODER_SOFTWARE
        help
            Select the H.264 encoder type to use.
            Hardware encoder is only available on ESP32P4 and provides
            better performance and lower power consumption.
            Software encoder is available on all targets but requires
            more CPU resources.

        config H264_ENCODER_HARDWARE
            bool "Hardware Encoder (ESP32P4 only)"
            depends on IDF_TARGET_ESP32P4
            help
                Use hardware H.264 encoder.
                This option is only available on ESP32P4 which has
                dedicated H.264 hardware encoding capabilities.
                Provides better performance and lower power consumption
                compared to software encoding.

        config H264_ENCODER_SOFTWARE
            bool "Software Encoder"
            help
                Use software H.264 encoder using OpenH264 library.
                Available on all supported targets (ESP32S3, ESP32P4)
                but requires more CPU resources and power consumption
                compared to hardware encoding.
    endchoice

    menu "H.264 Encoder Parameters"

        config H264_ENCODER_WIDTH
            int "Video Width"
            range 64 1920
            default 320
            help
                Video frame width in pixels.
                Must be multiple of 16 for optimal performance.
                Recommended values: 128, 160, 320, 640, 1280.

        config H264_ENCODER_HEIGHT
            int "Video Height"
            range 64 1080
            default 240
            help
                Video frame height in pixels.
                Must be multiple of 16 for optimal performance.
                Recommended values: 96, 120, 240, 480, 720.

        config H264_ENCODER_FPS
            int "Frame Rate (FPS)"
            range 1 60
            default 30 if H264_ENCODER_HARDWARE
            default 15 if H264_ENCODER_SOFTWARE
            help
                Video frame rate in frames per second.
                Hardware encoder can support higher frame rates.
                Software encoder performance depends on CPU capability.

        config H264_ENCODER_BITRATE
            int "Bitrate (bps)"
            range 64000 10000000
            default 512000 if H264_ENCODER_HARDWARE
            default 256000 if H264_ENCODER_SOFTWARE
            help
                Video bitrate in bits per second.
                Higher bitrate provides better quality but larger file size.
                Hardware encoder can handle higher bitrates more efficiently.
                Typical values: 256K-1M for low quality, 1M-5M for high quality.

        config H264_ENCODER_GOP_SIZE
            int "GOP Size"
            range 1 255
            default 30
            help
                Group of Pictures size. Determines the frequency
                of I-frames in the video stream.
                Larger GOP size = better compression, higher latency.
                Smaller GOP size = lower compression, lower latency.

        config H264_ENCODER_QP_VALUE
            int "Quantization Parameter (QP)"
            range 10 51
            default 26 if H264_ENCODER_HARDWARE
            default 28 if H264_ENCODER_SOFTWARE
            help
                Quantization parameter that controls video quality.
                Lower values = higher quality, larger file size.
                Higher values = lower quality, smaller file size.
                Hardware encoder can handle lower QP values more efficiently.

    endmenu
endmenu
```

## examples/peripherals/h264/sdkconfig.defaults
```kconfig
CONFIG_SPIRAM=y

CONFIG_ESP_MAIN_TASK_STACK_SIZE=10240

# FreeRTOS configurations
CONFIG_FREERTOS_HZ=1000

# H264 IRAM Configuration Notes:
# When LDGEN_CHECK_MAPPING="1" strict memory mapping check is enabled, linking errors may occur
# Cause: Prebuilt libtinyh264.a library doesn't support forced IRAM placement
# Solutions:
#  Disable IRAM optimization: CONFIG_ESP_H264_DECODER_IRAM=n
CONFIG_ESP_H264_DECODER_IRAM=n

# This case uses the terminal to print the brief diagrams before encoding and after decoding.
# Turn off the watchdog to ensure the integrity of the picture printing
CONFIG_ESP_TASK_WDT_EN=n
```

## examples/peripherals/h264/sdkconfig.defaults.esp32p4
```kconfig
# SPIRAM configurations for ESP32P4
CONFIG_IDF_EXPERIMENTAL_FEATURES=y
CONFIG_SPIRAM_MODE_HEX=y
CONFIG_SPIRAM_SPEED_200M=y

# CPU configuration
CONFIG_ESP_DEFAULT_CPU_FREQ_MHZ_360=y
```

## examples/peripherals/h264/sdkconfig.defaults.esp32s3
```kconfig
# SPIRAM configurations for ESP32S3
CONFIG_SPIRAM_MODE_OCT=y
CONFIG_SPIRAM_SPEED_80M=y

# CPU configuration
CONFIG_ESP_DEFAULT_CPU_FREQ_MHZ_240=y
```

## examples/peripherals/i2c/i2c_basic/main/Kconfig.projbuild
```kconfig
menu "Example Configuration"

    orsource "$IDF_PATH/examples/common_components/env_caps/$IDF_TARGET/Kconfig.env_caps"

    config I2C_MASTER_SCL
        int "SCL GPIO Num"
        range ENV_GPIO_RANGE_MIN ENV_GPIO_OUT_RANGE_MAX
        default 4
        help
            GPIO number for I2C Master clock line.

    config I2C_MASTER_SDA
        int "SDA GPIO Num"
        range ENV_GPIO_RANGE_MIN ENV_GPIO_OUT_RANGE_MAX
        default 5
        help
            GPIO number for I2C Master data line.

    config I2C_MASTER_FREQUENCY
        int "Master Frequency"
        default 400000
        help
            I2C Speed of Master device.

endmenu
```

## examples/peripherals/i2c/i2c_self_test/main/Kconfig.projbuild
```kconfig
menu "Example Configuration"

    menu "I2C Master"
        config I2C_MASTER_SCL
            int "SCL GPIO Num"
            default 19
            help
                GPIO number for I2C Master clock line.

        config I2C_MASTER_SDA
            int "SDA GPIO Num"
            default 18
            help
                GPIO number for I2C Master data line.

        config I2C_MASTER_PORT_NUM
            int "Port Number"
            default 1
            help
                Port number for I2C Master device.

        config I2C_MASTER_FREQUENCY
            int "Master Frequency"
            default 100000
            help
                I2C Speed of Master device.
    endmenu

    menu "I2C Slave"
        config I2C_SLAVE_SCL
            int "SCL GPIO Num"
            default 5
            help
                GPIO number for I2C Slave clock line.

        config I2C_SLAVE_SDA
            int "SDA GPIO Num"
            default 4
            help
                GPIO number for I2C Slave data line.

        config I2C_SLAVE_PORT_NUM
            int "Port Number"
            default 0
            help
                Port number for I2C Slave device.

        config I2C_SLAVE_ADDRESS
            hex "ESP Slave Address"
            default 0x28
            help
                Hardware Address of I2C Slave Port.
    endmenu

    menu "BH1750 Sensor"
        choice BH1750_ADDR
            prompt "BH1750 I2C Address"
            default BH1750_I2C_ADDRESS_LOW
            help
                Hardware address of BH1750, which is 2 types, and determined by ADDR terminal.

            config BH1750_I2C_ADDRESS_LOW
                bool "BH1750 I2C Address(ADDR=0)"
                help
                    I2C Address of BH1750 Sensor according to your schemetic configuration.

            config BH1750_I2C_ADDRESS_High
                bool "BH1750 I2C Address(ADDR=1)"
                help
                    I2C Address of BH1750 Sensor according to your schemetic configuration.
        endchoice

        config BH1750_ADDR
            hex
            default 0x5C if BH1750_I2C_ADDRESS_High
            default 0x23 if BH1750_I2C_ADDRESS_LOW

        choice BH1750_MODE
            prompt "BH1750 Operation Mode"
            default BH1750_ONETIME_L_RESOLUTION
            help
                Operation Mode of BH1750.
                Different mode means different resolution and measurement time.
            config BH1750_CONTINU_H_RESOLUTION
                bool "Continuously H-Resolution Mode"
                help
                    Resolution is 1lx, measurement time is typically 120ms.
            config BH1750_CONTINU_H_RESOLUTION2
                bool "Continuously H-Resolution Mode2"
                help
                    Resolution is 0.5lx, measurement time is typically 120ms.
            config BH1750_CONTINU_L_RESOLUTION
                bool "Continuously L-Resolution Mode"
                help
                    Resolution is 4lx, measurement time is typically 16ms.
            config BH1750_ONETIME_H_RESOLUTION
                bool "One Time H-Resolution Mode"
                help
                    Resolution is 1lx, measurement time is typically 120ms.
                    It is automatically set to Power Down mode after measurement.
            config BH1750_ONETIME_H_RESOLUTION2
                bool "One Time H-Resolution Mode2"
                help
                    Resolution is 0.5lx, measurement time is typically 120ms.
                    It is automatically set to Power Down mode after measurement.
            config BH1750_ONETIME_L_RESOLUTION
                bool "One Time L-Resolution Mode"
                help
                    Resolution is 4lx, measurement time is typically 16ms.
                    It is automatically set to Power Down mode after measurement.
        endchoice

        config BH1750_OPMODE
            hex
            default 0x10 if BH1750_CONTINU_H_RESOLUTION
            default 0x11 if BH1750_CONTINU_H_RESOLUTION2
            default 0x13 if BH1750_CONTINU_L_RESOLUTION
            default 0x20 if BH1750_ONETIME_H_RESOLUTION
            default 0x21 if BH1750_ONETIME_H_RESOLUTION2
            default 0x23 if BH1750_ONETIME_L_RESOLUTION

    endmenu

endmenu
```

## examples/peripherals/i2c/i2c_simple/main/Kconfig.projbuild
```kconfig
menu "Example Configuration"

    orsource "$IDF_PATH/examples/common_components/env_caps/$IDF_TARGET/Kconfig.env_caps"

    config I2C_MASTER_SCL
        int "SCL GPIO Num"
        range ENV_GPIO_RANGE_MIN ENV_GPIO_OUT_RANGE_MAX
        default 19 if IDF_TARGET_ESP32 || IDF_TARGET_ESP32S2 || IDF_TARGET_ESP32S3
        default 2
        help
            GPIO number for I2C Master clock line.

    config I2C_MASTER_SDA
        int "SDA GPIO Num"
        range ENV_GPIO_RANGE_MIN ENV_GPIO_OUT_RANGE_MAX
        default 18 if IDF_TARGET_ESP32 || IDF_TARGET_ESP32S2 || IDF_TARGET_ESP32S3
        default 1
        help
            GPIO number for I2C Master data line.

endmenu
```

## examples/peripherals/i2c/i2c_slave_network_sensor/main/Kconfig.projbuild
```kconfig
menu "Example Configuration"

    menu "I2C Slave"
        config I2C_SLAVE_SCL
            int "SCL GPIO Num"
            default 4
            help
                GPIO number for I2C Slave clock line.

        config I2C_SLAVE_SDA
            int "SDA GPIO Num"
            default 5
            help
                GPIO number for I2C Slave data line.

        config I2C_SLAVE_ADDRESS
            hex "I2C SLAVE ADDRESS"
            default 0x28
            help
                Address of I2C slave

    endmenu

endmenu
```

## examples/peripherals/i2c/i2c_slave_network_sensor/sdkconfig.defaults
```kconfig
CONFIG_PARTITION_TABLE_CUSTOM=y
CONFIG_ESPTOOLPY_FLASHSIZE_4MB=y
CONFIG_ESP_TLS_INSECURE=y
CONFIG_ESP_TLS_SKIP_SERVER_CERT_VERIFY=y
```

## examples/peripherals/i2c/i2c_tools/main/Kconfig.projbuild
```kconfig
menu "Example Configuration"

    config EXAMPLE_STORE_HISTORY
        bool "Store command history in flash"
        default y
        help
            Linenoise line editing library provides functions to save and load
            command history. If this option is enabled, initalizes a FAT filesystem
            and uses it to store command history.

    config EXAMPLE_I2C_MASTER_SCL
        int "SCL GPIO Num"
        default 19 if IDF_TARGET_ESP32
        default 4
        help
            GPIO number for I2C Master clock line.

    config EXAMPLE_I2C_MASTER_SDA
        int "SDA GPIO Num"
        default 18 if IDF_TARGET_ESP32
        default 5
        help
            GPIO number for I2C Master data line.

endmenu
```

## examples/peripherals/i2c/i2c_u8g2/main/Kconfig.projbuild
```kconfig
menu "Example Configuration"

    orsource "$IDF_PATH/examples/common_components/env_caps/$IDF_TARGET/Kconfig.env_caps"

    config I2C_DISPLAY_ADDRESS
        hex "Display I2C Address"
        range 0x00 0x7F
        default 0x3C
        help
            I2C address of the target display, usually 0x3C or 0x3D.

    config I2C_MASTER_SCL
        int "SCL GPIO Num"
        range ENV_GPIO_RANGE_MIN ENV_GPIO_OUT_RANGE_MAX
        default 18 if IDF_TARGET_ESP32
        default 4
        help
            GPIO number for I2C Master clock line.

    config I2C_MASTER_SDA
        int "SDA GPIO Num"
        range ENV_GPIO_RANGE_MIN ENV_GPIO_OUT_RANGE_MAX
        default 19 if IDF_TARGET_ESP32
        default 5
        help
            GPIO number for I2C Master data line.

    config I2C_MASTER_FREQUENCY
        int "Master Frequency"
        default 400000
        help
            I2C Speed of Master device.

endmenu
```

## examples/peripherals/i2s/i2s_adc_dac/sdkconfig.defaults
```kconfig
CONFIG_PARTITION_TABLE_CUSTOM=y
CONFIG_PARTITION_TABLE_CUSTOM_FILENAME="partitions_adc_dac_example.csv"
CONFIG_ESPTOOLPY_FLASHSIZE_4MB=y
```
