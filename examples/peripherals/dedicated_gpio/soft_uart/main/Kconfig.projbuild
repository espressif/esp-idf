## examples/peripherals/i2s/i2s_advance/i2s_usb/main/Kconfig.projbuild
```kconfig
menu "Example Configuration"

    menu "I2C GPIOs config"
        config EXAMPLE_I2C_SCL_IO
            int "SCL pin"
            default 8 if IDF_TARGET_ESP32P4
            default 4
        config EXAMPLE_I2C_SDA_IO
            int "SDA pin"
            default 7 if IDF_TARGET_ESP32P4
            default 5
    endmenu

    menu "I2S GPIOs config"
        config EXAMPLE_I2S_MCK_IO
            int "MCK pin"
            default 13 if IDF_TARGET_ESP32P4
            default 10
        config EXAMPLE_I2S_BCK_IO
            int "BCK pin"
            default 12 if IDF_TARGET_ESP32P4
            default 11
        config EXAMPLE_I2S_WS_IO
            int "WS pin"
            default 10 if IDF_TARGET_ESP32P4
            default 12
        config EXAMPLE_I2S_DO_IO
            int "DOUT pin"
            default 9 if IDF_TARGET_ESP32P4
            default 13
        config EXAMPLE_I2S_DI_IO
            int "DIN pin"
            default 11 if IDF_TARGET_ESP32P4
            default 14
    endmenu

    config EXAMPLE_DYNAMIC_TUNING_EN
        bool "Enable dynamic tuning"
        default n
        help
            Enable to tune the audio rate dynamically to match the I2S and UAC speed.

    choice EXAMPLE_BIT_WIDTH
        prompt "Audio data bit width"
        default BIT_WIDTH_16BIT

        config BIT_WIDTH_8BIT
            bool "8-bit"
        config BIT_WIDTH_16BIT
            bool "16-bit"
        config BIT_WIDTH_24BIT
            bool "24-bit"
        config BIT_WIDTH_32BIT
            bool "32-bit"
    endchoice

    config EXAMPLE_AUDIO_BIT_WIDTH
        int
        default 8 if BIT_WIDTH_8BIT
        default 16 if BIT_WIDTH_16BIT
        default 24 if BIT_WIDTH_24BIT
        default 32 if BIT_WIDTH_32BIT

    config EXAMPLE_CODEC_MIC_GAIN
        int "Set MIC gain (unit: dB)"
        default 18
        help
            Select mic gain for echo mode

    config EXAMPLE_CODEC_VOLUME
        int "Voice volume"
        range 0 100
        default 60
        help
            Set voice volume

    config EXAMPLE_PA_CTRL_IO
        int "Power Amplifier control IO"
        default 53 if IDF_TARGET_ESP32P4
        default 6
        help
            Set GPIO number for PA control. Set -1 to disable PA control.

endmenu
```

## examples/peripherals/i2s/i2s_advance/i2s_usb/sdkconfig.defaults
```kconfig
CONFIG_I2S_ENABLE_DEBUG_LOG=y
CONFIG_FREERTOS_HZ=1000
CONFIG_UAC_SAMPLE_RATE=16000
CONFIG_CODEC_I2C_BACKWARD_COMPATIBLE=n
```

## examples/peripherals/i2s/i2s_advance/i2s_usb/sdkconfig.defaults.esp32p4
```kconfig
# ESP32-P4 EV board pin assignment
# I2C GPIOs
CONFIG_EXAMPLE_I2C_SCL_IO=8
CONFIG_EXAMPLE_I2C_SDA_IO=7

# I2S GPIOs
CONFIG_EXAMPLE_I2S_MCK_IO=13
CONFIG_EXAMPLE_I2S_BCK_IO=12
CONFIG_EXAMPLE_I2S_WS_IO=10
CONFIG_EXAMPLE_I2S_DO_IO=9
CONFIG_EXAMPLE_I2S_DI_IO=11

# PA GPIO
CONFIG_EXAMPLE_PA_CTRL_IO=53
```

## examples/peripherals/i2s/i2s_advance/i2s_usb/sdkconfig.defaults.esp32s3
```kconfig
# I2C GPIOs
CONFIG_EXAMPLE_I2C_SCL_IO=4
CONFIG_EXAMPLE_I2C_SDA_IO=5

# I2S GPIOs
CONFIG_EXAMPLE_I2S_MCK_IO=10
CONFIG_EXAMPLE_I2S_BCK_IO=11
CONFIG_EXAMPLE_I2S_WS_IO=12
CONFIG_EXAMPLE_I2S_DO_IO=13
CONFIG_EXAMPLE_I2S_DI_IO=14

# PA GPIO
CONFIG_EXAMPLE_PA_CTRL_IO=6
```

## examples/peripherals/i2s/i2s_basic/i2s_pdm/main/Kconfig.projbuild
```kconfig
menu "I2S PDM Example Configuration"

    choice EXAMPLE_PDM_DIR
        prompt "I2S PDM direction"
        default EXAMPLE_PDM_TX
        help
            Select example PDM direction

        config EXAMPLE_PDM_TX
            bool "PDM TX"
            depends on SOC_I2S_SUPPORTS_PDM_TX
            help
                PDM TX example will play 'twinkle twinkle little star' in three tones.

        config EXAMPLE_PDM_RX
            bool "PDM RX"
            depends on SOC_I2S_SUPPORTS_PDM_RX
            help
                PDM RX example will show the received data from a PDM microphone.
    endchoice

    choice EXAMPLE_PDM_TX_LINE_MODE
        prompt "I2S PDM TX Line Mode"
        depends on EXAMPLE_PDM_TX && SOC_I2S_HW_VERSION_2
        default EXAMPLE_PDM_TX_CODEC
        help
            Decide to output PDM signal into a PDM codec or a low-pass filter

        config EXAMPLE_PDM_TX_CODEC
            bool "Codec line mode"
            help
                Output PDM signal to a PDM codec. The PDM clock signal is mandatory for PDM codec,
                the codec can differentiate the left and right sound channels by sampling data
                on positive or negative edges. That means the data of the left and right channels
                can coexist on a same data line.

        config EXAMPLE_PDM_TX_DAC
            bool "DAC line mode"
            help
                Output PDM signal to a low-pass filter, so that the low-pass filter can restore the PDM
                signal to analog wave. Therefore, each data line can only contains one sound channel,
                if both left and right channels are required, two data lines should be specified as well.
                Normally the PDM signal is not sufficient in DAC line mode.
    endchoice

endmenu
```

## examples/peripherals/i2s/i2s_basic/i2s_std/main/Kconfig.projbuild
```kconfig
menu "I2S STD Example Configuration"

    choice DUPLEX_MODE
        prompt "I2S STD duplex/simplex select"
        default USE_DUPLEX
        help
            Select duplex mode or simplex mode for the example

        config USE_DUPLEX
            bool "Duplex TX and RX channels"
            help
                Allocate TX and RX channels on a same I2S controller in duplex mode, sharing the BCLK and WS signal

        config USE_SIMPLEX
            bool "Simplex TX and RX channels"
            depends on !IDF_TARGET_ESP32S2
            help
                Allocate TX and RX channels in duplex mode, they are totally separate.
    endchoice

endmenu
```

## examples/peripherals/i2s/i2s_codec/i2s_es7210_tdm/main/Kconfig.projbuild
```kconfig
menu "Example Configuration"

    menu "Example IO Configuration"
        config EXAMPLE_I2C_SDA_IO
            int "I2C SDA IO"
            default 1 if IDF_TARGET_ESP32S3
            default 17 if IDF_TARGET_ESP32H4
            default 3

        config EXAMPLE_I2C_SCL_IO
            int "I2C SCL IO"
            default 16 if IDF_TARGET_ESP32H4
            default 2

        config EXAMPLE_I2S_MCLK_IO
            int "I2S MCLK IO"
            default 20 if IDF_TARGET_ESP32S3
            default 4 if IDF_TARGET_ESP32P4
            default 0

        config EXAMPLE_I2S_BCLK_IO
            int "I2S BCLK IO"
            default 10 if IDF_TARGET_ESP32S3
            default 5 if IDF_TARGET_ESP32P4
            default 4 if IDF_TARGET_ESP32H4
            default 1

        config EXAMPLE_I2S_WS_IO
            int "I2S WS IO"
            default 9 if IDF_TARGET_ESP32S3
            default 6 if IDF_TARGET_ESP32P4
            default 5 if IDF_TARGET_ESP32H4
            default 10

        config EXAMPLE_I2S_DIN_IO
            int "I2S DIN IO"
            default 11 if IDF_TARGET_ESP32S3
            default 7 if IDF_TARGET_ESP32P4
            default 6 if IDF_TARGET_ESP32H4
            default 8

        config EXAMPLE_SD_SPI_CLK_IO
            int "SD card SPI CLK IO"
            default 18 if IDF_TARGET_ESP32S3 || IDF_TARGET_ESP32P4
            default 12 if IDF_TARGET_ESP32H4
            default 5

        config EXAMPLE_SD_SPI_MOSI_IO
            int "SD card SPI MOSI IO"
            default 17 if IDF_TARGET_ESP32S3
            default 19 if IDF_TARGET_ESP32P4
            default 13 if IDF_TARGET_ESP32H4
            default 7

        config EXAMPLE_SD_SPI_MISO_IO
            int "SD card SPI MISO IO"
            default 16 if IDF_TARGET_ESP32S3
            default 14 if IDF_TARGET_ESP32P4 || IDF_TARGET_ESP32H4
            default 6

        config EXAMPLE_SD_SPI_CS_IO
            int "SD card SPI CS IO"
            default 15 if IDF_TARGET_ESP32S3 || IDF_TARGET_ESP32H4
            default 17 if IDF_TARGET_ESP32P4
            default 4

    endmenu

endmenu
```

## examples/peripherals/i2s/i2s_codec/i2s_es8311/main/Kconfig.projbuild
```kconfig
menu "Example Configuration"

    menu "Example IO Configuration"
        config EXAMPLE_PA_CTRL_IO
            int "Power Amplifier control IO"
            default 53 if IDF_TARGET_ESP32P4
            default -1
            help
                Set GPIO number for PA control. Set -1 to disable PA control.

        config EXAMPLE_I2C_SDA_IO
            int "I2C SDA IO"
            default 17 if IDF_TARGET_ESP32 || IDF_TARGET_ESP32S2 || IDF_TARGET_ESP32S3
            default 9 if IDF_TARGET_ESP32H2
            default 7

        config EXAMPLE_I2C_SCL_IO
            int "I2C SCL IO"
            default 16 if IDF_TARGET_ESP32 || IDF_TARGET_ESP32S2 || IDF_TARGET_ESP32S3
            default 8 if IDF_TARGET_ESP32H2 || IDF_TARGET_ESP32P4
            default 6

        config EXAMPLE_I2S_MCLK_IO
            int "I2S MCLK IO"
            default 13 if IDF_TARGET_ESP32P4
            default 0

        config EXAMPLE_I2S_BCLK_IO
            int "I2S BCLK IO"
            default 12 if IDF_TARGET_ESP32P4
            default 4

        config EXAMPLE_I2S_WS_IO
            int "I2S WS IO"
            default 10 if IDF_TARGET_ESP32P4
            default 5

        config EXAMPLE_I2S_DIN_IO
            int "I2S DIN IO"
            default 19 if IDF_TARGET_ESP32 || IDF_TARGET_ESP32S2 || IDF_TARGET_ESP32S3
            default 11 if IDF_TARGET_ESP32P4
            default 3

        config EXAMPLE_I2S_DOUT_IO
            int "I2S DOUT IO"
            default 18 if IDF_TARGET_ESP32 || IDF_TARGET_ESP32S2 || IDF_TARGET_ESP32S3
            default 9 if IDF_TARGET_ESP32P4
            default 2

    endmenu

    choice EXAMPLE_MODE
        prompt "Example mode"
        default EXAMPLE_MODE_MUSIC
        help
            Select example work mode

        config EXAMPLE_MODE_MUSIC
            bool "music"
        config EXAMPLE_MODE_ECHO
            depends on !EXAMPLE_BSP
            bool "echo"
    endchoice

    config EXAMPLE_MIC_GAIN
        int "Set MIC gain (unit: dB)"
        depends on EXAMPLE_MODE_ECHO
        default 18
        help
            Select mic gain for echo mode

    config EXAMPLE_VOICE_VOLUME
        int "Voice volume"
        range 0 100
        default 60
        help
            Set voice volume
endmenu
```
