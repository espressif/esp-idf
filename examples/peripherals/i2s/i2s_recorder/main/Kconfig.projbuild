## examples/peripherals/i2s/i2s_recorder/main/Kconfig.projbuild
```kconfig
menu "Example Configuration"

    menu "SDCard Configuration"

        config EXAMPLE_SPI_MISO_GPIO
            int "SPI MISO GPIO"
            default 15
            help
                Set the GPIO number used for MISO from SPI.

        config EXAMPLE_SPI_MOSI_GPIO
            int "SPI MOSI GPIO"
            default 14
            help
                Set the GPIO number used for MOSI from SPI.

        config EXAMPLE_SPI_SCLK_GPIO
            int "SPI SCLK GPIO"
            default 18
            help
                Set the GPIO number used for SCLK from SPI.

        config EXAMPLE_SPI_CS_GPIO
            int "SPI CS GPIO"
            default 19
            help
                Set the GPIO number used for CS from SPI.

    endmenu

    menu "I2S MEMS MIC Configuration"

        config EXAMPLE_SAMPLE_RATE
            int "Audio Sample Rate"
            default 44100
            help
                Set the audio sample rate frequency. Usually 16000 or 44100 Hz.

        config EXAMPLE_BIT_SAMPLE
            int "Audio Bit Sample"
            default 16
            help
                Define the number of bits for each sample. Default 16 bits per sample.

        config EXAMPLE_I2S_DATA_GPIO
            int "I2S Data GPIO"
            default 5
            help
                Set the GPIO number used for transmitting/receiving data from I2S.

        config EXAMPLE_I2S_CLK_GPIO
            int "I2S Clock GPIO"
            default 4
            help
                Set the GPIO number used for the clock line from I2S.

    endmenu

    config EXAMPLE_REC_TIME
        int "Example Recording Time in Seconds"
        default 15
        help
            Set the time for recording audio in seconds.

endmenu
```

## examples/peripherals/i2s/i2s_test/sdkconfig.defaults
```kconfig
# Target
CONFIG_IDF_TARGET="esp32s3"

# Disable PSRAM
CONFIG_SPIRAM=n

# Disable other potentially problematic components
CONFIG_ESP_PSRAM_MODE_DISABLE=y
```

## examples/peripherals/i2s_test_final/sdkconfig.defaults
```kconfig
# Enable SPIRAM support
CONFIG_SPIRAM=y
CONFIG_ESP32S3_SPIRAM_MODE_OCT=y
CONFIG_ESP32S3_SPIRAM_TYPE_AUTO=y
CONFIG_ESP32S3_SPIRAM_SIZE=-1
CONFIG_ESP32S3_SPIRAM_SPEED_80M=y
CONFIG_ESP32S3_SPIRAM_BOOT_INIT=y
CONFIG_ESP32S3_SPIRAM_USE_MALLOC=y
CONFIG_ESP32S3_SPIRAM_MEMTEST=y
CONFIG_ESP32S3_SPIRAM_MALLOC_ALWAYSINTERNAL=16384
CONFIG_ESP32S3_SPIRAM_TRY_ALLOCATE_WIFI_LWIP=y
CONFIG_ESP32S3_SPIRAM_MALLOC_RESERVE_INTERNAL=32768
```

## examples/peripherals/i2s_test_final_last/main/Kconfig.projbuild
```kconfig
menu "I2S Test Configuration"

    menu "I2S Audio Output Configuration"
        config EXAMPLE_I2S_BCK_IO
            int "I2S BCK GPIO"
            default 2 if IDF_TARGET_ESP32S3
            default 4
            help
                Set the GPIO number used for I2S bit clock.

        config EXAMPLE_I2S_WS_IO
            int "I2S WS GPIO"
            default 3 if IDF_TARGET_ESP32S3
            default 5
            help
                Set the GPIO number used for I2S word select.

        config EXAMPLE_I2S_DO_IO
            int "I2S DO GPIO"
            default 4 if IDF_TARGET_ESP32S3
            default 18
            help
                Set the GPIO number used for I2S data out.

        config EXAMPLE_I2S_DI_IO
            int "I2S DI GPIO"
            default 5 if IDF_TARGET_ESP32S3
            default 19
            help
                Set the GPIO number used for I2S data in.

        config EXAMPLE_SAMPLE_RATE
            int "Audio Sample Rate"
            default 44100
            help
                Set the audio sample rate frequency. Usually 16000 or 44100 Hz.
    endmenu

endmenu
```

## examples/peripherals/i2s_test_final_last/sdkconfig.defaults
```kconfig
# ESP32-S3固有の設定
CONFIG_IDF_TARGET="esp32s3"
CONFIG_ESP32S3_DEFAULT_CPU_FREQ_240=y
CONFIG_ESP32S3_SPIRAM_SUPPORT=y

# WiFi設定
CONFIG_ESP_WIFI_SSID="YOUR_WIFI_SSID"
CONFIG_ESP_WIFI_PASSWORD="YOUR_WIFI_PASSWORD"
CONFIG_ESP_MAXIMUM_RETRY=5

# HTTPクライアント設定
CONFIG_ESP_HTTP_CLIENT_ENABLE_HTTPS=y
CONFIG_ESP_HTTP_CLIENT_ENABLE_BASIC_AUTH=y

# I2S設定
CONFIG_DRIVER_I2S_ENABLE=y

# SDカード設定
CONFIG_FATFS_LFN_HEAP=y
CONFIG_FATFS_MAX_LFN=255
CONFIG_FATFS_API_ENCODING_UTF_8=y

# JSON設定
CONFIG_CJSON_ENABLE=y

# バッファサイズ設定
CONFIG_ESP_HTTP_CLIENT_ENABLE_DIGEST_AUTH=y
CONFIG_HTTPD_MAX_REQ_HDR_LEN=1024
CONFIG_HTTP_BUF_SIZE=2048

# ログ設定
CONFIG_LOG_DEFAULT_LEVEL_INFO=y

# メモリ設定
CONFIG_ESP_SYSTEM_EVENT_QUEUE_SIZE=32
CONFIG_ESP_SYSTEM_EVENT_TASK_STACK_SIZE=4096
CONFIG_ESP_MAIN_TASK_STACK_SIZE=8192

# タスクウォッチドッグの設定
CONFIG_ESP_TASK_WDT=y
CONFIG_ESP_TASK_WDT_TIMEOUT_S=10

# FreeRTOS設定
CONFIG_FREERTOS_HZ=1000
```

## examples/peripherals/i3c/i3c_bmp581/main/Kconfig.projbuild
```kconfig
menu "Example Configuration"

    menu "I3C Master"
        config I3C_MASTER_SCL
            int "SCL GPIO Num"
            default 32 if IDF_TARGET_ESP32P4
            help
                GPIO number for I3C Master clock line.

        config I3C_MASTER_SDA
            int "SDA GPIO Num"
            default 33 if IDF_TARGET_ESP32P4
            help
                GPIO number for I3C Master data line.

        config I3C_DYNAMIC_ADDRESS_ASSIGN_BY_ENTDAA
            bool "assign i3c dynamic address by entdaa"
            default n
            help
                Select to assign i3c dynamic address by entdaa, otherwise use setdata

        config I3C_USE_IN_BAND_INTERRUPTS
            bool "Use i3c in-band interrupts to notify data availability instead of polling"
            default n
            help
                Select to use ibi for data readiness, otherwise use polling

    endmenu

endmenu
```

## examples/peripherals/i3c/i3c_i2c_basic/main/Kconfig.projbuild
```kconfig
menu "Example Configuration"

    menu "I3C Master"
        config I3C_MASTER_SCL
            int "SCL GPIO Num"
            default 4
            help
                GPIO number for I3C Master clock line.

        config I3C_MASTER_SDA
            int "SDA GPIO Num"
            default 5
            help
                GPIO number for I3C Master data line.

    endmenu

endmenu
```

## examples/peripherals/i3c/i3c_lsm6dscx/main/Kconfig.projbuild
```kconfig
menu "Example Configuration"

    menu "I3C Master"
        config I3C_MASTER_SCL
            int "SCL GPIO Num"
            default 32 if IDF_TARGET_ESP32P4
            help
                GPIO number for I3C Master clock line.

        config I3C_MASTER_SDA
            int "SDA GPIO Num"
            default 33 if IDF_TARGET_ESP32P4
            help
                GPIO number for I3C Master data line.

        config I3C_DYNAMIC_ADDRESS_ASSIGN_BY_ENTDAA
            bool "assign i3c dynamic address by entdaa"
            default n
            help
                Select to assign i3c dynamic address by entdaa, otherwise use setdata

    endmenu

endmenu
```

## examples/peripherals/isp/auto_focus/main/Kconfig.projbuild
```kconfig
menu "Example Configuration"
    config EXAMPLE_USED_LDO_CHAN_ID
        int "example used LDO channel ID"
        default 3
        help
            Example used LDO channel ID, you may check datasheet to know more details.

    config EXAMPLE_USED_LDO_VOLTAGE_MV
        int "example used LDO voltage in mV"
        default 2500
        range 0 3300
        help
            Example used LDO voltage, in mV

    choice EXAMPLE_MIPI_CSI_DISP_HRES
        bool "Set MIPI CSI horizontal resolution"
        default EXAMPLE_MIPI_CSI_HRES_800

        config EXAMPLE_MIPI_CSI_HRES_800
            bool "800"
    endchoice

    config EXAMPLE_MIPI_CSI_DISP_HRES
        int
        default 800 if EXAMPLE_MIPI_CSI_HRES_800

    choice EXAMPLE_MIPI_CSI_DISP_VRES
        bool "Set MIPI CSI vertical resolution"
        default EXAMPLE_MIPI_CSI_VRES_640

        config EXAMPLE_MIPI_CSI_VRES_640
            bool "640"
        config EXAMPLE_MIPI_CSI_VRES_1280
            bool "1280"
    endchoice

    config EXAMPLE_MIPI_CSI_DISP_VRES
        int
        default 640 if EXAMPLE_MIPI_CSI_VRES_640
        default 1280 if EXAMPLE_MIPI_CSI_VRES_1280
endmenu
```

## examples/peripherals/isp/multi_pipelines/main/Kconfig.projbuild
```kconfig
menu "Example Configuration"
    config EXAMPLE_USED_LDO_CHAN_ID
        int "example used LDO channel ID"
        default 3
        help
            Example used LDO channel ID, you may check datasheet to know more details.

    config EXAMPLE_USED_LDO_VOLTAGE_MV
        int "example used LDO voltage in mV"
        default 2500
        range 0 3300
        help
            Example used LDO voltage, in mV

    choice EXAMPLE_MIPI_CSI_DISP_HRES
        bool "Set MIPI CSI horizontal resolution"
        default EXAMPLE_MIPI_CSI_HRES_1024

        config EXAMPLE_MIPI_CSI_HRES_800
            bool "800"
        config EXAMPLE_MIPI_CSI_HRES_1024
            bool "1024"
    endchoice

    config EXAMPLE_MIPI_CSI_DISP_HRES
        int
        default 800 if EXAMPLE_MIPI_CSI_HRES_800
        default 1024 if EXAMPLE_MIPI_CSI_HRES_1024

    choice EXAMPLE_MIPI_CSI_DISP_VRES
        bool "Set MIPI CSI vertical resolution"
        default EXAMPLE_MIPI_CSI_VRES_600

        config EXAMPLE_MIPI_CSI_VRES_600
            bool "600"
        config EXAMPLE_MIPI_CSI_VRES_640
            bool "640"
        config EXAMPLE_MIPI_CSI_VRES_1280
            bool "1280"
    endchoice

    config EXAMPLE_MIPI_CSI_DISP_VRES
        int
        default 600 if EXAMPLE_MIPI_CSI_VRES_600
        default 640 if EXAMPLE_MIPI_CSI_VRES_640
        default 1280 if EXAMPLE_MIPI_CSI_VRES_1280

    config EXAMPLE_ISP_CROP_ENABLE
        depends on (ESP32P4_REV_MIN_FULL >= 300)
        bool "Enable ISP crop functionality"
        default n
        help
            Enable ISP crop functionality. When enabled, you can configure
            the crop area for the ISP pipeline.

    menu "ISP Crop Configuration"
        visible if EXAMPLE_ISP_CROP_ENABLE

        config EXAMPLE_ISP_CROP_TOP_LEFT_H
            int "ISP crop top-left horizontal coordinate"
            default 0
            range 0 799 if EXAMPLE_MIPI_CSI_HRES_800
            range 0 1023 if EXAMPLE_MIPI_CSI_HRES_1024
            help
                Horizontal coordinate of the top-left corner for ISP crop.
                Must be an even number and less than bottom-right horizontal coordinate.

        config EXAMPLE_ISP_CROP_TOP_LEFT_V
            int "ISP crop top-left vertical coordinate"
            default 0
            range 0 599 if EXAMPLE_MIPI_CSI_VRES_600
            range 0 639 if EXAMPLE_MIPI_CSI_VRES_640
            range 0 1279 if EXAMPLE_MIPI_CSI_VRES_1280
            help
                Vertical coordinate of the top-left corner for ISP crop.
                Must be an even number and less than bottom-right vertical coordinate.

        config EXAMPLE_ISP_CROP_BOTTOM_RIGHT_H
            int "ISP crop bottom-right horizontal coordinate"
            default 799 if EXAMPLE_MIPI_CSI_HRES_800
            default 1023 if EXAMPLE_MIPI_CSI_HRES_1024
            range 1 799 if EXAMPLE_MIPI_CSI_HRES_800
            range 1 1023 if EXAMPLE_MIPI_CSI_HRES_1024
            help
                Horizontal coordinate of the bottom-right corner for ISP crop.
                Must be an odd number, greater than top-left horizontal coordinate, and not exceed display width.

        config EXAMPLE_ISP_CROP_BOTTOM_RIGHT_V
            int "ISP crop bottom-right vertical coordinate"
            default 599 if EXAMPLE_MIPI_CSI_VRES_600
            default 639 if EXAMPLE_MIPI_CSI_VRES_640
            default 1279 if EXAMPLE_MIPI_CSI_VRES_1280
            range 1 599 if EXAMPLE_MIPI_CSI_VRES_600
            range 1 639 if EXAMPLE_MIPI_CSI_VRES_640
            range 1 1279 if EXAMPLE_MIPI_CSI_VRES_1280
            help
                Vertical coordinate of the bottom-right corner for ISP crop.
                Must be an odd number, greater than top-left vertical coordinate, and not exceed display height.
    endmenu
endmenu
```

## examples/peripherals/isp/multi_pipelines/sdkconfig.defaults
```kconfig
CONFIG_SPIRAM=y
CONFIG_IDF_EXPERIMENTAL_FEATURES=y
CONFIG_SPIRAM_SPEED_200M=y
CONFIG_CAMERA_SC2336=y
CONFIG_CAMERA_OV5647=y
CONFIG_CAMERA_OV5647_ENABLE_MOTOR_BY_GPIO0=y
CONFIG_CAM_CTRL_SPI_ENABLE=n
```

## examples/peripherals/jpeg/jpeg_encode/main/Kconfig.projbuild
```kconfig
menu "JPEG Encode Example menu"

    config EXAMPLE_FORMAT_IF_MOUNT_FAILED
        bool "Format the card if mount failed"
        default n
        help
            If this config item is set, format_if_mount_failed will be set to true and the card will be formatted if
            the mount has failed.

    config EXAMPLE_SDMMC_IO_POWER_INTERNAL_LDO
        depends on SOC_SDMMC_IO_POWER_EXTERNAL
        bool "SDMMC IO power supply comes from internal LDO (READ HELP!)"
        default y
        help
            Please read the schematic first and check if the SDMMC VDD is connected to any internal LDO output.
            If the SDMMC is powered by an external supplier, unselect me

endmenu
```

## examples/peripherals/jpeg/jpeg_encode/sdkconfig.defaults
```kconfig
CONFIG_SPIRAM=y
CONFIG_PARTITION_TABLE_CUSTOM=y
CONFIG_PARTITION_TABLE_CUSTOM_FILENAME="partitions.csv"
CONFIG_PARTITION_TABLE_FILENAME="partitions.csv"
CONFIG_ESPTOOLPY_FLASHSIZE_4MB=y
CONFIG_ESPTOOLPY_FLASHSIZE="4MB"
```

## examples/peripherals/lcd/i2c_oled/main/Kconfig.projbuild
```kconfig
menu "Example Configuration"

    choice EXAMPLE_LCD_CONTROLLER
        prompt "LCD controller model"
        default EXAMPLE_LCD_CONTROLLER_SSD1306
        help
            Select LCD controller model

        config EXAMPLE_LCD_CONTROLLER_SSD1306
            bool "SSD1306"

        config EXAMPLE_LCD_CONTROLLER_SH1107
            bool "SH1107"
    endchoice

    if EXAMPLE_LCD_CONTROLLER_SSD1306
        choice EXAMPLE_SSD1306_HEIGHT
            prompt "SSD1306 Height in pixels"
            default EXAMPLE_SSD1306_HEIGHT_64
            help
                Height of the display in pixels. a.k.a vertical resolution

            config EXAMPLE_SSD1306_HEIGHT_64
                bool "64"
            config EXAMPLE_SSD1306_HEIGHT_32
                bool "32"
        endchoice

        config EXAMPLE_SSD1306_HEIGHT
            int
            default 64 if EXAMPLE_SSD1306_HEIGHT_64
            default 32 if EXAMPLE_SSD1306_HEIGHT_32
    endif

endmenu
```

## examples/peripherals/lcd/i80_controller/sdkconfig.defaults.esp32s3
```kconfig
CONFIG_SPIRAM=y
CONFIG_SPIRAM_SPEED_80M=y

# Enabling the following configurations can help increase the PCLK frequency in the case when
# the Frame Buffer is allocated from the PSRAM and fetched by EDMA
CONFIG_SPIRAM_XIP_FROM_PSRAM=y


CONFIG_EXAMPLE_PIN_NUM_PCLK=2
CONFIG_EXAMPLE_PIN_NUM_CS=0
CONFIG_EXAMPLE_PIN_NUM_DC=19
CONFIG_EXAMPLE_PIN_NUM_RST=5
CONFIG_EXAMPLE_PIN_NUM_BK_LIGHT=18
CONFIG_EXAMPLE_PIN_NUM_DATA0=4
CONFIG_EXAMPLE_PIN_NUM_DATA1=7
CONFIG_EXAMPLE_PIN_NUM_DATA2=8
CONFIG_EXAMPLE_PIN_NUM_DATA3=9
CONFIG_EXAMPLE_PIN_NUM_DATA4=10
CONFIG_EXAMPLE_PIN_NUM_DATA5=11
CONFIG_EXAMPLE_PIN_NUM_DATA6=12
CONFIG_EXAMPLE_PIN_NUM_DATA7=13
```

## examples/peripherals/lcd/i80_controller/sdkconfig.defaults.esp32s31
```kconfig
CONFIG_SPIRAM=y
CONFIG_SPIRAM_SPEED_250M=y

# Enabling the following configurations can help increase the PCLK frequency in the case when
# the Frame Buffer is allocated from the PSRAM and fetched by EDMA
CONFIG_SPIRAM_XIP_FROM_PSRAM=y

CONFIG_EXAMPLE_PIN_NUM_BK_LIGHT=1
CONFIG_EXAMPLE_PIN_NUM_RST=56
CONFIG_EXAMPLE_PIN_NUM_CS=2
CONFIG_EXAMPLE_PIN_NUM_DC=54
CONFIG_EXAMPLE_PIN_NUM_PCLK=5
CONFIG_EXAMPLE_PIN_NUM_DATA0=11
CONFIG_EXAMPLE_PIN_NUM_DATA1=52
CONFIG_EXAMPLE_PIN_NUM_DATA2=8
CONFIG_EXAMPLE_PIN_NUM_DATA3=50
CONFIG_EXAMPLE_PIN_NUM_DATA4=6
CONFIG_EXAMPLE_PIN_NUM_DATA5=48
CONFIG_EXAMPLE_PIN_NUM_DATA6=13
CONFIG_EXAMPLE_PIN_NUM_DATA7=46
```

## examples/peripherals/lcd/lvgl/sdkconfig.defaults
```kconfig
CONFIG_LV_USE_PERF_MONITOR=y
CONFIG_LV_USE_USER_DATA=y
CONFIG_LV_COLOR_16_SWAP=y
```
