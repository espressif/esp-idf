## examples/peripherals/lcd/mipi_dsi/main/Kconfig.projbuild
```kconfig
menu "Example Configuration"
    config EXAMPLE_USE_DMA2D_COPY_FRAME
        bool "Use DMA2D to copy draw buffer to frame buffer"
        default y
        help
            Enable this option, DMA2D will be used to copy the LVGL draw buffer to the target frame buffer.
            This can save some CPU time and improve the performance.

    config EXAMPLE_MONITOR_REFRESH_BY_GPIO
        bool "Monitor Refresh Rate by GPIO"
        default y
        help
            Enable this option, you can visualize the refresh rate by attaching a logic analyzer to a specific GPIO.
            The GPIO will output a square wave with the frequency equals to half of the refresh rate.

    choice
        prompt "Select MIPI LCD model"
        default EXAMPLE_LCD_EK79007_SUPPORT
        help
            Select LCD controller model.

        config EXAMPLE_LCD_USE_EK79007
            bool "EK79007"
        config EXAMPLE_LCD_USE_ILI9881C
            bool "ILI9881C"
    endchoice
endmenu
```

## examples/peripherals/lcd/mipi_dsi/sdkconfig.defaults
```kconfig
CONFIG_LV_CONF_SKIP=y
CONFIG_LV_COLOR_DEPTH_24=y
CONFIG_LV_FONT_MONTSERRAT_16=y
CONFIG_LV_USE_OBSERVER=y
CONFIG_LV_USE_SYSMON=y
CONFIG_LV_USE_PERF_MONITOR=y
CONFIG_IDF_EXPERIMENTAL_FEATURES=y
```

## examples/peripherals/lcd/parlio_simulate/main/Kconfig.projbuild
```kconfig
menu "Example Configuration"

    config EXAMPLE_LCD_PARLIO_COLOR_IN_PSRAM
        bool "Allocate color data from PSRAM"
        depends on SOC_PSRAM_DMA_CAPABLE
        default n
        help
            Enable this option if you want to allocate the LVGL draw buffer from PSRAM.

    choice EXAMPLE_LCD_PARLIO_SIMULATE_INTERFACE
        prompt "LCD interface"
        default EXAMPLE_LCD_PARLIO_SIMULATE_I80 if SOC_PARLIO_SUPPORT_I80_LCD
        default EXAMPLE_LCD_PARLIO_SIMULATE_SPI
        help
            Select LCD controller model

        config EXAMPLE_LCD_PARLIO_SIMULATE_SPI
            bool "SPI"

        config EXAMPLE_LCD_PARLIO_SIMULATE_I80
            depends on SOC_PARLIO_SUPPORT_I80_LCD
            bool "I80"

    endchoice

    config EXAMPLE_LCD_PIXEL_CLOCK_HZ
        int "Pixel clock frequency (Hz)"
        default 10000000
        help
            Set the pixel clock frequency in Hz.

    config EXAMPLE_LCD_PARLIO_DATA_WIDTH
        int
        default 8 if EXAMPLE_LCD_PARLIO_SIMULATE_I80
        default 1

    menu "LCD GPIO Configuration"
        config EXAMPLE_PIN_NUM_PCLK
            int "PCLK Pin"
            default 5

        config EXAMPLE_PIN_NUM_CS
            int "CS Pin"
            default 3

        config EXAMPLE_PIN_NUM_DC
            int "DC Pin"
            default 4

        config EXAMPLE_PIN_NUM_RST
            int "RST Pin"
            default 2

        config EXAMPLE_PIN_NUM_BK_LIGHT
            int "Backlight Pin"
            default 1

        config EXAMPLE_PIN_NUM_DATA0
            int "Data Pin 0(MOSI)"
            default 6

        config EXAMPLE_PIN_NUM_DATA1
            int "Data Pin 1"
            depends on EXAMPLE_LCD_PARLIO_SIMULATE_I80
            default 25

        config EXAMPLE_PIN_NUM_DATA2
            int "Data Pin 2"
            depends on EXAMPLE_LCD_PARLIO_SIMULATE_I80
            default 26

        config EXAMPLE_PIN_NUM_DATA3
            int "Data Pin 3"
            depends on EXAMPLE_LCD_PARLIO_SIMULATE_I80
            default 27

        config EXAMPLE_PIN_NUM_DATA4
            int "Data Pin 4"
            depends on EXAMPLE_LCD_PARLIO_SIMULATE_I80
            default 28

        config EXAMPLE_PIN_NUM_DATA5
            int "Data Pin 5"
            depends on EXAMPLE_LCD_PARLIO_SIMULATE_I80
            default 29

        config EXAMPLE_PIN_NUM_DATA6
            int "Data Pin 6"
            depends on EXAMPLE_LCD_PARLIO_SIMULATE_I80
            default 30

        config EXAMPLE_PIN_NUM_DATA7
            int "Data Pin 7"
            depends on EXAMPLE_LCD_PARLIO_SIMULATE_I80
            default 31

    endmenu
endmenu
```
