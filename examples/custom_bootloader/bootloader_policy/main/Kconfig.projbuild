## examples/peripherals/lcd/i80_controller/sdkconfig.defaults.esp32
```kconfig
CONFIG_EXAMPLE_PIN_NUM_BK_LIGHT=2
CONFIG_EXAMPLE_PIN_NUM_RST=-1
CONFIG_EXAMPLE_PIN_NUM_CS=4
CONFIG_EXAMPLE_PIN_NUM_DC=5
CONFIG_EXAMPLE_PIN_NUM_PCLK=18
CONFIG_EXAMPLE_PIN_NUM_DATA0=19
CONFIG_EXAMPLE_PIN_NUM_DATA1=21
CONFIG_EXAMPLE_PIN_NUM_DATA2=0
CONFIG_EXAMPLE_PIN_NUM_DATA3=22
CONFIG_EXAMPLE_PIN_NUM_DATA4=23
CONFIG_EXAMPLE_PIN_NUM_DATA5=33
CONFIG_EXAMPLE_PIN_NUM_DATA6=32
CONFIG_EXAMPLE_PIN_NUM_DATA7=27
```

## examples/peripherals/lcd/i80_controller/sdkconfig.defaults.esp32s2
```kconfig
CONFIG_EXAMPLE_PIN_NUM_BK_LIGHT=0
CONFIG_EXAMPLE_PIN_NUM_RST=18
CONFIG_EXAMPLE_PIN_NUM_CS=19
CONFIG_EXAMPLE_PIN_NUM_DC=38
CONFIG_EXAMPLE_PIN_NUM_PCLK=33
CONFIG_EXAMPLE_PIN_NUM_DATA0=1
CONFIG_EXAMPLE_PIN_NUM_DATA1=10
CONFIG_EXAMPLE_PIN_NUM_DATA2=2
CONFIG_EXAMPLE_PIN_NUM_DATA3=11
CONFIG_EXAMPLE_PIN_NUM_DATA4=3
CONFIG_EXAMPLE_PIN_NUM_DATA5=12
CONFIG_EXAMPLE_PIN_NUM_DATA6=4
CONFIG_EXAMPLE_PIN_NUM_DATA7=13
```

## examples/peripherals/ledc/ledc_fade/main/Kconfig.projbuild
```kconfig
menu "Example Configuration"

    orsource "$IDF_PATH/examples/common_components/env_caps/$IDF_TARGET/Kconfig.env_caps"

    config LEDC_CH0_GPIO
        int "LEDC channel 0 GPIO number"
        range ENV_GPIO_RANGE_MIN ENV_GPIO_OUT_RANGE_MAX
        default 18 if IDF_TARGET_ESP32 || IDF_TARGET_ESP32H4
        default 8
        help
            GPIO pin number to be used as LEDC channel 0 output.

    config LEDC_CH1_GPIO
        int "LEDC channel 1 GPIO number"
        range ENV_GPIO_RANGE_MIN ENV_GPIO_OUT_RANGE_MAX
        default 19 if IDF_TARGET_ESP32 || IDF_TARGET_ESP32H4
        default 9
        help
            GPIO pin number to be used as LEDC channel 1 output.

    config LEDC_CH2_GPIO
        int "LEDC channel 2 GPIO number"
        range ENV_GPIO_RANGE_MIN ENV_GPIO_OUT_RANGE_MAX
        default 4 if IDF_TARGET_ESP32
        default 2
        help
            GPIO pin number to be used as LEDC channel 2 output.

    config LEDC_CH3_GPIO
        int "LEDC channel 3 GPIO number"
        range ENV_GPIO_RANGE_MIN ENV_GPIO_OUT_RANGE_MAX
        default 5 if IDF_TARGET_ESP32
        default 3
        help
            GPIO pin number to be used as LEDC channel 3 output.

endmenu
```

## examples/peripherals/mcpwm/mcpwm_foc_open_loop/main/Kconfig.projbuild
```kconfig
menu "Example Configuration"

    orsource "$IDF_PATH/examples/common_components/env_caps/$IDF_TARGET/Kconfig.env_caps"

    menu "Inverter Configuration"

        config EXAMPLE_INVERTER_MODULATION_FREQ_HZ
            int "Inverter modulation frequency (Hz)"
            range 1000 200000
            default 10000
            help
                Set the inverter modulation frequency.
                The FOC control loop runs once per inverter modulation cycle.
                This value must divide the MCPWM timer resolution evenly.

        config EXAMPLE_INVERTER_GATE_EN_GPIO
            int "Gate driver enable GPIO"
            range ENV_GPIO_RANGE_MIN ENV_GPIO_OUT_RANGE_MAX
            default 22

        config EXAMPLE_INVERTER_PWM_UH_GPIO
            int "U-phase high-side PWM GPIO"
            range ENV_GPIO_RANGE_MIN ENV_GPIO_OUT_RANGE_MAX
            default 33

        config EXAMPLE_INVERTER_PWM_UL_GPIO
            int "U-phase low-side PWM GPIO"
            range ENV_GPIO_RANGE_MIN ENV_GPIO_OUT_RANGE_MAX
            default 32

        config EXAMPLE_INVERTER_PWM_VH_GPIO
            int "V-phase high-side PWM GPIO"
            range ENV_GPIO_RANGE_MIN ENV_GPIO_OUT_RANGE_MAX
            default 23

        config EXAMPLE_INVERTER_PWM_VL_GPIO
            int "V-phase low-side PWM GPIO"
            range ENV_GPIO_RANGE_MIN ENV_GPIO_OUT_RANGE_MAX
            default 21

        config EXAMPLE_INVERTER_PWM_WH_GPIO
            int "W-phase high-side PWM GPIO"
            range ENV_GPIO_RANGE_MIN ENV_GPIO_OUT_RANGE_MAX
            default 20

        config EXAMPLE_INVERTER_PWM_WL_GPIO
            int "W-phase low-side PWM GPIO"
            range ENV_GPIO_RANGE_MIN ENV_GPIO_OUT_RANGE_MAX
            default 6

    endmenu

    menu "FOC Control Configuration"

        config EXAMPLE_FOC_OPENLOOP_ALIGN_DURATION_MS
            int "Rotor alignment duration (ms)"
            range 1 50000
            default 1000

        config EXAMPLE_FOC_OPENLOOP_TARGET_ELEC_FREQ_HZ
            int "Open-loop target electrical frequency (Hz)"
            range 1 500
            default 25

        config EXAMPLE_FOC_OPENLOOP_RAMP_UP_DIVISIONS
            int "Nominal open-loop ramp divisions"
            range 1 100000
            default 20000
            help
                Set the nominal number of divisions for the linear open-loop ramp.
                Actual number of control cycles required may exceed this value.

        config EXAMPLE_FOC_OPENLOOP_UD_REF_PERCENT
            int "Open-loop d-axis voltage reference (%)"
            range 0 100
            default 40
            help
                Set the normalized d-axis voltage reference as a percentage.
                100% corresponds to Udc / sqrt(3).

    endmenu

endmenu
```

## examples/peripherals/ppa/ppa_freetype/sdkconfig.defaults
```kconfig
CONFIG_SPIRAM=y

CONFIG_PARTITION_TABLE_CUSTOM=y
CONFIG_PARTITION_TABLE_CUSTOM_FILENAME="partitions.csv"

CONFIG_ESP_MAIN_TASK_STACK_SIZE=20000
CONFIG_FREERTOS_WATCHPOINT_END_OF_STACK=y
```

## examples/peripherals/sdio/hw_test/host/main/Kconfig.projbuild
```kconfig
menu "Example Configuration"

    orsource "$IDF_PATH/examples/common_components/env_caps/$IDF_TARGET/Kconfig.env_caps"

    config EXAMPLE_ADJUSTABLE_PIN
        bool
        default SOC_SDMMC_USE_GPIO_MATRIX

    config EXAMPLE_PIN_CMD
        int "CMD (MOSI) GPIO number"
        depends on EXAMPLE_ADJUSTABLE_PIN
        range ENV_GPIO_RANGE_MIN ENV_GPIO_OUT_RANGE_MAX
        default 4 if IDF_TARGET_ESP32P4
        default 15

    config EXAMPLE_PIN_CLK
        int "CLK GPIO number"
        depends on EXAMPLE_ADJUSTABLE_PIN
        range ENV_GPIO_RANGE_MIN ENV_GPIO_OUT_RANGE_MAX
        default 33 if IDF_TARGET_ESP32P4
        default 14

    config EXAMPLE_PIN_D0
        int "D0 (MISO) GPIO number"
        depends on EXAMPLE_ADJUSTABLE_PIN
        range ENV_GPIO_RANGE_MIN ENV_GPIO_OUT_RANGE_MAX
        default 32 if IDF_TARGET_ESP32P4
        default 2

    config EXAMPLE_PIN_D1
        int "D1 (INTR) GPIO number"
        depends on EXAMPLE_ADJUSTABLE_PIN
        range ENV_GPIO_RANGE_MIN ENV_GPIO_OUT_RANGE_MAX
        default 23 if IDF_TARGET_ESP32P4
        default 4

    config EXAMPLE_PIN_D2
        int "D2 GPIO number"
        depends on EXAMPLE_ADJUSTABLE_PIN
        range ENV_GPIO_RANGE_MIN ENV_GPIO_OUT_RANGE_MAX
        default 53 if IDF_TARGET_ESP32P4
        default 12

    config EXAMPLE_PIN_D3
        int "D3 (CS) GPIO number"
        depends on EXAMPLE_ADJUSTABLE_PIN
        range ENV_GPIO_RANGE_MIN ENV_GPIO_OUT_RANGE_MAX
        default 5 if IDF_TARGET_ESP32P4
        default 13

endmenu
```

## examples/peripherals/usb/device/tusb_msc/main/Kconfig.projbuild
```kconfig
menu "TinyUSB MSC Example Configuration"

    orsource "$IDF_PATH/examples/common_components/env_caps/$IDF_TARGET/Kconfig.env_caps"

    config EXAMPLE_STORAGE_MEDIA_SPIFLASH
        bool "SPI Flash LUN"
        default y
        help
            Expose an internal SPI Flash FAT partition as a USB MSC LUN.
            This should be used only for demo purposes. Sharing the same flash for
            both code and storage degrades performance

    config EXAMPLE_STORAGE_MEDIA_SDMMC
        bool "SDMMC Card LUN"
        depends on SOC_SDMMC_HOST_SUPPORTED
        default n
        help
            Expose an SD/MMC card as a USB MSC LUN.
            Enable together with SPI Flash LUN to present two LUNs to the USB host.

    if !EXAMPLE_STORAGE_MEDIA_SPIFLASH && !EXAMPLE_STORAGE_MEDIA_SDMMC
        comment "At least one storage media must be enabled"
    endif

    if EXAMPLE_STORAGE_MEDIA_SDMMC

        choice EXAMPLE_SDMMC_BUS_WIDTH
            prompt "SD/MMC bus width"
            default EXAMPLE_SDMMC_BUS_WIDTH_4
            help
                Select the bus width of SD or MMC interface.
                Note that even if 1 line mode is used, D3 pin of the SD card must
                have a pull-up resistor connected. Otherwise the card may enter
                SPI mode, the only way to recover from which is to cycle power to the card.

            config EXAMPLE_SDMMC_BUS_WIDTH_4
                bool "4 lines (D0 - D3)"

            config EXAMPLE_SDMMC_BUS_WIDTH_1
                bool "1 line (D0)"
        endchoice

        if SOC_SDMMC_USE_GPIO_MATRIX

            config EXAMPLE_PIN_CMD
                int "CMD GPIO number"
                range ENV_GPIO_RANGE_MIN ENV_GPIO_IN_RANGE_MAX
                default 35

            config EXAMPLE_PIN_CLK
                int "CLK GPIO number"
                range ENV_GPIO_RANGE_MIN ENV_GPIO_OUT_RANGE_MAX
                default 36

            config EXAMPLE_PIN_D0
                int "D0 GPIO number"
                range ENV_GPIO_RANGE_MIN ENV_GPIO_IN_RANGE_MAX
                default 37

            if EXAMPLE_SDMMC_BUS_WIDTH_4

                config EXAMPLE_PIN_D1
                    int "D1 GPIO number"
                    range ENV_GPIO_RANGE_MIN ENV_GPIO_IN_RANGE_MAX
                    default 38

                config EXAMPLE_PIN_D2
                    int "D2 GPIO number"
                    range ENV_GPIO_RANGE_MIN ENV_GPIO_IN_RANGE_MAX
                    default 33

                config EXAMPLE_PIN_D3
                    int "D3 GPIO number"
                    range ENV_GPIO_RANGE_MIN ENV_GPIO_IN_RANGE_MAX
                    default 34

            endif  # EXAMPLE_SDMMC_BUS_WIDTH_4

        endif  # SOC_SDMMC_USE_GPIO_MATRIX

        config EXAMPLE_SD_PWR_CTRL_LDO_INTERNAL_IO
            depends on SOC_SDMMC_IO_POWER_EXTERNAL || SOC_SDMMC_IO_UHS_POWER_EXTERNAL
            bool "SDMMC powered by internal LDO"
            help
                Enable when internal LDO of an ESP32 is used as a power supply for SD card. Specify the LDO IO.
                Disable when external power supply is used as a power supply for SD card.

        config EXAMPLE_SD_PWR_CTRL_LDO_IO_ID
            depends on SOC_SDMMC_IO_POWER_EXTERNAL || SOC_SDMMC_IO_UHS_POWER_EXTERNAL
            depends on EXAMPLE_SD_PWR_CTRL_LDO_INTERNAL_IO
            int "LDO IO"
            default 1
            help
                There are several IOs in ESP32 SD card capable targets which are in "SD card IO" power domain.
                Power has to be supplied to this power domain externally (from outside the chip) via one of the pins.
                Based on the schematic, specify the LDO IO pin.

    endif  # EXAMPLE_STORAGE_MEDIA_SDMMC

endmenu
```
