## examples/custom_bootloader/bootloader_policy/main/Kconfig.projbuild
```kconfig
menu "Bootloader policy example"

    config EXAMPLE_CONFIRM_IMAGE
        bool "confirm the image at startup"
        default n
        help
            When disabled, which is the default, the application never confirms itself, so
            every boot is an unconfirmed boot and the policy walks up to the attempt limit
            and then enters safe mode. That is the path the automated test asserts.

            Enable this to see the healthy path: the application records that it started
            successfully, which resets the attempt counter and clears safe mode.

endmenu
```

## examples/ethernet/sublayer/main/Kconfig.projbuild
```kconfig
menu "Example Configuration"

    config EXAMPLE_ETHERNET_VLAN_ID
        int "VLAN identifier"
        range 1 4094
        default 20
        help
            802.1Q VLAN ID for the tagged virtual interface created via the Ethernet sublayer.

    config EXAMPLE_VLAN_STATIC_IPV4_ADDR
        string "VLAN IPV4 Address"
        default "192.168.20.10"

    config EXAMPLE_VLAN_STATIC_ADDR_MASK
        string "VLAN Subnet Mask"
        default "255.255.255.0"

    config EXAMPLE_VLAN_STATIC_ADDR_DEF_GW
        string "VLAN IPV4 Default Gateway"
        default "192.168.20.1"

endmenu
```

## examples/ethernet/sublayer/sdkconfig.defaults
```kconfig
CONFIG_IDF_EXPERIMENTAL_FEATURES=y
CONFIG_ETH_SUBLAYER_SUPPORT=y
CONFIG_ETH_SUBLAYER_VLAN_SUPPORT=y
CONFIG_ETH_TRANSMIT_MUTEX=n
CONFIG_ETH_SUBLAYER_TRANSMIT_MUTEX=y
```

## examples/lowpower/power_management/main/Kconfig.esp32p4.supported_freq
```kconfig
# ESP32-P4 rev < 3.0 (eco2) CPLL DFS points: 360 / 180 / 90.

choice EXAMPLE_PM_MAX_FREQ_MHZ
    prompt "Max CPU frequency (MHz)"
    default EXAMPLE_PM_MAX_FREQ_MHZ_360
    config EXAMPLE_PM_MAX_FREQ_MHZ_10
        bool "10"
    config EXAMPLE_PM_MAX_FREQ_MHZ_20
        bool "20"
    config EXAMPLE_PM_MAX_FREQ_MHZ_40
        bool "40"
    config EXAMPLE_PM_MAX_FREQ_MHZ_90
        bool "90"
    config EXAMPLE_PM_MAX_FREQ_MHZ_180
        bool "180"
    config EXAMPLE_PM_MAX_FREQ_MHZ_360
        bool "360"
endchoice

config EXAMPLE_PM_MAX_FREQ
    int
    default 10 if EXAMPLE_PM_MAX_FREQ_MHZ_10
    default 20 if EXAMPLE_PM_MAX_FREQ_MHZ_20
    default 40 if EXAMPLE_PM_MAX_FREQ_MHZ_40
    default 90 if EXAMPLE_PM_MAX_FREQ_MHZ_90
    default 180 if EXAMPLE_PM_MAX_FREQ_MHZ_180
    default 360 if EXAMPLE_PM_MAX_FREQ_MHZ_360

choice EXAMPLE_PM_MIN_FREQ_MHZ
    prompt "Min CPU frequency (MHz)"
    default EXAMPLE_PM_MIN_FREQ_MHZ_40
    config EXAMPLE_PM_MIN_FREQ_MHZ_10
        bool "10"
    config EXAMPLE_PM_MIN_FREQ_MHZ_20
        bool "20"
    config EXAMPLE_PM_MIN_FREQ_MHZ_40
        bool "40"
    config EXAMPLE_PM_MIN_FREQ_MHZ_90
        bool "90"
    config EXAMPLE_PM_MIN_FREQ_MHZ_180
        bool "180"
    config EXAMPLE_PM_MIN_FREQ_MHZ_360
        bool "360"
endchoice

config EXAMPLE_PM_MIN_FREQ
    int
    default 10 if EXAMPLE_PM_MIN_FREQ_MHZ_10
    default 20 if EXAMPLE_PM_MIN_FREQ_MHZ_20
    default 40 if EXAMPLE_PM_MIN_FREQ_MHZ_40
    default 90 if EXAMPLE_PM_MIN_FREQ_MHZ_90
    default 180 if EXAMPLE_PM_MIN_FREQ_MHZ_180
    default 360 if EXAMPLE_PM_MIN_FREQ_MHZ_360
```

## examples/openthread/ot_zb_multipan/sdkconfig.defaults
```kconfig
#
# Partition Table
#
CONFIG_PARTITION_TABLE_CUSTOM=y
CONFIG_PARTITION_TABLE_CUSTOM_FILENAME="partitions.csv"
CONFIG_PARTITION_TABLE_FILENAME="partitions.csv"
CONFIG_PARTITION_TABLE_MD5=y
# end of Partition Table

#
# mbedTLS
#
CONFIG_MBEDTLS_SSL_PROTO_DTLS=y
CONFIG_MBEDTLS_KEY_EXCHANGE_ECJPAKE=y
CONFIG_MBEDTLS_ECJPAKE_C=y
# end of mbedTLS

#
# OpenThread
#
CONFIG_OPENTHREAD_ENABLED=y
CONFIG_OPENTHREAD_BORDER_ROUTER=y
CONFIG_OPENTHREAD_RADIO_SPINEL_UART=y
CONFIG_OPENTHREAD_SPINEL_ONLY=y
CONFIG_OPENTHREAD_MULTIPAN_HOST_ENABLE=y
CONFIG_OPENTHREAD_MULTIPLE_INTERFACES_COUNT=2
CONFIG_OPENTHREAD_TASK_SIZE=10240
CONFIG_OPENTHREAD_CONSOLE_ENABLE=n
# end of OpenThread

#
# Zigbee
#
CONFIG_ZB_ENABLED=y
CONFIG_ZB_ZCZR=y
CONFIG_ZB_RADIO_SPINEL_UART=y
# end of Zigbee

#
# lwIP
#
CONFIG_LWIP_IPV6_NUM_ADDRESSES=12
CONFIG_LWIP_MULTICAST_PING=y
CONFIG_LWIP_NETIF_STATUS_CALLBACK=y
CONFIG_LWIP_HOOK_IP6_ROUTE_DEFAULT=y
CONFIG_LWIP_HOOK_ND6_GET_GW_DEFAULT=y
CONFIG_LWIP_HOOK_IP6_INPUT_CUSTOM=y
CONFIG_LWIP_HOOK_IP6_SELECT_SRC_ADDR_CUSTOM=y
CONFIG_LWIP_IPV6_AUTOCONFIG=y
# end of lwIP

#
# mDNS
#
CONFIG_MDNS_MULTIPLE_INSTANCE=y
# end of mDNS

# Example connect
CONFIG_EXAMPLE_CONNECT_WIFI=y
CONFIG_EXAMPLE_CONNECT_THREAD=n

#
# ESP System Settings
#
CONFIG_ESP_MAIN_TASK_STACK_SIZE=6144
CONFIG_ESP_SYSTEM_EVENT_TASK_STACK_SIZE=4096
# end of ESP System Settings

#
# Serial flasher config
#
CONFIG_ESPTOOLPY_FLASHSIZE_4MB=y
```

## examples/peripherals/dac/dac_continuous/dac_audio/main/Kconfig.projbuild
```kconfig
menu "Example Configuration"

    choice EXAMPLE_DAC_WRITE_MODE
        prompt "Select DAC writing mode"
        default EXAMPLE_DAC_WRITE_SYNC
        help
            DAC writes data synchronously or asynchronously

        config EXAMPLE_DAC_WRITE_SYNC
            bool "Synchronous transmitting"
        config EXAMPLE_DAC_WRITE_ASYNC
            bool "Asynchronous transmitting"
    endchoice

    config EXAMPLE_AUDIO_WAV_FILE
        string "WAV file name"
        default "hi_idf_audio.wav"
        help
            WAV file under the example tools/ directory. It is converted to a DAC
            code table at build time.

    choice EXAMPLE_DAC_AUDIO_BITWIDTH_SEL
        prompt "DAC audio table bit width"
        default EXAMPLE_DAC_AUDIO_BITWIDTH_8 if IDF_TARGET_ESP32 || IDF_TARGET_ESP32S2
        default EXAMPLE_DAC_AUDIO_BITWIDTH_12 if IDF_TARGET_ESP32S31
        help
            Bit width of the generated DAC codes. Must match the DAC channel configuration.

        config EXAMPLE_DAC_AUDIO_BITWIDTH_8
            bool "8 bits"
            depends on IDF_TARGET_ESP32 || IDF_TARGET_ESP32S2
        config EXAMPLE_DAC_AUDIO_BITWIDTH_10
            bool "10 bits"
            depends on IDF_TARGET_ESP32S31
        config EXAMPLE_DAC_AUDIO_BITWIDTH_12
            bool "12 bits"
            depends on IDF_TARGET_ESP32S31
    endchoice

    config EXAMPLE_DAC_AUDIO_BITWIDTH
        int
        default 8 if EXAMPLE_DAC_AUDIO_BITWIDTH_8
        default 10 if EXAMPLE_DAC_AUDIO_BITWIDTH_10
        default 12 if EXAMPLE_DAC_AUDIO_BITWIDTH_12

endmenu
```

## examples/peripherals/h264/sdkconfig.defaults.esp32s31
```kconfig
# SPIRAM configurations for ESP32S31
CONFIG_SPIRAM=y
CONFIG_SPIRAM_MODE_OCT=y
CONFIG_SPIRAM_SPEED_250M=y

# CPU configuration
CONFIG_ESP_DEFAULT_CPU_FREQ_MHZ_320=y
```

## examples/peripherals/i2s/mic_recorder/main/Kconfig.projbuild
```kconfig
menu "Example Configuration"

    choice EXAMPLE_MIC_TYPE
        prompt "Microphone type"
        default EXAMPLE_MIC_TYPE_DMIC if SOC_I2S_SUPPORTS_PDM2PCM
        default EXAMPLE_MIC_TYPE_AMIC
        help
            Select the microphone type connected to the board. The example configures the
            I2S peripheral accordingly:

            - Digital microphone (PDM): the I2S PDM RX mode samples two PDM MEMS
              microphones and performs the PDM-to-PCM conversion in hardware.
              Only available on chips that support hardware PDM-to-PCM conversion.
            - Analog microphone (ES8389 codec): the ES8389 ADC samples the analog
              microphone signal, then I2S STD mode receives the codec's PCM stream.

        config EXAMPLE_MIC_TYPE_DMIC
            bool "Digital microphone (PDM)"
            depends on SOC_I2S_SUPPORTS_PDM2PCM

        config EXAMPLE_MIC_TYPE_AMIC
            bool "Analog microphone (ES8389 codec)"
            # defined by the esp_codec_dev component
            select CODEC_ES8389_SUPPORT
    endchoice

    config EXAMPLE_STARTUP_DISCARD_MS
        int "Startup data to discard (ms)"
        default 20
        range 0 500
        help
            Number of milliseconds of PCM to read and discard after the
            microphone path is running, before the recording is stored.
            Use this to skip the microphone or codec startup transient.
            The default is 20 ms. Set to 0 to keep every sample.
            Refer to the microphone datasheet for the startup delay
            (also called turn-on time).

    menu "PDM MIC Configuration"
        depends on EXAMPLE_MIC_TYPE_DMIC

        config EXAMPLE_PDM_CLK_GPIO
            int "PDM Clock GPIO"
            default 4
            help
                Set the GPIO number used for the PDM clock line driven by I2S.

        config EXAMPLE_PDM_DATA_GPIO
            int "PDM Data GPIO"
            default 5
            help
                Set the GPIO number used for receiving PDM data from the microphone.
                The left and right PDM microphones share this data pin:
                connect the left microphone's select pin to GND
                and the right microphone's select pin to VDD.
    endmenu

    menu "ES8389 Codec Configuration (Analog Microphone)"
        depends on EXAMPLE_MIC_TYPE_AMIC

        config EXAMPLE_I2C_SDA_IO
            int "I2C SDA GPIO"
            default 0
            help
                Set the GPIO number used for the I2C SDA signal towards the ES8389 codec.

        config EXAMPLE_I2C_SCL_IO
            int "I2C SCL GPIO"
            default 1
            help
                Set the GPIO number used for the I2C SCL signal towards the ES8389 codec.

        config EXAMPLE_I2S_MCLK_IO
            int "I2S MCLK GPIO (set -1 if the codec does not use an external MCLK)"
            default 2
            help
                Set the GPIO number used for the I2S MCLK signal. When set to -1, no MCLK
                is generated and the ES8389 derives its clock from BCLK.

        config EXAMPLE_I2S_BCLK_IO
            int "I2S BCLK GPIO"
            default 3
            help
                Set the GPIO number used for the I2S BCLK signal towards the ES8389 codec.

        config EXAMPLE_I2S_WS_IO
            int "I2S WS/LRCK GPIO"
            default 4
            help
                Set the GPIO number used for the I2S WS (LRCK) signal towards the ES8389 codec.

        config EXAMPLE_I2S_DIN_IO
            int "I2S DIN GPIO"
            default 6
            help
                Set the GPIO number used for receiving the ADC data from the ES8389 codec.

        config EXAMPLE_MIC_GAIN
            int "Mic gain (dB)"
            default 27
            range 0 36
            help
                Set the ES8389 analog microphone input gain in dB.
    endmenu

endmenu
```

## examples/peripherals/i2s/wav_player/main/Kconfig.projbuild
```kconfig
menu "Example Configuration"

    choice EXAMPLE_DAC_TYPE
        prompt "DAC / codec type"
        default EXAMPLE_DAC_TYPE_ES8311
        help
            Select the DAC codec connected to the board. Both options use I2S STD TX
            to send PCM and I2C to configure the codec:

            - ES8311: low-power mono ADC/DAC codec used on boards such as ESP-BOX
              and ESP32-S3-Korvo-2.
            - ES8389: stereo ADC/DAC codec used on boards such as ESP32-S31-Korvo-1.

        config EXAMPLE_DAC_TYPE_ES8311
            bool "ES8311 codec"
            select CODEC_ES8311_SUPPORT

        config EXAMPLE_DAC_TYPE_ES8389
            bool "ES8389 codec"
            select CODEC_ES8389_SUPPORT
    endchoice

    menu "Example IO Configuration"
        config EXAMPLE_PA_CTRL_IO
            int "Power amplifier enable IO"
            default -1
            help
                GPIO connected to the board's speaker-amplifier enable
                (often labeled EN, CTRL, PA, or INT). This is not a pin
                on the ES8311 or ES8389. The codec driver raises it when
                the DAC starts. Set -1 if the board has no amplifier
                enable, or if that pin is already strapped high.

        config EXAMPLE_I2C_SDA_IO
            int "I2C SDA IO"
            default 0
            help
                Set the GPIO number used for the I2C SDA signal towards the codec.

        config EXAMPLE_I2C_SCL_IO
            int "I2C SCL IO"
            default 1
            help
                Set the GPIO number used for the I2C SCL signal towards the codec.

        config EXAMPLE_I2S_MCLK_IO
            int "I2S MCLK IO (set -1 if the codec does not use an external MCLK)"
            default -1
            help
                Set the GPIO number used for the I2S MCLK signal. When set to -1, no MCLK
                is generated and the codec derives its clock from BCLK.

        config EXAMPLE_I2S_BCLK_IO
            int "I2S BCLK IO"
            default 3
            help
                Set the GPIO number used for the I2S BCLK signal towards the codec.

        config EXAMPLE_I2S_WS_IO
            int "I2S WS/LRCK IO"
            default 4
            help
                Set the GPIO number used for the I2S WS/LRCK signal towards the codec.

        config EXAMPLE_I2S_DOUT_IO
            int "I2S DOUT IO"
            default 5
            help
                Set the GPIO number used for sending PCM data to the codec.
    endmenu

    config EXAMPLE_VOICE_VOLUME
        int "Voice volume"
        range 0 100
        default 60
        help
            Set the codec output volume.

endmenu
```

## examples/peripherals/i2s/wav_player/sdkconfig.defaults.esp32
```kconfig
CONFIG_EXAMPLE_I2C_SDA_IO=21
CONFIG_EXAMPLE_I2C_SCL_IO=22
CONFIG_EXAMPLE_I2S_BCLK_IO=4
CONFIG_EXAMPLE_I2S_WS_IO=5
CONFIG_EXAMPLE_I2S_DOUT_IO=18
```

## examples/peripherals/i2s/wav_player/sdkconfig.defaults.esp32s31
```kconfig
CONFIG_EXAMPLE_I2C_SDA_IO=0
CONFIG_EXAMPLE_I2C_SCL_IO=1
CONFIG_EXAMPLE_I2S_BCLK_IO=3
CONFIG_EXAMPLE_I2S_WS_IO=4
CONFIG_EXAMPLE_I2S_DOUT_IO=5
CONFIG_EXAMPLE_PA_CTRL_IO=7
```

## examples/peripherals/lcd/i80_controller/main/Kconfig.projbuild
```kconfig
menu "Example Configuration"

    config EXAMPLE_LCD_I80_COLOR_IN_PSRAM
        bool "Allocate color data from PSRAM"
        depends on SOC_PSRAM_DMA_CAPABLE
        default n
        help
            Enable this option if you want to allocate the LVGL draw buffer from PSRAM.

    config EXAMPLE_LCD_PIXEL_CLOCK_HZ
        int "Pixel clock frequency (Hz)"
        default 2000000 if EXAMPLE_LCD_I80_COLOR_IN_PSRAM && IDF_TARGET_ESP32S3
        default 10000000
        help
            Set the pixel clock frequency in Hz.

    menu "LCD GPIO Configuration"
        config EXAMPLE_PIN_NUM_PCLK
            int "PCLK Pin"
            default 5

        config EXAMPLE_PIN_NUM_CS
            int "CS Pin"
            default 3

        config EXAMPLE_PIN_NUM_DC
            int "DC Pin"
            default 4

        config EXAMPLE_PIN_NUM_RST
            int "RST Pin"
            default 2

        config EXAMPLE_PIN_NUM_BK_LIGHT
            int "Backlight Pin"
            default 1

        config EXAMPLE_PIN_NUM_DATA0
            int "Data Pin 0"
            default 6

        config EXAMPLE_PIN_NUM_DATA1
            int "Data Pin 1"
            default 7

        config EXAMPLE_PIN_NUM_DATA2
            int "Data Pin 2"
            default 8

        config EXAMPLE_PIN_NUM_DATA3
            int "Data Pin 3"
            default 9

        config EXAMPLE_PIN_NUM_DATA4
            int "Data Pin 4"
            default 10

        config EXAMPLE_PIN_NUM_DATA5
            int "Data Pin 5"
            default 11

        config EXAMPLE_PIN_NUM_DATA6
            int "Data Pin 6"
            default 12

        config EXAMPLE_PIN_NUM_DATA7
            int "Data Pin 7"
            default 13
    endmenu

endmenu
```
