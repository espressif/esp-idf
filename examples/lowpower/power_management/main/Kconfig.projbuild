## examples/lowpower/power_management/main/Kconfig.projbuild
```kconfig
# PM frequency options: one file per target (see test_freqs[] in
# components/esp_pm/test_apps/esp_pm/main/test_pm.c)

menu "Example Configuration"

    orsource "Kconfig.$IDF_TARGET.supported_freq"

    config EXAMPLE_PM_LIGHT_SLEEP_ENABLE
        bool "Enable automatic light sleep when idle"
        default y if FREERTOS_USE_TICKLESS_IDLE
        default n
        help
            When enabled (and tickless idle is enabled), the chip may enter light
            sleep when no PM lock prevents it. Effective only if Component config
            -> FreeRTOS -> Tickless idle support is enabled.

endmenu
```

## examples/lowpower/power_management/sdkconfig.defaults
```kconfig
# Enable power management (required for esp_pm component)
CONFIG_PM_ENABLE=y
CONFIG_PM_PROFILING=y
CONFIG_FREERTOS_HZ=1000

# Enable tickless idle so that automatic light sleep can be used when light_sleep_enable is true
CONFIG_FREERTOS_USE_TICKLESS_IDLE=y
```

## examples/lowpower/vbat/main/Kconfig.projbuild
```kconfig
menu "Example Configuration"
    choice EXAMPLE_STATE_WHILE_WAITING_BATTERY_CHARGE_DONE
        bool "Configure the chip state while waiting for battery charging"
        default EXAMPLE_WAITING_BATTERY_CHARGING_IN_ACTIVE
        depends on ESP_VBAT_USE_RECHARGEABLE_BATTERY
        help
            Select chip state when waiting battery charging done

        config EXAMPLE_WAITING_BATTERY_CHARGING_IN_ACTIVE
            bool "Waiting for battery charging in active state"
        config EXAMPLE_WAITING_BATTERY_CHARGING_IN_LIGHT_SLEEP
            bool "Waiting for battery charging in light sleep state"
            select PM_ENABLE
            select FREERTOS_USE_TICKLESS_IDLE
        config EXAMPLE_WAITING_BATTERY_CHARGING_IN_DEEP_SLEEP
            bool "Waiting for battery charging in deep sleep state"
    endchoice

    config EXAMPLE_VBAT_CHARGING_DONE_CHECK_PERIOD
        int "Battery charging done check period (in seconds)"
        default 60
        depends on ESP_VBAT_USE_RECHARGEABLE_BATTERY
        help
            Period in seconds to check whether the battery has been charged done

endmenu
```
