## examples/mesh/internal_communication/main/Kconfig.projbuild
```kconfig
menu "Example Configuration"

    choice
        bool "Mesh Topology"
        default MESH_TOPO_TREE
        help
            Mesh Network Topology.

        config MESH_TOPO_TREE
            bool "MESH_TOPO_TREE"
        config MESH_TOPO_CHAIN
            bool "MESH_TOPO_CHAIN"
    endchoice

    config MESH_TOPOLOGY
        int
        default 0 if MESH_TOPO_TREE
        default 1 if MESH_TOPO_CHAIN
        help
            Mesh Network Topology.

    config MESH_ENABLE_PS
        bool "Enable mesh PS (power save) function"
        default y
        help
            Enable/Disable Power Save function.

    choice
        bool "Mesh PS device duty cycle type"
        depends on MESH_ENABLE_PS
        default MESH_PS_DEV_DUTY_TYPE_REQUEST
        help
            Mesh PS device duty cycle type.

        config MESH_PS_DEV_DUTY_TYPE_REQUEST
            bool "MESH_PS_DEV_DUTY_TYPE_REQUEST"
        config MESH_PS_DEV_DUTY_TYPE_DEMAND
            bool "MESH_PS_DEV_DUTY_TYPE_DEMAND"
    endchoice

    config MESH_PS_DEV_DUTY_TYPE
        int
        depends on MESH_ENABLE_PS
        default 1 if MESH_PS_DEV_DUTY_TYPE_REQUEST
        default 4 if MESH_PS_DEV_DUTY_TYPE_DEMAND
        help
            Mesh PS device duty cycle type.

    config MESH_PS_DEV_DUTY
        int "Mesh PS device duty cycle"
        depends on MESH_ENABLE_PS
        range 1 100
        default 10
        help
            Mesh PS device duty cycle.

    config MESH_PS_NWK_DUTY
        int "Mesh PS network duty cycle"
        depends on MESH_ENABLE_PS
        range 1 100
        default 10
        help
            Mesh PS network duty cycle.

    config MESH_PS_NWK_DUTY_DURATION
        int "Mesh PS network duty cycle duration (unit: minutes)"
        depends on MESH_ENABLE_PS
        range -1 100
        default -1
        help
            Mesh PS network duty cycle duration.

    choice
        bool "Mesh PS network duty cycle rule"
        depends on MESH_ENABLE_PS
        default MESH_PS_NETWORK_DUTY_APPLIED_ENTIRE
        help
            Mesh PS network duty cycle rule.

        config MESH_PS_NETWORK_DUTY_APPLIED_ENTIRE
            bool "MESH_PS_NETWORK_DUTY_APPLIED_ENTIRE"
        config MESH_PS_NETWORK_DUTY_APPLIED_UPLINK
            bool "MESH_PS_NETWORK_DUTY_APPLIED_UPLINK"
    endchoice

    config MESH_PS_NWK_DUTY_RULE
        int
        depends on MESH_ENABLE_PS
        default 0 if MESH_PS_NETWORK_DUTY_APPLIED_ENTIRE
        default 1 if MESH_PS_NETWORK_DUTY_APPLIED_UPLINK
        help
            Mesh PS network duty cycle rule.

    config MESH_MAX_LAYER
        int "Mesh Max Layer"
        range 1 25 if MESH_TOPO_TREE
        range 1 1000 if MESH_TOPO_CHAIN
        default 6
        help
            Max layer allowed in mesh network.

    config MESH_CHANNEL
        int "channel"
        range 0 14
        default 0
        help
            mesh network channel.

    config MESH_ROUTER_SSID
        string "Router SSID"
        default "ROUTER_SSID"
        help
            Router SSID.

    config MESH_ROUTER_PASSWD
        string "Router password"
        default "ROUTER_PASSWD"
        help
            Router password.

    choice
        bool "Mesh AP Authentication Mode"
        default WIFI_AUTH_WPA2_PSK
        help
            Authentication mode.

        config WIFI_AUTH_OPEN
            bool "WIFI_AUTH_OPEN"
        config WIFI_AUTH_WPA_PSK
            bool "WIFI_AUTH_WPA_PSK"
        config WIFI_AUTH_WPA2_PSK
            bool "WIFI_AUTH_WPA2_PSK"
        config WIFI_AUTH_WPA_WPA2_PSK
            bool "WIFI_AUTH_WPA_WPA2_PSK"
    endchoice

    config MESH_AP_AUTHMODE
        int
        default 0 if WIFI_AUTH_OPEN
        default 2 if WIFI_AUTH_WPA_PSK
        default 3 if WIFI_AUTH_WPA2_PSK
        default 4 if WIFI_AUTH_WPA_WPA2_PSK
        help
            Mesh AP authentication mode.

    config MESH_AP_PASSWD
        string "Mesh AP Password"
        default "MAP_PASSWD"
        help
            Mesh AP password.

    config MESH_AP_CONNECTIONS
        int "Mesh AP Connections"
        range 1 10
        default 6
        help
            The number of mesh stations allowed to connect in.

    config MESH_NON_MESH_AP_CONNECTIONS
        int "Mesh Non Mesh AP Connections"
        range 0 9
        default 0
        help
            The number of non-mesh stations allowed to connect in.

    config MESH_ROUTE_TABLE_SIZE
        int "Mesh Routing Table Size"
        range 1 300
        default 50
        help
            The number of devices over the network(max: 300).
endmenu
```

## examples/mesh/ip_internal_network/main/Kconfig.projbuild
```kconfig
menu "Example Configuration"

    config MESH_CHANNEL
        int "channel"
        range 0 14
        default 0
        help
            mesh network channel.

    config MESH_ROUTER_SSID
        string "Router SSID"
        default "ROUTER_SSID"
        help
            Router SSID.

    config MESH_ROUTER_PASSWD
        string "Router password"
        default "ROUTER_PASSWD"
        help
            Router password.

    choice
        bool "Mesh AP Authentication Mode"
        default WIFI_AUTH_WPA2_PSK
        help
            Authentication mode.

        config WIFI_AUTH_OPEN
            bool "WIFI_AUTH_OPEN"
        config WIFI_AUTH_WPA_PSK
            bool "WIFI_AUTH_WPA_PSK"
        config WIFI_AUTH_WPA2_PSK
            bool "WIFI_AUTH_WPA2_PSK"
        config WIFI_AUTH_WPA_WPA2_PSK
            bool "WIFI_AUTH_WPA_WPA2_PSK"
    endchoice

    config MESH_AP_AUTHMODE
        int
        default 0 if WIFI_AUTH_OPEN
        default 2 if WIFI_AUTH_WPA_PSK
        default 3 if WIFI_AUTH_WPA2_PSK
        default 4 if WIFI_AUTH_WPA_WPA2_PSK
        help
            Mesh AP authentication mode.

    config MESH_AP_PASSWD
        string "Mesh AP Password"
        default "MAP_PASSWD"
        help
            Mesh AP password.

    config MESH_AP_CONNECTIONS
        int "Mesh AP Connections"
        range 1 10
        default 6
        help
            The number of mesh stations allowed to connect in.

    config MESH_NON_MESH_AP_CONNECTIONS
        int "Mesh Non Mesh AP Connections"
        range 0 9
        default 0
        help
            The number of non-mesh stations allowed to connect in.

    config MESH_MAX_LAYER
        int "Mesh Max Layer"
        range 1 25
        default 6
        help
            Max layer allowed in mesh network.

    config MESH_ROUTE_TABLE_SIZE
        int "Mesh Routing Table Size"
        range 1 300
        default 50
        help
            The number of devices over the network(max: 300).

    config MESH_USE_GLOBAL_DNS_IP
        bool "Use global DNS IP"
        default n
        help
            Use fixed DNS server IP address. If enabled, root node
            advertises the specified DNS address in DHCP packets.
            By default it uses DNS record received from the router.

    config MESH_GLOBAL_DNS_IP
        hex "Global DNS"
        depends on MESH_USE_GLOBAL_DNS_IP
        default 0x08080808
        help
            The IP address of global DNS server that is used
            for internal IP subnet formed by the mesh network
            if MESH_USE_GLOBAL_DNS_IP is enabled.
            Note: The IP address is in platform (not network)
            format.

endmenu
```

## examples/mesh/ip_internal_network/sdkconfig.defaults
```kconfig
CONFIG_LWIP_L2_TO_L3_COPY=y
CONFIG_LWIP_IP_FORWARD=y
CONFIG_LWIP_IPV4_NAPT=y
CONFIG_LWIP_TCP_MSS=624
CONFIG_LWIP_TCP_OVERSIZE_MSS=y
```

## examples/mesh/manual_networking/main/Kconfig.projbuild
```kconfig
menu "Example Configuration"

    choice
        bool "Device type"
        default MESH_SET_ROOT
        help
            Device type (root or node).

        config MESH_SET_ROOT
            bool "MESH_SET_ROOT"
        config MESH_SET_NODE
            bool "MESH_SET_NODE"
    endchoice

    config MESH_CHANNEL
        int "channel"
        range 1 14
        default 1
        help
            mesh network channel.

    config MESH_ROUTER_SSID
        string "Router SSID"
        default "ROUTER_SSID"
        help
            Router SSID.

    config MESH_ROUTER_PASSWD
        string "Router password"
        default "ROUTER_PASSWD"
        help
            Router password.

    choice
        bool "Mesh AP Authentication Mode"
        default WIFI_AUTH_WPA2_PSK
        help
            Authentication mode.

        config WIFI_AUTH_OPEN
            bool "WIFI_AUTH_OPEN"
        config WIFI_AUTH_WPA_PSK
            bool "WIFI_AUTH_WPA_PSK"
        config WIFI_AUTH_WPA2_PSK
            bool "WIFI_AUTH_WPA2_PSK"
        config WIFI_AUTH_WPA_WPA2_PSK
            bool "WIFI_AUTH_WPA_WPA2_PSK"
    endchoice

    config MESH_AP_AUTHMODE
        int
        default 0 if WIFI_AUTH_OPEN
        default 2 if WIFI_AUTH_WPA_PSK
        default 3 if WIFI_AUTH_WPA2_PSK
        default 4 if WIFI_AUTH_WPA_WPA2_PSK
        help
            Mesh AP authentication mode.

    config MESH_AP_PASSWD
        string "Mesh AP Password"
        default "MAP_PASSWD"
        help
            Mesh AP password.

    config MESH_AP_CONNECTIONS
        int "Mesh AP Connections"
        range 1 10
        default 6
        help
            The number of mesh stations allowed to connect in.

    config MESH_NON_MESH_AP_CONNECTIONS
        int "Mesh Non Mesh AP Connections"
        range 0 9
        default 0
        help
            The number of non-mesh stations allowed to connect in.

    config MESH_MAX_LAYER
        int "Mesh Max Layer"
        range 1 25
        default 6
        help
            Max layer allowed in mesh network.

    config MESH_IE_CRYPTO_KEY
        string "Mesh IE Crypto Key"
        default "hello, esp-mesh."
        help
            Mesh IE ASCII crypto key, length in bytes, range:8~64.

    choice
        bool "Mesh IE Crypto Funcs"
        default IE_CRYPTO_ENABLE
        help
            Mesh IE crypto funcs.

        config IE_CRYPTO_ENABLE
            bool "IE_CRYPTO_ENABLE"
        config IE_CRYPTO_DISABLE
            bool "IE_CRYPTO_DISABLE"
    endchoice

    config MESH_IE_CRYPTO_FUNCS
        int
        default 1 if IE_CRYPTO_ENABLE
        default 0 if IE_CRYPTO_DISABLE
        help
             Mesh IE crypto enable/disable.

endmenu
```

## examples/mesh/manual_networking/sdkconfig.defaults
```kconfig
CONFIG_PARTITION_TABLE_CUSTOM=y
CONFIG_PARTITION_TABLE_CUSTOM_FILENAME="partitions.csv"
CONFIG_PARTITION_TABLE_FILENAME="partitions.csv"
CONFIG_PARTITION_TABLE_OFFSET=0x8000
CONFIG_PARTITION_TABLE_MD5=y
```

## examples/mesh/nonmesh_internal_communication/sdkconfig.defaults
```kconfig
CONFIG_LWIP_L2_TO_L3_COPY=y
CONFIG_LWIP_IP_FORWARD=y
CONFIG_LWIP_IPV4_NAPT=y
CONFIG_MESH_NON_MESH_AP_CONNECTIONS=3
```

## examples/network/bridge/main/Kconfig.projbuild
```kconfig
menu "Example Bridge Configuration"
    config EXAMPLE_BR_DHCPS
        bool "Enable DHCP Server"
        default n
        help
            Enable DHCP Server on the device.
endmenu

menu "Example AP Wifi Configuration"
    config EXAMPLE_BR_WIFI
        depends on SOC_WIFI_SUPPORTED || SLAVE_SOC_WIFI_SUPPORTED
        default n
        bool "Bridge WiFi interface"
        help
            Add WiFi interface to be bridged.

    config EXAMPLE_BR_WIFI_SSID
        depends on EXAMPLE_BR_WIFI
        string "WiFi SSID"
        default "myssid"
        help
            SSID (network name) for the example to connect to.

    config EXAMPLE_BR_WIFI_PASSWORD
        depends on EXAMPLE_BR_WIFI
        string "WiFi Password"
        default "mypassword"
        help
            WiFi password (WPA or WPA2) for the example to use.

    config EXAMPLE_BR_WIFI_CHANNEL
        depends on EXAMPLE_BR_WIFI
        int "WiFi Channel"
        range 1 13
        default 1
        help
            WiFi channel (network channel) for the example to use.

    config EXAMPLE_BR_MAX_STA_CONN
        depends on EXAMPLE_BR_WIFI
        int "Maximal STA connections"
        default 4
        range 1 4 if IDF_TARGET_ESP32C2
        range 1 15
        help
            Maximum number of STAs allowed to connect to the bridged soft-AP (wifi_config_t.ap.max_connection).
            Upper bound matches ESP_WIFI_MAX_CONN_NUM in esp_wifi_types_native.h:
            1-4 on ESP32-C2, 1-15 on other Wi-Fi chips.
            Soft-AP and ESP-NOW share encryption keys; see Wi-Fi driver documentation
            if ESP-NOW is enabled.
endmenu
```

## examples/network/bridge/sdkconfig.defaults
```kconfig
CONFIG_ESP_NETIF_TCPIP_LWIP=y
CONFIG_ESP_NETIF_BRIDGE_EN=y

CONFIG_LWIP_NUM_NETIF_CLIENT_DATA=1
```

## examples/network/eth2ap/main/Kconfig.projbuild
```kconfig
menu "Example Configuration"

    config EXAMPLE_WIFI_SSID
        string "Wi-Fi SSID"
        default "eth2ap"
        help
            Set the SSID of Wi-Fi ap interface.

    config EXAMPLE_WIFI_PASSWORD
        string "Wi-Fi Password"
        default "12345678"
        help
            Set the password of Wi-Fi ap interface.

    config EXAMPLE_WIFI_CHANNEL
        int "WiFi channel"
        range 1 13
        default 1
        help
            Set the channel of Wi-Fi ap.

    config EXAMPLE_MAX_STA_CONN
        int "Maximum STA connections"
        default 4
        range 1 4 if IDF_TARGET_ESP32C2
        range 1 15
        help
            Maximum number of STAs allowed to connect to the soft-AP (wifi_config_t.ap.max_connection).
            Upper bound matches ESP_WIFI_MAX_CONN_NUM in esp_wifi_types_native.h:
            1-4 on ESP32-C2, 1-15 on other Wi-Fi chips.
            Soft-AP and ESP-NOW share encryption keys; see Wi-Fi driver documentation
            if ESP-NOW is enabled.

endmenu
```
