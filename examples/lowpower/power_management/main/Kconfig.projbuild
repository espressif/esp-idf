## examples/network/simple_sniffer/main/Kconfig.projbuild
```kconfig
menu "Example Configuration"

    orsource "$IDF_PATH/examples/common_components/env_caps/$IDF_TARGET/Kconfig.env_caps"

    config SNIFFER_STORE_HISTORY
        bool "Store command history into flash"
        default y
        help
            Linenoise line editing library provides functions to save and load command history.
            If this option is enabled, initializes a FAT filesystem and uses it to store command history.

    choice SNIFFER_PCAP_DESTINATION
        prompt "Select destination to store pcap file"
        default SNIFFER_PCAP_DESTINATION_SD
        help
            Select where to store the pcap file.
            Currently support storing files to SD card or to host via JTAG interface with 'Trace memory' enabled.
        config SNIFFER_PCAP_DESTINATION_SD
            bool "SD Card"
            help
                Store pcap file to SD card.
        config SNIFFER_PCAP_DESTINATION_JTAG
            bool "JTAG (App Trace)"
            depends on APPTRACE_DEST_JTAG
            help
                Store pcap file to host via JTAG interface.
        config SNIFFER_PCAP_DESTINATION_MEMORY
            bool "Memory"
            help
                Store pcap file to memory.
    endchoice

    if SNIFFER_PCAP_DESTINATION_SD
        choice SNIFFER_SD_MODE
            prompt "Select SD card work mode"
            default SNIFFER_SD_SDMMC_MODE
            help
                Select which peripheral SD card should use.
            config SNIFFER_SD_SDMMC_MODE
                bool "SDMMC"
                depends on IDF_TARGET_ESP32 || IDF_TARGET_ESP32S3
                help
                    Use SDMMC mode (Not support on esp32c3).
            config SNIFFER_SD_SPI_MODE
                bool "SPI"
                help
                    Use SPI mode.
        endchoice
        menu "SD card pin configuration (SPI)"
            depends on SNIFFER_SD_SPI_MODE

            config SNIFFER_PIN_MOSI
                int "MOSI GPIO number"
                range ENV_GPIO_RANGE_MIN ENV_GPIO_OUT_RANGE_MAX
                default 15
                help
                    GPIO pin number for SPI MOSI (Master Out Slave In).

            config SNIFFER_PIN_MISO
                int "MISO GPIO number"
                range ENV_GPIO_RANGE_MIN ENV_GPIO_IN_RANGE_MAX
                default 2
                help
                    GPIO pin number for SPI MISO (Master In Slave Out).

            config SNIFFER_PIN_CLK
                int "CLK GPIO number"
                range ENV_GPIO_RANGE_MIN ENV_GPIO_OUT_RANGE_MAX
                default 14
                help
                    GPIO pin number for SPI Clock.

            config SNIFFER_PIN_CS
                int "CS GPIO number"
                range ENV_GPIO_RANGE_MIN ENV_GPIO_OUT_RANGE_MAX
                default 13
                help
                    GPIO pin number for SPI Chip Select.
        endmenu
        config SNIFFER_MOUNT_POINT
            string "SD card mount point in the filesystem"
            default "/sdcard"
            help
                Specify the mount point in the VFS (Virtual File System) for SD card.

        config SNIFFER_PCAP_FILE_NAME_MAX_LEN
            int "Max name length of pcap file"
            default 32
            help
                Specify maximum name length of pcap file.
    endif

    if SNIFFER_PCAP_DESTINATION_MEMORY
        config SNIFFER_PCAP_MEMORY_SIZE
            int "Memory size of the '.pcap' file in memory"
            default 4096
            help
                Max memory size to storage packet in memory.
    endif

    config SNIFFER_WORK_QUEUE_LEN
        int "Length of sniffer work queue"
        default 128
        help
            The sniffer callback function should not do heavy work, so we put all heavy IO operation to another task.
            The task gets some basic info of sniffer packet via queue.
            Here you should specify the length of queue.

    config SNIFFER_TASK_STACK_SIZE
        int "Stack size of sniffer task"
        default 4096
        help
            Stack size of sniffer task.

    config SNIFFER_TASK_PRIORITY
        int "Priority of sniffer task"
        default 2
        help
            Priority of sniffer task.

endmenu
```

## examples/network/simple_sniffer/sdkconfig.defaults
```kconfig
# Defaults for generating a new "sdkconfig" file (project settings).
# https://docs.espressif.com/projects/esp-idf/en/latest/esp32/api-guides/build-system.html#custom-sdkconfig-defaults
#
# NOTE - if this file changes, to get new defaults, you must erase any existing
# "sdkconfig" file (this will undo manual settings from "idf.py menuconfig").

# Reduce bootloader log verbosity
CONFIG_BOOTLOADER_LOG_LEVEL_WARN=y
CONFIG_BOOTLOADER_LOG_LEVEL=2

# Increase main task stack size
CONFIG_ESP_MAIN_TASK_STACK_SIZE=7168

# Enable filesystem
CONFIG_PARTITION_TABLE_CUSTOM=y
CONFIG_PARTITION_TABLE_CUSTOM_FILENAME="partitions_example.csv"
CONFIG_PARTITION_TABLE_FILENAME="partitions_example.csv"

# Enable FreeRTOS stats formatting functions, needed for 'tasks' command
CONFIG_FREERTOS_USE_TRACE_FACILITY=y
CONFIG_FREERTOS_USE_STATS_FORMATTING_FUNCTIONS=y

CONFIG_ESPTOOLPY_FLASHSIZE_4MB=y

# FatFS
CONFIG_FATFS_LFN_HEAP=y
CONFIG_FATFS_MAX_LFN=31
```

## examples/network/sta2eth/main/Kconfig.projbuild
```kconfig
menu "Example Configuration"

    orsource "$IDF_PATH/examples/common_components/env_caps/$IDF_TARGET/Kconfig.env_caps"

    choice EXAMPLE_WIFI_CONFIGURATION
        prompt "WiFi configuration"
        default EXAMPLE_WIFI_CONFIGURATION_MANUAL
        help
            Choose how the WiFi settings should be configured.

        config EXAMPLE_WIFI_CONFIGURATION_MANUAL
            bool
            prompt "Manual configuration via http server"
        config EXAMPLE_WIFI_CONFIGURATION_PROVISIONING
            bool
            prompt "Using unified provisioning"
    endchoice

    choice EXAMPLE_PROV_SECURITY_VERSION
        bool "Protocomm security version"
        depends on EXAMPLE_WIFI_CONFIGURATION_PROVISIONING
        default EXAMPLE_PROV_SECURITY_VERSION_1
        help
            Wi-Fi provisioning component offers 3 security versions.
            The example offers a choice between security version 1 and 2.
            You can also choose version 0, which is recommended only
            for testing (not secure, plain text communication)

        config EXAMPLE_PROV_SECURITY_VERSION_1
            bool "Security version 1"
            select ESP_PROTOCOMM_SUPPORT_SECURITY_VERSION_1

        config EXAMPLE_PROV_SECURITY_VERSION_2
            bool "Security version 2"
            select ESP_PROTOCOMM_SUPPORT_SECURITY_VERSION_2

        config EXAMPLE_PROV_SECURITY_VERSION_0
            bool "Plain text communication -- not secure!"
            select ESP_PROTOCOMM_SUPPORT_SECURITY_VERSION_0

    endchoice

    choice EXAMPLE_PROV_MODE
        bool "Security version 2 mode"
        depends on EXAMPLE_PROV_SECURITY_VERSION_2
        default EXAMPLE_PROV_SEC2_DEV_MODE

        config EXAMPLE_PROV_SEC2_DEV_MODE
            bool "Security version 2 development mode"
            depends on EXAMPLE_PROV_SECURITY_VERSION_2
            help
                This enables the development mode for
                security version 2.
                Please note that this mode is NOT recommended for production purpose.

        config EXAMPLE_PROV_SEC2_PROD_MODE
            bool "Security version 2 production mode"
            depends on EXAMPLE_PROV_SECURITY_VERSION_2
            help
                This enables the production mode for
                security version 2.
    endchoice

    choice EXAMPLE_WIRED_INTERFACE
        prompt "Choose the Wired interface"
        default EXAMPLE_WIRED_INTERFACE_IS_ETHERNET
        help
            Choose the wired interface: Ethernet or USB

        config EXAMPLE_WIRED_INTERFACE_IS_ETHERNET
            bool
            prompt "Ethernet"
        config EXAMPLE_WIRED_INTERFACE_IS_USB
            bool
            depends on IDF_TARGET_ESP32S2 || IDF_TARGET_ESP32S3
            prompt "USB NCM"
    endchoice

    config EXAMPLE_RECONFIGURE_BUTTON
        int "Button for switching to reconfigure mode"
        range ENV_GPIO_RANGE_MIN ENV_GPIO_IN_RANGE_MAX
        default 2 if EXAMPLE_WIRED_INTERFACE_IS_ETHERNET
        default 0
        help
            The button on this GPIO is used to reset the board to
            the reconfiguration mode, i.e. to restart provisioning
            or manual configuration of Wi-Fi settings (ssid, password)

endmenu
```

## examples/network/sta2eth/sdkconfig.defaults.esp32c6
```kconfig
CONFIG_EXAMPLE_WIRED_INTERFACE_IS_ETHERNET=y

CONFIG_PARTITION_TABLE_SINGLE_APP_LARGE=y
```

## examples/network/sta2eth/sdkconfig.defaults.esp32s3
```kconfig
# ESP32S3 has USB-OTG, let's prefer virtual Ethernet (USB-NCM device)
CONFIG_EXAMPLE_WIRED_INTERFACE_IS_USB=y
CONFIG_EXAMPLE_WIRED_INTERFACE_IS_ETHERNET=n

# TinyUSB needs to be initialized and run from one core
# that's why we pin the task to CPU0 and init tusb in the task
# on dual core devices (ESP32S3)
CONFIG_TINYUSB_TASK_AFFINITY_CPU0=y
CONFIG_TINYUSB_INIT_IN_DEFAULT_TASK=y

CONFIG_TINYUSB_NET_MODE_NCM=y
```

## examples/network/sta_to_eth/main/Kconfig.projbuild
```kconfig
menu "Example Configuration"

    choice EXAMPLE_WIFI_CONFIGURATION
        prompt "WiFi configuration"
        default EXAMPLE_WIFI_CONFIGURATION_MANUAL
        help
            Choose how the WiFi settings should be configured.

        config EXAMPLE_WIFI_CONFIGURATION_MANUAL
            bool
            prompt "Manual configuration via http server"
        config EXAMPLE_WIFI_CONFIGURATION_PROVISIONING
            bool
            prompt "Using unified provisioning"
    endchoice

    choice EXAMPLE_WIRED_INTERFACE
        prompt "Choose the Wired interface"
        default EXAMPLE_WIRED_INTERFACE_IS_ETHERNET
        help
            Choose how the WiFi settings should be configured.

        config EXAMPLE_WIRED_INTERFACE_IS_ETHERNET
            bool
            prompt "Ethernet"
        config EXAMPLE_WIRED_INTERFACE_IS_USB
            bool
            depends on IDF_TARGET_ESP32S2 || IDF_TARGET_ESP32S3
            prompt "USB NCM"
    endchoice

    config EXAMPLE_RECONFIGURE_BUTTON
        int "Button for switching to reconfigure mode"
        range 0 46
        default 2 if EXAMPLE_WIRED_INTERFACE_IS_ETHERNET
        default 0
        help
            The button on this GPIO is used to reset the board to
            the reconfiguration mode, i.e. to restart provisioning
            or manual configuration of Wi-Fi settings (ssid, password)

endmenu
```

## examples/network/sta_to_eth/sdkconfig.defaults.esp32s2
```kconfig
# ESP32S2 has USB-OTG, let's prefer virtual Ethernet (USB-NCM device)
CONFIG_EXAMPLE_WIRED_INTERFACE_IS_USB=y
CONFIG_EXAMPLE_WIRED_INTERFACE_IS_ETHERNET=n
CONFIG_TINYUSB_NET_MODE_NCM=y
```

## examples/network/sta_to_eth/sdkconfig.defaults.esp32s3
```kconfig
CONFIG_EXAMPLE_WIRED_INTERFACE_IS_USB=y
CONFIG_EXAMPLE_WIRED_INTERFACE_IS_ETHERNET=n
CONFIG_TINYUSB_TASK_AFFINITY_CPU0=y
CONFIG_TINYUSB_INIT_IN_DEFAULT_TASK=y
CONFIG_TINYUSB_NET_MODE_NCM=y
```

## examples/network/vlan_support/main/Kconfig.projbuild
```kconfig
menu "Example Configuration"

    comment "Virtual Ethernet Interface Configuration"

    config EXAMPLE_ETHERNET_VLAN_ID
        int "VLAN identifier"
        range 1 4094
        default 20
        help
            Set the VLAN Id to the virtual interface

    config EXAMPLE_VLAN_STATIC_IPV4_ADDR
        string "IPV4 Address"
        default "192.168.20.10"
        help
            The example will set this IPV4 address to this interface.

    config EXAMPLE_VLAN_STATIC_ADDR_MASK
        string "Subnet Mask"
        default "255.255.255.0"

    config EXAMPLE_VLAN_STATIC_ADDR_DEF_GW
        string "IPV4 Default Gateway"
        default "192.168.20.1"

    config EXAMPLE_EXTRA_VLAN_INTERFACE
        bool "Additional Vlan Interface"
        default n
        help
            Enables an additional VLAN interface

    if EXAMPLE_EXTRA_VLAN_INTERFACE
        config EXAMPLE_EXTRA_ETHERNET_VLAN_ID
            int "VLAN identifier"
            range 1 4094
            default 30
            depends on EXAMPLE_EXTRA_VLAN_INTERFACE
            help
                Set the VLAN Id to the additional virtual interface

        config EXAMPLE_EXTRA_VLAN_STATIC_IPV4_ADDR
            string "IPV4 Address"
            default "192.168.30.10"
            depends on EXAMPLE_EXTRA_VLAN_INTERFACE
            help
                The example will set this IPV4 address to this interface.

        config EXAMPLE_EXTRA_VLAN_STATIC_ADDR_MASK
            string "Subnet Mask"
            default "255.255.255.0"
            depends on EXAMPLE_EXTRA_VLAN_INTERFACE

        config EXAMPLE_EXTRA_VLAN_STATIC_ADDR_DEF_GW
            string "IPV4 Default Gateway"
            default "192.168.30.1"
            depends on EXAMPLE_EXTRA_VLAN_INTERFACE

    endif #EXAMPLE_EXTRA_VLAN_INTERFACE

    choice EXAMPLE_VLAN_DEFAULT_IF
        prompt "Choose the default interface"
        default EXAMPLE_ETHERNET_DEF_IF
        help
            Select the interface to be set as default

        config EXAMPLE_ETHERNET_DEF_IF
            bool
            prompt "Internal Ethernet Interface"
        config EXAMPLE_VLAN_DEF_IF
            bool
            prompt "VLAN Interface"
        config EXAMPLE_EXTRA_VLAN_DEF_IF
            bool
            prompt "Additional VLAN Interface"
            depends on EXAMPLE_EXTRA_VLAN_INTERFACE
    endchoice

    choice EXAMPLE_VLAN_ENABLE_NAPT_IF
        prompt "Select the network interface to enable NAPT on"
        default EXAMPLE_VLAN_NAPT_IF
        help
            Choose the interface on which NAPT will be enabled

        config EXAMPLE_ETHERNET_NAPT_IF
            bool
            prompt "Internal Ethernet Interface"
        config EXAMPLE_VLAN_NAPT_IF
            bool
            prompt "VLAN Interface"
        config EXAMPLE_EXTRA_VLAN_NAPT_IF
            bool
            prompt "Additional VLAN Interface"
            depends on EXAMPLE_EXTRA_VLAN_INTERFACE
    endchoice

    config EXAMPLE_VLAN_PYTEST_PC_IFACE
        string
        default "eth1"
        help
            The example will set this IPV4 address to this interface.
            This configuration is used in pytest only.
            This is a hidden configuration, i.e it will not show up im menuconfig.

endmenu
```
