## examples/protocols/sockets/udp_multicast/main/Kconfig.projbuild
```kconfig
menu "Example Configuration"

    choice EXAMPLE_IP_MODE
        prompt "Multicast IP type"
        help
            Example can multicast IPV4, IPV6, or both.

        config EXAMPLE_IPV4_V6
            bool "IPV4 & IPV6"
            select EXAMPLE_IPV4
            select EXAMPLE_IPV6

        config EXAMPLE_IPV4_ONLY
            bool "IPV4"
            select EXAMPLE_IPV4

        config EXAMPLE_IPV6_ONLY
            bool "IPV6"
            select EXAMPLE_IPV6

    endchoice

    config EXAMPLE_IPV4
        bool
    config EXAMPLE_IPV6
        bool
        select EXAMPLE_CONNECT_IPV6 if IDF_TARGET_ESP32

    config EXAMPLE_MULTICAST_IPV4_ADDR
        string "Multicast IPV4 Address (send & receive)"
        default "232.10.11.12"
        depends on EXAMPLE_IPV4
        help
            IPV4 multicast address. Example will both send to and listen to this address.

    config EXAMPLE_MULTICAST_IPV6_ADDR
        string "Multicast IPV6 Address (send & receive)"
        default "FF02::FC"
        depends on EXAMPLE_IPV6
        help
            IPV6 multicast address. Example will both send to and listen to this address.

            The default FF02::FC address is a link-local multicast address.
            Consult IPV6 specifications or documentation for information about
            meaning of different IPV6 multicast ranges.

    config EXAMPLE_PORT
        int "Multicast port (send & receive)"
        range 0 65535
        default 3333
        help
            Multicast port the example will both send & receive UDP packets on.

    config EXAMPLE_LOOPBACK
        bool "Multicast loopback"
        help
            Enables IP_MULTICAST_LOOP/IPV6_MULTICAST_LOOP options, meaning
            that packets transmitted from the device are also received by the
            device itself.

    config EXAMPLE_MULTICAST_TTL
        int  "Multicast packet TTL"
        range 1 255
        help
            Sets TTL field of multicast packets. Separate from uni- & broadcast TTL.

    choice EXAMPLE_MULTICAST_IF
        prompt "Multicast Interface"
        default EXAMPLE_MULTICAST_LISTEN_DEFAULT_IF
        help
            Multicast socket can bind to default interface, or all interfaces.

        config EXAMPLE_MULTICAST_LISTEN_ALL_IF
            bool "All interfaces (IPV4 only)"
            depends on !EXAMPLE_IPV6_ONLY

        config EXAMPLE_MULTICAST_LISTEN_DEFAULT_IF
            bool "Default interface"

    endchoice

endmenu
```

## examples/protocols/sockets/udp_server/main/Kconfig.projbuild
```kconfig
menu "Example Configuration"

    config EXAMPLE_IPV4
        bool "IPV4"
        default y

    config EXAMPLE_IPV6
        bool "IPV6"
        default n
        select EXAMPLE_CONNECT_IPV6

    config EXAMPLE_PORT
        int "Port"
        range 0 65535
        default 3333
        help
            Local port the example server will listen on.

endmenu
```

## examples/protocols/static_ip/main/Kconfig.projbuild
```kconfig
menu "Example Configuration"
    # Hidden variable to get configuration of Component for Ethernet Initialization
    config EXAMPLE_USE_ETH
        bool
        default y if ETHERNET_INTERNAL_SUPPORT || ETHERNET_SPI_SUPPORT
        default n

    config EXAMPLE_STATIC_IP_ADDR
        string "Static IP address"
        default "192.168.4.2"
        help
            Set static IP address.

    config EXAMPLE_STATIC_NETMASK_ADDR
        string "Static netmask address"
        default "255.255.255.0"
        help
            Set static netmask address.

    config EXAMPLE_STATIC_GW_ADDR
        string "Static gateway address"
        default "192.168.4.1"
        help
            Set static gateway address.

    choice EXAMPLE_STATIC_DNS_SERVER
        prompt "Choose DNS server"
        default EXAMPLE_STATIC_DNS_AUTO
        help
            Select auto to make gateway address as DNS server or manual to input your DNS server
        config EXAMPLE_STATIC_DNS_AUTO
            bool "Use gateway address as DNS server"
            help
                Set DNS server the same as gateway address

        config EXAMPLE_STATIC_DNS_MANUAL
            bool "Set manual value as DNS server"
            help
                Set DNS server with you want
    endchoice

    config EXAMPLE_STATIC_DNS_SERVER_MAIN
        string "Main DNS server address"
        default "192.168.4.1"
        depends on EXAMPLE_STATIC_DNS_MANUAL
        help
            Set main DNS server address.

    config EXAMPLE_STATIC_DNS_SERVER_BACKUP
        string "Backup DNS server address"
        default "192.168.4.1"
        depends on EXAMPLE_STATIC_DNS_MANUAL
        help
            Set backup DNS server address. It can be same with the main DNS server address or leave empty.

    config EXAMPLE_STATIC_DNS_RESOLVE_TEST
        bool "Enable DNS resolve test"
        default n
        help
            Enable it and configure EXAMPLE_STATIC_RESOLVE_DOMAIN to resolve DNS domain name

    config EXAMPLE_STATIC_RESOLVE_DOMAIN
        string "Domain name to resolve"
        default "www.espressif.com"
        depends on EXAMPLE_STATIC_DNS_RESOLVE_TEST
        help
            Set domain name for DNS test
endmenu

menu "WiFi Example Configuration"
    config EXAMPLE_USE_WIFI
        depends on SOC_WIFI_SUPPORTED
        bool "Use WiFi"
        default y
        help
            Select to use WiFi as network interface in the example.

    if EXAMPLE_USE_WIFI
        config EXAMPLE_WIFI_SSID
            string "WiFi SSID"
            default "myssid"
            help
                SSID (network name) for the example to connect to.

        config EXAMPLE_WIFI_PASSWORD
            string "WiFi Password"
            default "mypassword"
            help
                WiFi password (WPA or WPA2) for the example to use.

        config EXAMPLE_MAXIMUM_RETRY
            int "Maximum retry"
            default 5
            help
                Set the Maximum retry to avoid station reconnecting to the AP unlimited when the AP is really
                inexistent.
    endif # EXAMPLE_WIFI
endmenu
```

## examples/protocols/static_ip/sdkconfig.defaults
```kconfig
# CONFIG_ETHERNET_INTERNAL_SUPPORT is not set
# CONFIG_ETHERNET_SPI_SUPPORT is not set
```
