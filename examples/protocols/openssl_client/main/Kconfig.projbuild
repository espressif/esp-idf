## examples/protocols/openssl_client/main/Kconfig.projbuild
```kconfig
menu "Example Configuration"

    choice EXAMPLE_OPENSSL_CLIENT_URI_SOURCE
        prompt "SSL Client URI source"
        default EXAMPLE_OPENSSL_CLIENT_URI_FROM_STRING
        help
            Selects the source of the URI used in the example.

        config EXAMPLE_OPENSSL_CLIENT_URI_FROM_STRING
            bool "From string"

        config EXAMPLE_OPENSSL_CLIENT_URI_FROM_STDIN
            bool "From stdin"
    endchoice

    config EXAMPLE_OPENSSL_CLIENT_TARGET_DOMAIN
        string "Target Domain"
        default "www.baidu.com"
        help
            Target domain for the example to connect to.

    config EXAMPLE_OPENSSL_CLIENT_TARGET_PORT
        string "Target port number"
        default "443"
        help
            Target port number for the example to connect to.

endmenu
```

## examples/protocols/openssl_server/main/Kconfig.projbuild
```kconfig
menu "Example Configuration"

    config EXAMPLE_OPENSSL_SERVER_PORT
        int "Target port number"
        range 0 65535
        default 443
        help
            Target port number for the example to connect to.

endmenu
```

## examples/protocols/pppos_client/components/modem/Kconfig
```kconfig
menu "ESP-MODEM"

    config EXAMPLE_COMPONENT_MODEM_APN
        string "Set Access Point Name (APN)"
        default "CMNET"
        help
            Logical name which is used to select the GGSN or the external packet data network.

endmenu
```

## examples/protocols/pppos_client/main/Kconfig.projbuild
```kconfig
menu "Example Configuration"

    choice EXAMPLE_MODEM_DEVICE
        prompt "Choose supported modem device (DCE)"
        default EXAMPLE_MODEM_DEVICE_BG96
        help
            Select modem device connected to the ESP DTE.
        config EXAMPLE_MODEM_DEVICE_SIM800
            bool "SIM800"
            help
                SIMCom SIM800L is a GSM/GPRS module.
                It supports Quad-band 850/900/1800/1900MHz.
        config EXAMPLE_MODEM_DEVICE_BG96
            bool "BG96"
            help
                Quectel BG96 is a series of LTE Cat M1/Cat NB1/EGPRS module.
        config EXAMPLE_MODEM_DEVICE_SIM7600
            bool "SIM7600"
            help
                SIM7600 is Multi-Band LTE-TDD/LTE-FDD/HSPA+ and GSM/GPRS/EDGE module
    endchoice

    config EXAMPLE_MODEM_PPP_AUTH_USERNAME
        string "Set username for authentication"
        default "espressif"
        depends on !EXAMPLE_MODEM_PPP_AUTH_NONE
        help
            Set username for PPP Authentication.

    config EXAMPLE_MODEM_PPP_AUTH_PASSWORD
        string "Set password for authentication"
        default "esp32"
        depends on !EXAMPLE_MODEM_PPP_AUTH_NONE
        help
            Set password for PPP Authentication.

    config EXAMPLE_MODEM_PPP_AUTH_NONE
        bool "Skip PPP authentication"
        default n
        help
            Set to true for the PPP client to skip authentication

    config EXAMPLE_SEND_MSG
        bool "Short message (SMS)"
        default n
        help
            Select this, the modem will send a short message before power off.

    if EXAMPLE_SEND_MSG
        config EXAMPLE_SEND_MSG_PEER_PHONE_NUMBER
            string "Peer Phone Number (with area code)"
            default "+8610086"
            help
                Enter the peer phone number that you want to send message to.
    endif

    config EXAMPLE_UART_ISR_IN_RAM
        bool "Use UART ISR in RAM"
        default n
        select UART_ISR_IN_IRAM
        help
            Enable placing UART ISR to IRAM.
            This options is useful if PPPoS client needs to perform
            flash operations (e.g. OTA) while keeping the network operational.

    config EXAMPLE_LCP_ECHO
        bool "Enable LCP ECHO"
        default n
        select LWIP_ENABLE_LCP_ECHO
        help
            Enable this option to make use of LCP keepalive using
            LCP_ECHO_INTERVAL and LCP_MAXECHOFAILS to default values

    menu "UART Configuration"
        config EXAMPLE_MODEM_UART_TX_PIN
            int "TXD Pin Number"
            default 25
            range 0 31
            help
                Pin number of UART TX.

        config EXAMPLE_MODEM_UART_RX_PIN
            int "RXD Pin Number"
            default 26
            range 0 31
            help
                Pin number of UART RX.

        config EXAMPLE_MODEM_UART_RTS_PIN
            int "RTS Pin Number"
            default 27
            range 0 31
            help
                Pin number of UART RTS.

        config EXAMPLE_MODEM_UART_CTS_PIN
            int "CTS Pin Number"
            default 23
            range 0 31
            help
                Pin number of UART CTS.

        config EXAMPLE_MODEM_UART_EVENT_TASK_STACK_SIZE
            int "UART Event Task Stack Size"
            range 2000 6000
            default 3072
            help
                Stack size of UART event task.

        config EXAMPLE_MODEM_UART_EVENT_TASK_PRIORITY
            int "UART Event Task Priority"
            range 3 22
            default 5
            help
                Priority of UART event task.

        config EXAMPLE_MODEM_UART_EVENT_QUEUE_SIZE
            int "UART Event Queue Size"
            range 10 40
            default 30
            help
                Length of UART event queue.

        config EXAMPLE_MODEM_UART_TX_BUFFER_SIZE
            int "UART TX Buffer Size"
            range 256 2048
            default 512
            help
                Buffer size of UART TX buffer.

        config EXAMPLE_MODEM_UART_RX_BUFFER_SIZE
            int "UART RX Buffer Size"
            range 256 2048
            default 1024
            help
                Buffer size of UART RX buffer.
    endmenu

endmenu
```

## examples/protocols/pppos_client/sdkconfig.defaults
```kconfig
# Override some defaults to enable PPP
CONFIG_LWIP_PPP_SUPPORT=y
CONFIG_LWIP_PPP_NOTIFY_PHASE_SUPPORT=y
CONFIG_LWIP_PPP_PAP_SUPPORT=y
CONFIG_LWIP_TCPIP_TASK_STACK_SIZE=4096
# Do not enable IPV6 in dte<->dce link local
CONFIG_LWIP_PPP_ENABLE_IPV6=n
```

## examples/protocols/slip/slip_udp/main/Kconfig.projbuild
```kconfig
menu "Example Configuration"

    menu "UART Configuration"
        config EXAMPLE_UART_TX_PIN
            int "TXD Pin Number"
            default 25
            range 0 36
            help
                Pin number of UART TX.

        config EXAMPLE_UART_RX_PIN
            int "RXD Pin Number"
            default 26
            range 0 36
            help
                Pin number of UART RX.

        config EXAMPLE_UART_BAUD
            int "UART baud rate"
            default 115200
            help
                Baud rate for UART communication

    endmenu

    config EXAMPLE_UDP_PORT
        int "Port for UDP echo server"
        default 5678
        help
            Port for UDP echo server in example

    config EXAMPLE_IPV4
        bool "Test with IPv4 address"
        default n
        help
            Test interface using IPv4

endmenu
```

## examples/protocols/smtp_client/main/Kconfig.projbuild
```kconfig
menu "Example Configuration"

    config SMTP_SERVER
        string "Mail Server"
        default "smtp.googlemail.com"
        help
            Target domain for the example to connect to.

    config SMTP_PORT_NUMBER
        string "Mail port number"
        default "587"
        help
            Mail port number for the example to connect to.

    config SMTP_SENDER_MAIL
        string "Sender email"
        default "sender.email@gmail.com"
        help
            Sender's Email address

    config SMTP_SENDER_PASSWORD
        string "Sender password"
        default "password@123"
        help
            Sender's email password

    config SMTP_RECIPIENT_MAIL
        string "Recipient email"
        default "recipient.email@gmail.com"
        help
            Recipient's email

endmenu
```

## examples/protocols/sntp/main/Kconfig.projbuild
```kconfig
menu "Example Configuration"

    config SNTP_TIME_SERVER
        string "SNTP server name"
        default "pool.ntp.org"
        help
            Hostname of the main SNTP server.

    choice SNTP_TIME_SYNC_METHOD
        prompt "Time synchronization method"
        default SNTP_TIME_SYNC_METHOD_IMMED
        help
            Time synchronization method.

        config SNTP_TIME_SYNC_METHOD_IMMED
            bool "update time immediately when received"
        config SNTP_TIME_SYNC_METHOD_SMOOTH
            bool "update time with smooth method (adjtime)"
        config SNTP_TIME_SYNC_METHOD_CUSTOM
            bool "custom implementation"
    endchoice

endmenu
```

## examples/protocols/sntp/sdkconfig.defaults.esp32h2
```kconfig
CONFIG_IDF_TARGET="esp32h2"
CONFIG_MBEDTLS_CMAC_C=y
CONFIG_OPENTHREAD_ENABLED=y
CONFIG_OPENTHREAD_DNS64_CLIENT=y
```

## examples/protocols/sockets/icmpv6_ping/main/Kconfig.projbuild
```kconfig
menu "Example Configuration"

    config EXAMPLE_DST_IPV6_ADDR
        string "Destination IPV6 Address"
        default "2001:DB8::56AF:97FF:FEB3:2195"
        help
            The example will connect to this IPV6 address.

endmenu
```

## examples/protocols/sockets/non_blocking/main/Kconfig.projbuild
```kconfig
menu "Example Configuration"

    config EXAMPLE_TCP_SERVER
        bool "TCP server"
        default n
        help
            This example will setup a tcp server, binds it to the specified address
            and starts listening

    if EXAMPLE_TCP_SERVER
        config EXAMPLE_TCP_SERVER_BIND_ADDRESS
            string "Server bind address"
            default "0.0.0.0"
            help
                Server listener's socket would be bound to this address. This address could be
                either IPv4 or IPv6 address

        config EXAMPLE_TCP_SERVER_BIND_PORT
            string "Server bind port"
            default "3344"
            help
                Server listener's socket would be bound to this port.

    endif

    config EXAMPLE_TCP_CLIENT
        bool "TCP client"
        default y
        help
            This example will setup a tcp client, connects to the specified address
            and sends the data.

    if EXAMPLE_TCP_CLIENT
        config EXAMPLE_TCP_CLIENT_CONNECT_ADDRESS
            string "Client connection address or hostname"
            default "www.google.com"
            help
                Client's socket would connect to this address/host.

        config EXAMPLE_TCP_CLIENT_CONNECT_PORT
            string "Client connection port"
            default "80"
            help
                Client connection port.

    endif

endmenu
```

## examples/protocols/sockets/tcp_client/main/Kconfig.projbuild
```kconfig
menu "Example Configuration"

    choice EXAMPLE_IP_MODE
        prompt "IP Version"
        depends on EXAMPLE_SOCKET_IP_INPUT_STRING
        help
            Example can use either IPV4 or IPV6.

        config EXAMPLE_IPV4
            bool "IPV4"

        config EXAMPLE_IPV6
            bool "IPV6"

    endchoice

    config EXAMPLE_IPV4_ADDR
        string "IPV4 Address"
        default "192.168.0.165"
        depends on EXAMPLE_IPV4
        help
            The example will connect to this IPV4 address.

    config EXAMPLE_IPV6_ADDR
        string "IPV6 Address"
        default "FE80::30AD:E57B:C212:68AD"
        depends on EXAMPLE_IPV6
        help
            The example will connect to this IPV6 address.

    config EXAMPLE_PORT
        int "Port"
        range 0 65535
        default 3333
        help
            The remote port to which the client example will connect to.

    choice EXAMPLE_SOCKET_IP_INPUT
        prompt "Socket example source"
        default EXAMPLE_SOCKET_IP_INPUT_STRING
        help
            Selects the input source of the IP used in the example.

        config EXAMPLE_SOCKET_IP_INPUT_STRING
            bool "From string"

        config EXAMPLE_SOCKET_IP_INPUT_STDIN
            bool "From stdin"
    endchoice

endmenu
```

## examples/protocols/sockets/tcp_client_multi_net/main/Kconfig.projbuild
```kconfig
menu "Example Configuration"

    config EXAMPLE_HOST_NAME
        string "Host Name"
        default "baidu.com"
        help
            host name

    config EXAMPLE_HOST_PORT
        int "Host Port"
        default 80
        range 0 65535
        help
            host port

    config EXAMPLE_BIND_SOCKET_TO_NETIF_NAME
        bool "Bind to interface by its name"
        default y
        help
            By default example uses setsockopt() to bind the tcp-client's socket
            to specific interface. Setting this option to true demonstrates binding
            the socket to the local ip address of the network interface.

endmenu
```

## examples/protocols/sockets/tcp_server/main/Kconfig.projbuild
```kconfig
menu "Example Configuration"

    config EXAMPLE_IPV4
        bool "IPV4"
        default y
        depends on LWIP_IPV4

    config EXAMPLE_IPV6
        bool "IPV6"
        default n
        select EXAMPLE_CONNECT_IPV6

    config EXAMPLE_PORT
        int "Port"
        range 0 65535
        default 3333
        help
            Local port the example server will listen on.

    config EXAMPLE_KEEPALIVE_IDLE
        int "TCP keep-alive idle time(s)"
        default 5
        help
            Keep-alive idle time. In idle time without receiving any data from peer, will send keep-alive probe packet

    config EXAMPLE_KEEPALIVE_INTERVAL
        int "TCP keep-alive interval time(s)"
        default 5
        help
            Keep-alive probe packet interval time.

    config EXAMPLE_KEEPALIVE_COUNT
        int "TCP keep-alive packet retry send counts"
        default 3
        help
            Keep-alive probe packet retry count.
endmenu
```

## examples/protocols/sockets/tcp_transport_client/main/Kconfig.projbuild
```kconfig
menu "Example Configuration"

    config EXAMPLE_TARGET_ADDR
        string "Target server Address"
        default "192.168.0.165"
        help
            The example will connect to this IPV4 address.

    config EXAMPLE_TARGET_PORT
        int "Target server Port"
        range 0 65535
        default 8080
        help
            The remote port to which the client example will connect to.

    config EXAMPLE_ENABLE_PROXY
        bool "Enable Proxy client"
        default n
        help
            Use a SOCKS proxy to connect

    config EXAMPLE_PROXY_ADDR
        string "Proxy server Address"
        depends on ENABLE_PROXY
        default "192.168.0.1"
        help
            The example will connect to this proxy address to request connection to target.

    config EXAMPLE_PROXY_PORT
        int "Proxy server Port"
        depends on ENABLE_PROXY
        range 0 65535
        default 1080
        help
            The proxy port to which the client example will request connection.

endmenu
```

## examples/protocols/sockets/udp_client/sdkconfig.defaults.linux
```kconfig
CONFIG_LWIP_ENABLE=y
CONFIG_EXAMPLE_IPV4_ADDR="127.0.0.1"
CONFIG_EXAMPLE_CONNECT_LWIP_TAPIF=n
```
