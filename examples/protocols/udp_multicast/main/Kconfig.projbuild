## examples/protocols/udp_multicast/main/Kconfig.projbuild
```kconfig
menu "Example Configuration"

config WIFI_SSID
    string "WiFi SSID"
	default "myssid"
	help
		SSID (network name) for the example to connect to.

config WIFI_PASSWORD
    string "WiFi Password"
	default "myssid"
	help
		WiFi password (WPA or WPA2) for the example to use.

		Can be left blank if the network has no security set.

choice EXAMPLE_IP_MODE
    prompt "Multicast IP type"
    help
       Example can multicast IPV4, IPV6, or both.

config EXAMPLE_IPV4_V6
    bool "IPV4 & IPV6"
    select EXAMPLE_IPV4
    select EXAMPLE_IPV6

config EXAMPLE_IPV4_ONLY
    bool "IPV4"
    select EXAMPLE_IPV4

config EXAMPLE_IPV6_ONLY
   bool "IPV6"
    select EXAMPLE_IPV6

endchoice

config EXAMPLE_IPV4
    bool
config EXAMPLE_IPV6
    bool

config EXAMPLE_MULTICAST_IPV4_ADDR
    string "Multicast IPV4 Address (send & receive)"
    default "232.10.11.12"
    depends on EXAMPLE_IPV4
    help
       IPV4 multicast address. Example will both send to and listen to this address.

config EXAMPLE_MULTICAST_IPV6_ADDR
    string "Multicast IPV6 Address (send & receive)"
    default "FF02::FC"
    depends on EXAMPLE_IPV6
    help
       IPV6 multicast address. Example will both send to and listen to this address.

       The default FF02::FC address is a link-local multicast address. Consult IPV6 specifications or documentation for information about meaning of different IPV6 multicast ranges.

config EXAMPLE_PORT
    int "Multicast port (send & receive)"
    range 0 65535
    default 333
    help
        Multicast port the example will both send & receive UDP packets on.

config EXAMPLE_LOOPBACK
    bool "Multicast loopback"
    help
        Enables IP_MULTICAST_LOOP/IPV6_MULTICAST_LOOP options, meaning
        that packets transmitted from the device are also received by the
        device itself.

config EXAMPLE_MULTICAST_TTL
    int  "Multicast packet TTL"
    range 1 255
    help
        Sets TTL field of multicast packets. Separate from uni- & broadcast TTL.

choice EXAMPLE_MULTICAST_IF
    prompt "Multicast Interface"
    help
       Multicast socket can bind to default interface, or all interfaces.

config EXAMPLE_MULTICAST_LISTEN_DEFAULT_IF
    bool "Default interface"

config EXAMPLE_MULTICAST_LISTEN_STA_IF
    bool "WiFi STA interface"

endchoice

endmenu
```

## examples/protocols/websocket/main/Kconfig.projbuild
```kconfig
menu "Example Configuration"

    choice WEBSOCKET_URI_SOURCE
        prompt "Websocket URI source"
        default WEBSOCKET_URI_FROM_STRING
        help
            Selects the source of the URI used in the example.

        config WEBSOCKET_URI_FROM_STRING
            bool "From string"

        config WEBSOCKET_URI_FROM_STDIN
            bool "From stdin"
    endchoice

    config WEBSOCKET_URI
        string "Websocket endpoint URI"
        depends on WEBSOCKET_URI_FROM_STRING
        default "ws://echo.websocket.org"
        help
            URL of websocket endpoint this example connects to and sends echo

endmenu
```

## examples/provisioning/ble_prov/main/Kconfig.projbuild
```kconfig
menu "Example Configuration"

    config USE_SEC_1
        bool
        default y
        prompt "Use Security Version 1"
        help
            Security version 1 used Curve25519 key exchange for establishing
            secure session between device and client during provisioning

    config USE_POP
        bool
        depends on USE_SEC_1
        default y
        prompt "Use proof-of-possession"
        help
            Proof-of-possession can be optionally used to prove that the device is indeed
            in possession of the user who is provisioning the device. This proof-of-possession
            is internally used to generate the shared secret through key exchange.

    config POP
        string "Proof-of-possession"
        default "abcd1234"
        depends on USE_POP

    config RESET_PROVISIONED
        bool
        default n
        prompt "Reset provisioned status of the device"
        help
            This erases the NVS to reset provisioned status of the device on every reboot.
            Provisioned status is determined by the Wi-Fi STA configuration, saved on the NVS.

    config AP_RECONN_ATTEMPTS
        int "Maximum AP connection attempts"
        default 5
        help
            Set the maximum connection attempts to perform when connecting to a Wi-Fi AP.

endmenu
```

## examples/provisioning/custom_config/main/Kconfig.projbuild
```kconfig
menu "Example Configuration"

config SOFTAP_SSID
    string "WiFi SSID"
    default "myssid"
    help
    SSID (network name) for the example to connect to.

config SOFTAP_PASS
    string "WiFi Password"
    default "mypassword"
    help
    WiFi password (WPA or WPA2) for the example to use.

config USE_SEC_1
    bool
    default n
    prompt "Use Security Version 1"
    help
    Security version 1 used Curve25519 key exchange for establishing
    secure session between device and client during provisioning

config USE_POP
    bool
    depends on USE_SEC_1
    default n
    prompt "Use proof-of-possession"
    help
    Proof-of-possession can be optionally used to prove that the device is indeed
    in possession of the user who is provisioning the device. This proof-of-possession
    is internally used to generate the shared secret through key exchange.

config POP
    string "Proof-of-possession"
    default "abcd1234"
    depends on USE_POP

config PROTOCOMM_HTTPD_PORT
    int "Protocomm HTTP Port"
    default 80
    help
    Port on which to run Protocomm HTTP based provisioning service

config RESET_PROVISIONED
    bool
    default n
    prompt "Reset provisioned status of the device"
    help
    This erases the NVS to reset provisioned status of the device on every reboot.
    Provisioned status is determined by the WiFi STA configuration, saved on the NVS.

endmenu
```

## examples/provisioning/legacy/console_prov/main/Kconfig.projbuild
```kconfig
menu "Example Configuration"

    config EXAMPLE_USE_SEC_1
        bool
        default y
        prompt "Use Security Version 1"
        help
            Security version 1 used Curve25519 key exchange for establishing
            secure session between device and client during provisioning

    config EXAMPLE_USE_POP
        bool
        depends on EXAMPLE_USE_SEC_1
        default y
        prompt "Use proof-of-possession"
        help
            Proof-of-possession can be optionally used to prove that the device is indeed
            in possession of the user who is provisioning the device. This proof-of-possession
            is internally used to generate the shared secret through key exchange.

    config EXAMPLE_POP
        string "Proof-of-possession"
        default "abcd1234"
        depends on EXAMPLE_USE_POP

    config EXAMPLE_RESET_PROVISIONED
        bool
        default n
        prompt "Reset provisioned status of the device"
        help
            This erases the NVS to reset provisioned status of the device on every reboot.
            Provisioned status is determined by the Wi-Fi STA configuration, saved on the NVS.

    config EXAMPLE_AP_RECONN_ATTEMPTS
        int "Maximum AP connection attempts"
        default 5
        help
            Set the maximum connection attempts to perform when connecting to a Wi-Fi AP.

endmenu
```

## examples/provisioning/legacy/softap_prov/main/Kconfig.projbuild
```kconfig
menu "Example Configuration"

    config EXAMPLE_SSID_SET_MAC
        bool "Use MAC as SSID"
        default y
        help
            Set SoftAP SSID as PROV_<MAC>.

    config EXAMPLE_SSID
        string "Wi-Fi SSID"
        default "PROV_SSID"
        depends on !EXAMPLE_SSID_SET_MAC
        help
            SSID (network name) for the example to connect to.

    config EXAMPLE_PASS
        string "Wi-Fi Password"
        default "PROV_PASS"
        help
            Wi-Fi password (WPA or WPA2) for the example to use.

    config EXAMPLE_USE_SEC_1
        bool
        default y
        prompt "Use Security Version 1"
        help
            Security version 1 used Curve25519 key exchange for establishing
            secure session between device and client during provisioning

    config EXAMPLE_USE_POP
        bool
        depends on EXAMPLE_USE_SEC_1
        default y
        prompt "Use proof-of-possession"
        help
            Proof-of-possession can be optionally used to prove that the device is indeed
            in possession of the user who is provisioning the device. This proof-of-possession
            is internally used to generate the shared secret through key exchange.

    config EXAMPLE_POP
        string "Proof-of-possession"
        default "abcd1234"
        depends on EXAMPLE_USE_POP

    config EXAMPLE_RESET_PROVISIONED
        bool
        default n
        prompt "Reset provisioned status of the device"
        help
            This erases the NVS to reset provisioned status of the device on every reboot.
            Provisioned status is determined by the Wi-Fi STA configuration, saved on the NVS.

    config EXAMPLE_AP_RECONN_ATTEMPTS
        int "Maximum AP connection attempts"
        default 5
        help
            Set the maximum connection attempts to perform when connecting to a Wi-Fi AP.

endmenu
```

## examples/provisioning/manager/sdkconfig.defaults
```kconfig
# Override some defaults so BT stack is enabled and
CONFIG_BT_ENABLED=y
CONFIG_BTDM_CTRL_MODE_BLE_ONLY=y
CONFIG_BTDM_CTRL_MODE_BR_EDR_ONLY=n
CONFIG_BTDM_CTRL_MODE_BTDM=n
CONFIG_BT_NIMBLE_ENABLED=y

## For Bluedroid as binary is larger than default size
CONFIG_PARTITION_TABLE_CUSTOM=y
CONFIG_PARTITION_TABLE_CUSTOM_FILENAME="partitions.csv"
CONFIG_PARTITION_TABLE_FILENAME="partitions.csv"
```

## examples/provisioning/softap_prov/main/Kconfig.projbuild
```kconfig
menu "Example Configuration"

config SOFTAP_SSID_SET_MAC
    bool "Use MAC as SSID"
    default y
    help
    Set SoftAP SSID as PROV_<MAC>.

config SOFTAP_SSID
    string "WiFi SSID"
    default "PROV_SSID"
    depends on !SOFTAP_SSID_SET_MAC
    help
    SSID (network name) for the example to connect to.

config SOFTAP_PASS
    string "WiFi Password"
    default "PROV_PASS"
    help
    WiFi password (WPA or WPA2) for the example to use.

config USE_SEC_1
    bool
    default y
    prompt "Use Security Version 1"
    help
    Security version 1 used Curve25519 key exchange for establishing
    secure session between device and client during provisioning

config USE_POP
    bool
    depends on USE_SEC_1
    default y
    prompt "Use proof-of-possession"
    help
    Proof-of-possession can be optionally used to prove that the device is indeed
    in possession of the user who is provisioning the device. This proof-of-possession
    is internally used to generate the shared secret through key exchange.

config POP
    string "Proof-of-possession"
    default "abcd1234"
    depends on USE_POP

config RESET_PROVISIONED
    bool
    default n
    prompt "Reset provisioned status of the device"
    help
    This erases the NVS to reset provisioned status of the device on every reboot.
    Provisioned status is determined by the WiFi STA configuration, saved on the NVS.

endmenu
```

## examples/provisioning/wifi_prov_mgr/main/Kconfig.projbuild
```kconfig
menu "Example Configuration"

    choice EXAMPLE_PROV_TRANSPORT
        bool "Provisioning Transport"
        default EXAMPLE_PROV_TRANSPORT_SOFTAP if IDF_TARGET_ESP32S2
        default EXAMPLE_PROV_TRANSPORT_BLE
        help
            Wi-Fi provisioning component offers both, SoftAP and BLE transports. Choose any one.

        config EXAMPLE_PROV_TRANSPORT_BLE
            bool "BLE"
            select BT_ENABLED
            depends on !IDF_TARGET_ESP32S2
        config EXAMPLE_PROV_TRANSPORT_SOFTAP
            bool "Soft AP"
    endchoice

    config EXAMPLE_PROV_TRANSPORT
        int
        default 1 if EXAMPLE_PROV_TRANSPORT_BLE
        default 2 if EXAMPLE_PROV_TRANSPORT_SOFTAP

    config EXAMPLE_RESET_PROVISIONED
        bool
        default n
        prompt "Reset provisioned status of the device"
        help
            This erases the NVS to reset provisioned status of the device on every reboot.
            Provisioned status is determined by the Wi-Fi STA configuration, saved on the NVS.

    config EXAMPLE_RESET_PROV_MGR_ON_FAILURE
        bool
        default y
        prompt "Reset provisioned credentials and state machine after session failure"
        help
            Enable reseting provisioned credentials and state machine after session failure.
            This will restart the provisioning service after retries are exhausted.

    config EXAMPLE_PROV_MGR_MAX_RETRY_CNT
        int
        default 5
        prompt "Max retries before reseting provisioning state machine"
        depends on EXAMPLE_RESET_PROV_MGR_ON_FAILURE
        help
            Set the Maximum retry to avoid reconnecting to an inexistent AP or if credentials
            are misconfigured. Provisioned credentials are erased and internal state machine
            is reset after this threshold is reached.

    config EXAMPLE_PROV_SHOW_QR
        bool "Show provisioning QR code"
        default y
        help
            Show the QR code for provisioning.

    config EXAMPLE_PROV_USING_BLUEDROID
        bool
        depends on (BT_BLUEDROID_ENABLED && (IDF_TARGET_ESP32C3 || IDF_TARGET_ESP32S3))
        select BT_BLE_42_FEATURES_SUPPORTED
        default y
        help
            This enables BLE 4.2 features for Bluedroid.
endmenu
```

## examples/provisioning/wifi_prov_mgr/sdkconfig.defaults
```kconfig
# Defaults for generating a new "sdkconfig" file (project settings).
# https://docs.espressif.com/projects/esp-idf/en/latest/esp32/api-guides/build-system.html#custom-sdkconfig-defaults
#
# NOTE - if this file changes, to get new defaults, you must erase any existing
# "sdkconfig" file (this will undo manual settings from "idf.py menuconfig").

# Override some defaults so BT stack is enabled and
CONFIG_BT_ENABLED=y
CONFIG_BTDM_CTRL_MODE_BLE_ONLY=y
CONFIG_BTDM_CTRL_MODE_BR_EDR_ONLY=n
CONFIG_BTDM_CTRL_MODE_BTDM=n
CONFIG_BT_NIMBLE_ENABLED=y

## For Bluedroid as binary is larger than default size
CONFIG_PARTITION_TABLE_CUSTOM=y
CONFIG_PARTITION_TABLE_CUSTOM_FILENAME="partitions.csv"
CONFIG_PARTITION_TABLE_FILENAME="partitions.csv"
```

## examples/provisioning/wifi_prov_mgr/sdkconfig.defaults.esp32
```kconfig
# Place FreeRTOS functions into flash to save some IRAM on the ESP32
CONFIG_FREERTOS_PLACE_FUNCTIONS_INTO_FLASH=y
```

## examples/security/atecc608a_ecdsa/init1_mfg/components/cryptoauthlib/Kconfig
```kconfig
menu "Cryptoauthlib"

config ATCA_MBEDTLS_ECDH
   bool "Enable Hardware ECDH with ATECC608A"
   depends on MBEDTLS_ECDH_C
   select MBEDTLS_HARDWARE_ECDH
   select MBEDTLS_ECP_DP_SECP256R1_ENABLED
   help
      Enable hardware ECDH operations on an ATECC608A device

config ATCA_MBEDTLS_ECDSA
   bool "Enable Hardware ECDSA keys for mbedTLS"
   depends on MBEDTLS_ECDSA_C
   help
      Enable Hardware ECDSA

config ATCA_MBEDTLS_ECDSA_SIGN
   bool "Enable ATECC608A sign operations in mbedTLS"
   depends on ATCA_MBEDTLS_ECDSA
   select MBEDTLS_HARDWARE_ECDSA_SIGN
   select MBEDTLS_ECP_DP_SECP256R1_ENABLED

config ATCA_MBEDTLS_ECDSA_VERIFY
   bool "Enable ATECC608A verify operations in mbedTLS"
   depends on ATCA_MBEDTLS_ECDSA
   select MBEDTLS_HARDWARE_ECDSA_VERIFY
   select MBEDTLS_ECP_DP_SECP256R1_ENABLED

endmenu # cryptoauthlib
```

## examples/security/atecc608a_ecdsa/init1_mfg/main/Kconfig.projbuild
```kconfig
menu "Mfg Configuration"

config MFG_DEBUGGING
    bool "MFG Debug"
	default n
	help
		Turn on debugging during the manufacturing workflow.

config MFG_TEST_MODE
	bool "MFG Test mode"
	default n
	help
		Enables test mode, thus the modules can be reprogrammed. Skips the flash encryption & secure boot part in the finalize step.

endmenu
```
