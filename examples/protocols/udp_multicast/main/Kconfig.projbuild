## examples/security/atecc608a_ecdsa/init1_mfg/sdkconfig.defaults
```kconfig
CONFIG_TASK_WDT_TIMEOUT_S=60
CONFIG_PARTITION_TABLE_CUSTOM=y
CONFIG_SPI_FLASH_WRITING_DANGEROUS_REGIONS_ALLOWED=y
CONFIG_ESPTOOLPY_FLASHSIZE_4MB=y
CONFIG_MBEDTLS_HARDWARE_MPI=y
CONFIG_MBEDTLS_HARDWARE_SHA=y
CONFIG_PARTITION_TABLE_OFFSET=0xc000
CONFIG_FLASHMODE_QIO=y
CONFIG_ESPTOOLPY_FLASHFREQ_80M=y
CONFIG_ESP32_DEFAULT_CPU_FREQ_240=y
```

## examples/security/flash_encryption/sdkconfig.defaults
```kconfig
# Defaults for generating a new "sdkconfig" file (project settings).
# https://docs.espressif.com/projects/esp-idf/en/latest/esp32/api-guides/build-system.html#custom-sdkconfig-defaults
#
# NOTE - if this file changes, to get new defaults, you must erase any existing
# "sdkconfig" file (this will undo manual settings from "idf.py menuconfig").

# This example uses an extra partition to demonstrate encrypted/non-encrypted reads/writes.
CONFIG_PARTITION_TABLE_CUSTOM=y
CONFIG_PARTITION_TABLE_CUSTOM_FILENAME="partitions_example.csv"
CONFIG_PARTITION_TABLE_FILENAME="partitions_example.csv"
CONFIG_PARTITION_TABLE_OFFSET=0x9000
```

## examples/security/hmac_soft_jtag/main/Kconfig.projbuild
```kconfig
menu "Example Configuration"

    config EXAMPLE_JTAG_SEC_HMAC_EFUSE_KEY_ID
        int "eFuse key ID storing the HMAC key"
        range -1 5
        default -1
        help
            The eFuse block key ID stores the HMAC key necessary for deriving token data to enable JTAG access.

            Note: If set to -1, the system will attempt to use the first found keys with the purpose
            either HMAC_DOWN_ALL or HMAC_DOWN_JTAG.

endmenu
```

## examples/security/key_manager/main/Kconfig.projbuild
```kconfig
menu "Key Manager Signing Example Configuration"

    config EXAMPLE_KEY_MGR_ECDSA_SIGN
        bool "Enable ECDSA signing example"
        default y
        depends on SOC_KEY_MANAGER_SUPPORTED && SOC_KEY_MANAGER_ECDSA_KEY_DEPLOY
        help
            Enable the ECDSA signing example using Key Manager deployed key.
            This demonstrates deploying an ECDSA private key via Key Manager
            and using it for signing operations through the PSA Crypto API.

    config EXAMPLE_KEY_MGR_RSA_DS_SIGN
        bool "Enable RSA-DS signing example"
        default y
        depends on SOC_KEY_MANAGER_SUPPORTED && SOC_KEY_MANAGER_DS_KEY_DEPLOY
        help
            Enable the RSA Digital Signature (DS) signing example using
            Key Manager deployed key. This demonstrates deploying a DS key
            via Key Manager and using it for RSA signing operations through
            the PSA Crypto API.

endmenu
```

## examples/security/key_manager/sdkconfig.defaults
```kconfig
# Enable hardware ECDSA signing
CONFIG_MBEDTLS_HARDWARE_ECDSA_SIGN=y
CONFIG_MBEDTLS_HARDWARE_ECDSA_VERIFY=y

# Enable DS peripheral support
CONFIG_MBEDTLS_HARDWARE_RSA_DS_PERIPHERAL=y

# Enable Key Manager signing examples
CONFIG_EXAMPLE_KEY_MGR_ECDSA_SIGN=y
CONFIG_EXAMPLE_KEY_MGR_RSA_DS_SIGN=y
```

## examples/security/nvs_encryption_hmac/sdkconfig.defaults
```kconfig
# This example uses an extra partition to demonstrate encrypted/non-encrypted reads/writes.
CONFIG_PARTITION_TABLE_CUSTOM=y
CONFIG_PARTITION_TABLE_CUSTOM_FILENAME="partitions_example.csv"
CONFIG_PARTITION_TABLE_FILENAME="partitions_example.csv"

CONFIG_NVS_ENCRYPTION=y
CONFIG_NVS_SEC_KEY_PROTECT_USING_HMAC=y
```

## examples/security/psa_its_custom_backend/sdkconfig.defaults
```kconfig
CONFIG_PARTITION_TABLE_CUSTOM=y
CONFIG_PARTITION_TABLE_CUSTOM_FILENAME="partitions_example.csv"
CONFIG_PARTITION_TABLE_FILENAME="partitions_example.csv"
CONFIG_ESPTOOLPY_FLASHSIZE_4MB=y

# Enable PSA ITS custom storage backend (Kconfig: MBEDTLS_PSA_ITS_*)
CONFIG_MBEDTLS_PSA_ITS_CUSTOM_STORAGE_BACKEND=y
CONFIG_MBEDTLS_PSA_ITS_CUSTOM_BACKEND_UID_MIN=0x30000000
CONFIG_MBEDTLS_PSA_ITS_CUSTOM_BACKEND_UID_MAX=0x3FFFFFFF
```

## examples/security/sbv2_multisig/sdkconfig.defaults
```kconfig
# Change default offset to give more space for bootloader
CONFIG_PARTITION_TABLE_OFFSET=0xF000

# Secure Boot V2 - disable signing during build we must supply signatures at a later stage
CONFIG_SECURE_SIGNED_ON_BOOT=y
CONFIG_SECURE_SIGNED_ON_UPDATE=y
CONFIG_SECURE_BOOT_V2_RSA_ENABLED=y
CONFIG_SECURE_SIGNED_APPS_RSA_SCHEME=y
CONFIG_SECURE_BOOT=y
CONFIG_SECURE_BOOT_V2_ENABLED=y
CONFIG_SECURE_BOOT_BUILD_SIGNED_BINARIES=n
CONFIG_SECURE_BOOT_INSECURE=y
CONFIG_SECURE_BOOT_FLASH_BOOTLOADER_DEFAULT=y

# Test of secure boot v2 multisig
CONFIG_SECURE_BOOT_V2_MIN_SIGNATURES=2
```

## examples/security/security_features_app/main/Kconfig.projbuild
```kconfig
menu "Example Configuration"

    config EXAMPLE_JTAG_REENABLE_EFUSE_BLOCK
        int "JTAG Re-enable efuse key id"
        default 3
        range 0 5
        help
            The value of the eFuse key id in which the HMAC key is stored for the JTAG re-enablement.
            The example readily assumes that the respective hmac key is burned in the eFuse at this value

    config EXAMPLE_SECURE_JTAG_TOKEN_PATH
        string "Secure JTAG token path"
        default "secure_jtag_token.bin"
        help
            The path to the binary file containing the token to re-enable JTAG.
            This path is relative to the root directory of the example project.

endmenu
```

## examples/security/security_features_app/sdkconfig.defaults
```kconfig
# This example uses an extra partition to demonstrate encrypted/non-encrypted reads/writes.
CONFIG_PARTITION_TABLE_CUSTOM=y
CONFIG_PARTITION_TABLE_CUSTOM_FILENAME="partitions.csv"
CONFIG_PARTITION_TABLE_FILENAME="partitions.csv"
CONFIG_PARTITION_TABLE_OFFSET=0xD000

# Secure Boot V2
CONFIG_SECURE_SIGNED_ON_BOOT=y
CONFIG_SECURE_SIGNED_ON_UPDATE=y
CONFIG_SECURE_SIGNED_APPS=y
CONFIG_SECURE_BOOT_V2_RSA_ENABLED=y
CONFIG_SECURE_SIGNED_APPS_RSA_SCHEME=y
CONFIG_SECURE_BOOT=y
CONFIG_SECURE_BOOT_V2_ENABLED=y
CONFIG_SECURE_BOOT_BUILD_SIGNED_BINARIES=y
CONFIG_SECURE_BOOT_SIGNING_KEY="secure_boot_signing_key.pem"

CONFIG_SECURE_BOOT_FLASH_BOOTLOADER_DEFAULT=y

# Please note that this does not make the device insecure as JTAG shall be soft disabled with instructions from README along

CONFIG_SECURE_BOOT_INSECURE=y
CONFIG_SECURE_BOOT_ALLOW_JTAG=y

# Flash Encryption
CONFIG_SECURE_FLASH_ENC_ENABLED=y
CONFIG_SECURE_FLASH_ENCRYPTION_MODE_RELEASE=y
CONFIG_SECURE_FLASH_ENCRYPT_ONLY_IMAGE_LEN_IN_APP_PART=y
CONFIG_SECURE_FLASH_CHECK_ENC_EN_IN_APP=y
CONFIG_SECURE_ROM_DL_MODE_ENABLED=y
CONFIG_SECURE_ENABLE_SECURE_ROM_DL_MODE=y
```

## examples/security/security_features_app/sdkconfig.defaults.esp32c3
```kconfig
CONFIG_SECURE_BOOT_ENABLE_AGGRESSIVE_KEY_REVOKE=y


# NVS encryption
CONFIG_NVS_ENCRYPTION=y
CONFIG_NVS_SEC_KEY_PROTECT_USING_HMAC=y
CONFIG_NVS_SEC_HMAC_EFUSE_KEY_ID=2
```
