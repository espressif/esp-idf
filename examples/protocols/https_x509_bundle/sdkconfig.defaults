## examples/protocols/mqtt/wss/main/Kconfig.projbuild
```kconfig
menu "Example Configuration"

    config BROKER_URI
        string "Broker URL"
        default "wss://mqtt.eclipseprojects.io:443/mqtt"
        help
            URL of an mqtt broker which this example connects to.

    config BROKER_CERTIFICATE_OVERRIDE
        string "Server certificate override"
        default ""
        help
            Please leave empty if server certificate included from a textfile; otherwise fill in a base64 part of PEM
            format certificate

    config BROKER_CERTIFICATE_OVERRIDDEN
        bool
        default y if BROKER_CERTIFICATE_OVERRIDE != ""

endmenu
```

## examples/protocols/mqtt5/sdkconfig.defaults
```kconfig
# Enable the built-in certificate bundle for TLS server verification
CONFIG_MBEDTLS_CERTIFICATE_BUNDLE=y
CONFIG_MBEDTLS_CERTIFICATE_BUNDLE_DEFAULT_FULL=y

# Enable MQTT v5 support in the managed ESP-MQTT component
CONFIG_MQTT_PROTOCOL_5=y
```
