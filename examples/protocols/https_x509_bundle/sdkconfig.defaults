## examples/protocols/https_x509_bundle/sdkconfig.defaults
```kconfig
# Defaults for generating a new "sdkconfig" file (project settings).
# https://docs.espressif.com/projects/esp-idf/en/latest/esp32/api-guides/build-system.html#custom-sdkconfig-defaults
#
# NOTE - if this file changes, to get new defaults, you must erase any existing
# "sdkconfig" file (this will undo manual settings from "idf.py menuconfig").

# CONFIG_MBEDTLS_CERTIFICATE_BUNDLE_DEFAULT_FULL is not set
# CONFIG_MBEDTLS_CERTIFICATE_BUNDLE_DEFAULT_CMN is not set
CONFIG_MBEDTLS_CERTIFICATE_BUNDLE_DEFAULT_NONE=y
CONFIG_MBEDTLS_CUSTOM_CERTIFICATE_BUNDLE=y
CONFIG_MBEDTLS_CUSTOM_CERTIFICATE_BUNDLE_PATH="certs"
```

## examples/protocols/icmp/pmtu_probe/main/Kconfig.projbuild
```kconfig
menu "Example Configuration"

    config EXAMPLE_PROBE_HOST
        string "Probe Hostname/IP"
        default "www.espressif.com"
        help
            Hostname or IPv4 address to probe for MTU.

endmenu
```

## examples/protocols/l2tap/sdkconfig.defaults
```kconfig
# L2 TAP currently supports Ethernet only
CONFIG_EXAMPLE_CONNECT_ETHERNET=y
CONFIG_ETHERNET_INTERNAL_SUPPORT=y
CONFIG_ETHERNET_PHY_GENERIC=y
CONFIG_ETHERNET_MDC_GPIO=23
CONFIG_ETHERNET_MDIO_GPIO=18
CONFIG_ETHERNET_PHY_RST_GPIO=5
CONFIG_ETHERNET_PHY_ADDR=1
CONFIG_ETHERNET_SPI_SUPPORT=n
CONFIG_EXAMPLE_CONNECT_WIFI=n

# Enable L2 TAP
CONFIG_ESP_NETIF_L2_TAP=y
```

## examples/protocols/mdns/main/Kconfig.projbuild
```kconfig
menu "Example Configuration"

    orsource "$IDF_PATH/examples/common_components/env_caps/$IDF_TARGET/Kconfig.env_caps"

    config MDNS_HOSTNAME
        string "mDNS Hostname"
        default "esp32-mdns"
        help
            mDNS Hostname for example to use

    config MDNS_INSTANCE
        string "mDNS Instance Name"
        default "ESP32 with mDNS"
        help
            mDNS Instance Name for example to use

    config MDNS_PUBLISH_DELEGATE_HOST
        bool "Publish a delegated host"
        help
            Enable publishing a delegated host other than ESP32.
            The example will also add a mock service for this host.

    config MDNS_RESOLVE_TEST_SERVICES
        bool "Resolve test services"
        default n
        help
            Enable resolving test services on startup.
            These services are advertized and evaluated in automated tests.
            When executed locally, these will not be resolved and warnings appear in the log.
            Please set to false to disable initial querying to avoid warnings.

    config MDNS_ADD_MAC_TO_HOSTNAME
        bool "Add mac suffix to hostname"
        default n
        help
            If enabled, a portion of MAC address is added to the hostname, this is used
            for evaluation of tests in CI

    config MDNS_BUTTON_GPIO
        int "Button GPIO to trigger querries"
        range ENV_GPIO_RANGE_MIN ENV_GPIO_IN_RANGE_MAX
        default 0
        help
            Set the GPIO number used as mDNS test button

    config MDNS_ADD_CUSTOM_NETIF
        bool "Add user netif to mdns service"
        default n
        help
            If enabled, we try to add a custom netif to mdns service.
            Note that for using with common connection example code, we have to disable
            all predefined interfaces in mdns component setup (since we're adding one
            of the default interfaces)

endmenu
```

## examples/protocols/modbus/serial/mb_master/sdkconfig.defaults
```kconfig
#
# Modbus configuration
#
CONFIG_FMB_TIMER_PORT_ENABLED=n
CONFIG_MB_COMM_MODE_ASCII=y
CONFIG_MB_UART_BAUD_RATE=115200
CONFIG_FMB_MASTER_DELAY_MS_CONVERT=200
CONFIG_FMB_MASTER_TIMEOUT_MS_RESPOND=400
CONFIG_FMB_TIMER_USE_ISR_DISPATCH_METHOD=y
```

## examples/protocols/modbus/serial/mb_slave/main/Kconfig.projbuild
```kconfig
menu "Modbus Example Configuration"

    orsource "$IDF_PATH/examples/common_components/env_caps/$IDF_TARGET/Kconfig.env_caps"

    config MB_UART_PORT_ONE
        bool
        default y
        depends on (ESP_CONSOLE_UART_NUM !=1) && (SOC_UART_HP_NUM > 1)

    config MB_UART_PORT_TWO
        bool
        default y
        depends on (ESP_CONSOLE_UART_NUM !=2) && (SOC_UART_HP_NUM > 2)

    config MB_UART_PORT_NUM
        int "UART port number"
        range 0 2 if MB_UART_PORT_TWO
        default 2 if MB_UART_PORT_TWO
        range 0 1 if MB_UART_PORT_ONE
        default 1 if MB_UART_PORT_ONE
        help
            UART communication port number for Modbus example.

    config MB_UART_BAUD_RATE
        int "UART communication speed"
        range 1200 115200
        default 115200
        help
            UART communication speed for Modbus example.

    config MB_UART_RXD
        int "UART RXD pin number"
        range ENV_GPIO_RANGE_MIN ENV_GPIO_IN_RANGE_MAX
        default 22 if IDF_TARGET_ESP32 || IDF_TARGET_ESP32C6 || IDF_TARGET_ESP32P4
        default 8 if IDF_TARGET_ESP32S2 || IDF_TARGET_ESP32S3 || IDF_TARGET_ESP32C3 ||\
            IDF_TARGET_ESP32C2 || IDF_TARGET_ESP32H2 || IDF_TARGET_ESP32C5
        help
            GPIO number for UART RX pin. See UART documentation for more information
            about available pin numbers for UART.

    config MB_UART_TXD
        int "UART TXD pin number"
        range ENV_GPIO_RANGE_MIN ENV_GPIO_OUT_RANGE_MAX
        default 23 if IDF_TARGET_ESP32 || IDF_TARGET_ESP32C6 || IDF_TARGET_ESP32P4
        default 9 if IDF_TARGET_ESP32S2 || IDF_TARGET_ESP32S3 || IDF_TARGET_ESP32C3 ||\
            IDF_TARGET_ESP32C2 || IDF_TARGET_ESP32H2 || IDF_TARGET_ESP32C5
        help
            GPIO number for UART TX pin. See UART documentation for more information
            about available pin numbers for UART.

    config MB_UART_RTS
        int "UART RTS pin number"
        range ENV_GPIO_RANGE_MIN ENV_GPIO_OUT_RANGE_MAX
        default 20 if IDF_TARGET_ESP32P4
        default 18 if IDF_TARGET_ESP32 || IDF_TARGET_ESP32C6
        default 10 if IDF_TARGET_ESP32S2 || IDF_TARGET_ESP32S3 || IDF_TARGET_ESP32C3 ||\
            IDF_TARGET_ESP32C2 || IDF_TARGET_ESP32H2 || IDF_TARGET_ESP32C5
        help
            GPIO number for UART RTS pin. This pin is connected to
            ~RE/DE pin of RS485 transceiver to switch direction.
            See UART documentation for more information about available pin
            numbers for UART.

    choice MB_COMM_MODE
        prompt "Modbus communication mode"
        default MB_COMM_MODE_RTU if CONFIG_FMB_COMM_MODE_RTU_EN
        help
            Selection of Modbus communication mode option for Modbus.

        config MB_COMM_MODE_RTU
            bool "RTU mode"
            depends on FMB_COMM_MODE_RTU_EN

        config MB_COMM_MODE_ASCII
            bool "ASCII mode"
            depends on FMB_COMM_MODE_ASCII_EN

    endchoice

    config MB_SLAVE_ADDR
        int "Modbus slave address"
        range 1 127
        default 1
        help
            This is the Modbus slave address in the network.
            It is used to organize Modbus network with several slaves connected into the same segment.


endmenu
```

## examples/protocols/modbus/serial/mb_slave/sdkconfig.defaults
```kconfig
#
# Modbus configuration
#
CONFIG_MB_COMM_MODE_ASCII=y
CONFIG_MB_SLAVE_ADDR=1
CONFIG_MB_UART_BAUD_RATE=115200
CONFIG_FMB_TIMER_PORT_ENABLED=y
CONFIG_FMB_TIMER_USE_ISR_DISPATCH_METHOD=y
```

## examples/protocols/modbus/tcp/mb_tcp_slave/main/Kconfig.projbuild
```kconfig
menu "Modbus Example Configuration"

    config MB_SLAVE_ADDR
        int "Modbus slave address"
        range 1 255
        default 1
        help
            This is the Modbus slave address in the network.
            The address is used as an index to resolve slave ip address.

    config MB_MDNS_IP_RESOLVER
        bool "Resolve slave addresses using mDNS service"
        default y
        help
            This option allows to use mDNS service to resolve IP addresses of the Modbus slaves.
            If the option is disabled the ip addresses of slaves are defined in static table.

endmenu
```

## examples/protocols/modbus/tcp/mb_tcp_slave/sdkconfig.defaults
```kconfig
#
# Modbus configuration
#
CONFIG_FMB_COMM_MODE_TCP_EN=y
CONFIG_FMB_TCP_PORT_DEFAULT=502
CONFIG_FMB_TCP_CONNECTION_TOUT_SEC=20
CONFIG_FMB_PORT_TASK_STACK_SIZE=4096
CONFIG_FMB_PORT_TASK_PRIO=10
CONFIG_FMB_COMM_MODE_RTU_EN=n
CONFIG_FMB_COMM_MODE_ASCII_EN=n
CONFIG_FMB_MASTER_TIMEOUT_MS_RESPOND=1000
CONFIG_FMB_MASTER_DELAY_MS_CONVERT=300
CONFIG_FMB_TIMER_PORT_ENABLED=y
CONFIG_MB_MDNS_IP_RESOLVER=n
CONFIG_MB_SLAVE_ADDR=1
CONFIG_LOG_DEFAULT_LEVEL_DEBUG=y
CONFIG_EXAMPLE_CONNECT_IPV6=n
CONFIG_FMB_TIMER_USE_ISR_DISPATCH_METHOD=y
```

## examples/protocols/modbus_master/main/Kconfig.projbuild
```kconfig
menu "Modbus Example Configuration"

    config MB_UART_RXD
        int "UART RXD pin number"
        range 0 34
        default 22
        help
            GPIO number for UART RX pin. See UART documentation for more information
            about available pin numbers for UART.

    config MB_UART_TXD
        int "UART TXD pin number"
        range 0 34
        default 23
        help
            GPIO number for UART TX pin. See UART documentation for more information
            about available pin numbers for UART.

    config MB_UART_RTS
        int "UART RTS pin number"
        range 0 34
        default 18
        help
            GPIO number for UART RTS pin. This pin is connected to
            ~RE/DE pin of RS485 transceiver to switch direction.

endmenu
```

## examples/protocols/modbus_master/sdkconfig.defaults
```kconfig
#
# Modbus configuration
#
CONFIG_FMB_TIMER_PORT_ENABLED=y
CONFIG_FMB_TIMER_GROUP=0
CONFIG_FMB_TIMER_INDEX=0
CONFIG_FMB_TIMER_ISR_IN_IRAM=y
CONFIG_FMB_MASTER_DELAY_MS_CONVERT=200
CONFIG_FMB_MASTER_TIMEOUT_MS_RESPOND=150
CONFIG_MB_UART_RXD=22
CONFIG_MB_UART_TXD=23
CONFIG_MB_UART_RTS=18
```

## examples/protocols/modbus_slave/sdkconfig.defaults
```kconfig
#
# Modbus configuration
#
CONFIG_MB_UART_RXD=22
CONFIG_MB_UART_TXD=23
CONFIG_MB_UART_RTS=18
CONFIG_FMB_TIMER_PORT_ENABLED=y
CONFIG_FMB_TIMER_GROUP=0
CONFIG_FMB_TIMER_INDEX=0
CONFIG_FMB_TIMER_ISR_IN_IRAM=y
```

## examples/protocols/mqtt/custom_outbox/sdkconfig.defaults
```kconfig
CONFIG_MQTT_CUSTOM_OUTBOX=y
CONFIG_COMPILER_CXX_EXCEPTIONS=y
CONFIG_COMPILER_OPTIMIZATION_SIZE=y
```

## examples/protocols/mqtt/main/Kconfig.projbuild
```kconfig
menu "Example Configuration"

    choice EXAMPLE_CERT_VALIDATION
        prompt "Certificate validation method"
        default EXAMPLE_CERT_VALIDATE_BUNDLE
        help
            Choose how the broker's TLS server certificate is validated.
            - Certificate bundle (default).
            - Embedded certificate

        config EXAMPLE_CERT_VALIDATE_BUNDLE
            bool "Certificate bundle"

        config EXAMPLE_CERT_VALIDATE_MOSQUITTO_CA
            bool "Embedded Certificate"

    endchoice

    config EXAMPLE_MQTT_BROKER_URI
        string "MQTT broker URI"
        default "mqtts://test.mosquitto.org:8886"
        default "mqtts://test.mosquitto.org:8883" if EXAMPLE_CERT_VALIDATE_MOSQUITTO_CA
        help
            URI to the MQTT broker.
            When using the example broker the port must be set to 8883 if testing
            embedded certificate

    config EXAMPLE_BROKER_CERTIFICATE_OVERRIDE
        string "Broker certificate override (PEM body)"
        default ""
        help
            Optional: override server certificate by embedding a PEM constructed
            from this base64 body. Leave empty to use the certificate bundle or the
            embedded Mosquitto CA. Provide only the base64 payload without the
            BEGIN/END markers.

    config EXAMPLE_BROKER_CERTIFICATE_OVERRIDDEN
        bool
        default y if EXAMPLE_BROKER_CERTIFICATE_OVERRIDE != ""

endmenu
```

## examples/protocols/mqtt/publish_test/main/Kconfig.projbuild
```kconfig
menu "Example Configuration"

    config EXAMPLE_BROKER_SSL_URI
        string "Broker SSL URL"
        default "mqtts://mqtt.eclipse.org:8883"
        help
            URL of an mqtt broker for ssl transport

    config EXAMPLE_BROKER_TCP_URI
        string "Broker TCP URL"
        default "mqtt://mqtt.eclipse.org:1883"
        help
            URL of an mqtt broker for tcp transport

    config EXAMPLE_BROKER_WS_URI
        string "Broker WS URL"
        default "ws://mqtt.eclipse.org:80/mqtt"
        help
            URL of an mqtt broker for ws transport

    config EXAMPLE_BROKER_WSS_URI
        string "Broker WSS URL"
        default "wss://mqtt.eclipse.org:443/mqtt"
        help
            URL of an mqtt broker for wss transport

    config EXAMPLE_PUBLISH_TOPIC
        string "publish topic"
        default "/topic/publish/esp2py"
        help
            topic to which esp32 client publishes

    config EXAMPLE_SUBSCIBE_TOPIC
        string "subscribe topic"
        default "/topic/subscribe/py2esp"
        help
            topic to which esp32 client subsribes (and expects data)

    config EXAMPLE_BROKER_CERTIFICATE_OVERRIDE
        string "Broker certificate override"
        default ""
        help
            Please leave empty if broker certificate included from a textfile; otherwise fill in a base64 part of PEM
            format certificate

    config EXAMPLE_BROKER_CERTIFICATE_OVERRIDDEN
        bool
        default y if EXAMPLE_BROKER_CERTIFICATE_OVERRIDE != ""

endmenu
```

## examples/protocols/mqtt/sdkconfig.defaults
```kconfig
# Enable the built-in certificate bundle for TLS server verification
CONFIG_MBEDTLS_CERTIFICATE_BUNDLE=y
CONFIG_MBEDTLS_CERTIFICATE_BUNDLE_DEFAULT_FULL=y
```

## examples/protocols/mqtt/ssl/main/Kconfig.projbuild
```kconfig
menu "Example Configuration"

    config BROKER_URI
        string "Broker URL"
        default "mqtts://mqtt.eclipse.org:8883"
        help
            URL of an mqtt broker which this example connects to.

    config BROKER_CERTIFICATE_OVERRIDE
        string "Broker certificate override"
        default ""
        help
            Please leave empty if broker certificate included from a textfile; otherwise fill in a base64 part of PEM
            format certificate

    config BROKER_CERTIFICATE_OVERRIDDEN
        bool
        default y if BROKER_CERTIFICATE_OVERRIDE != ""

    config BROKER_BIN_SIZE_TO_SEND
        # This option is not visible and is used only to set parameters for example tests
        # Here we configure the data size to send and to be expected in the python script
        int
        default 20000

endmenu
```

## examples/protocols/mqtt/ssl_ds/sdkconfig.defaults
```kconfig
CONFIG_PARTITION_TABLE_CUSTOM=y
# Setting partition table offset to 0xC000 would make the address of
# `esp_secure_cert` partition as 0xD000 (comes next in the sequence).
# Modules that are programmed with  Espressif Secure Pre Provisioining service
# uses this offset for `esp_secure_cert` and hence this change aligns this example
# to work on those modules.
CONFIG_PARTITION_TABLE_OFFSET=0xC000
```

## examples/protocols/mqtt/tcp/main/Kconfig.projbuild
```kconfig
menu "Example Configuration"

    config BROKER_URL
        string "Broker URL"
        default "mqtt://mqtt.eclipseprojects.io"
        help
            URL of the broker to connect to

    config BROKER_URL_FROM_STDIN
        bool
        default y if BROKER_URL = "FROM_STDIN"

endmenu
```

## examples/protocols/mqtt/tcp/sdkconfig.defaults
```kconfig
CONFIG_BROKER_URL="FROM_STDIN"
CONFIG_LOG_DEFAULT_LEVEL_NONE=
CONFIG_LOG_DEFAULT_LEVEL_ERROR=
CONFIG_LOG_DEFAULT_LEVEL_WARN=
CONFIG_LOG_DEFAULT_LEVEL_INFO=
CONFIG_LOG_DEFAULT_LEVEL_DEBUG=y
CONFIG_LOG_DEFAULT_LEVEL_VERBOSE=
```

## examples/protocols/mqtt/ws/main/Kconfig.projbuild
```kconfig
menu "Example Configuration"

    config BROKER_URI
        string "Broker URL"
        default "ws://mqtt.eclipseprojects.io:80/mqtt"
        help
            URL of an mqtt broker which this example connects to.

endmenu
```
