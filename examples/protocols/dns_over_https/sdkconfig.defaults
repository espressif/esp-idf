## examples/protocols/esp_http_client/main/Kconfig.projbuild
```kconfig
menu "Example Configuration"
    config EXAMPLE_HTTP_ENDPOINT
        string "Example HTTP Endpoint"
        default "httpbin.org"
        help
            Target endpoint host-name for the example to use.
    config EXAMPLE_ENABLE_RESPONSE_BUFFER_DUMP
        bool "Enable logging response buffer from HTTP event handler"
        default n
        help
            HTTP response is accumulated in output_buffer. Enable this config to print the accumulated response
endmenu
```

## examples/protocols/esp_http_client_mutual_auth/main/Kconfig.projbuild
```kconfig
menu "Example Configuration"
    config EXAMPLE_MUTUAL_AUTH_USE_HW_RSA_DS
        bool "Use DS peripheral for client authentication" if SOC_DIG_SIGN_SUPPORTED
        default n
        help
            When enabled, the client private key is held by the DS (Digital Signature)
            peripheral. The client certificate and DS context are loaded from the
            esp_secure_cert partition at runtime. Requires provisioning; see the README.

            When disabled (default), the client certificate and private key are embedded
            in the firmware as PEM files from main/certs/.
endmenu
```

## examples/protocols/esp_local_ctrl/main/Kconfig.projbuild
```kconfig
menu "Example Configuration"

    choice EXAMPLE_LOCAL_CTRL_TRANSPORT
        bool "Local Control Transport"
        default EXAMPLE_LOCAL_CTRL_TRANSPORT_HTTP
        default EXAMPLE_LOCAL_CTRL_TRANSPORT_BLE if SOC_BT_SUPPORTED
        help
            Local Control component offers both, HTTP/S and BLE transports. Choose any one.

        config EXAMPLE_LOCAL_CTRL_TRANSPORT_HTTP
            bool "HTTP/S"
            select LWIP_IPV4

        config EXAMPLE_LOCAL_CTRL_TRANSPORT_BLE
            bool "BLE"
            select BT_ENABLED
            depends on SOC_BT_SUPPORTED
    endchoice

    choice EXAMPLE_PROTOCOMM_SECURITY_VERSION
        bool "Protocomm security version"
        default EXAMPLE_PROTOCOMM_SECURITY_VERSION_2
        help
            Local Control component offers 3 security versions.
            The example offers a choice between security version 0, 1 and 2.

        config EXAMPLE_PROTOCOMM_SECURITY_VERSION_0
            bool "Security Version 0"
            select ESP_PROTOCOMM_SUPPORT_SECURITY_VERSION_0

        config EXAMPLE_PROTOCOMM_SECURITY_VERSION_1
            bool "Security version 1"
            select ESP_PROTOCOMM_SUPPORT_SECURITY_VERSION_1

        config EXAMPLE_PROTOCOMM_SECURITY_VERSION_2
            bool "Security version 2"
            select ESP_PROTOCOMM_SUPPORT_SECURITY_VERSION_2
    endchoice

    choice EXAMPLE_PROTOCOMM_SEC2_MODE
        bool "Security version 2 mode"
        depends on EXAMPLE_PROTOCOMM_SECURITY_VERSION_2
        default EXAMPLE_PROTOCOMM_SEC2_DEV_MODE

        config EXAMPLE_PROTOCOMM_SEC2_DEV_MODE
            bool "Security version 2 development mode"
            depends on EXAMPLE_PROTOCOMM_SECURITY_VERSION_2
            help
                This enables the development mode for
                security version 2.
                Please note that this mode is NOT recommended for production purpose.

        config EXAMPLE_PROTOCOMM_SEC2_PROD_MODE
            bool "Security version 2 production mode"
            depends on EXAMPLE_PROTOCOMM_SECURITY_VERSION_2
            help
                This enables the production mode for
                security version 2.
    endchoice

    config EXAMPLE_LOCAL_CTRL_USING_BLUEDROID
        bool
        depends on (BT_BLUEDROID_ENABLED && !IDF_TARGET_ESP32)
        select BT_BLE_42_FEATURES_SUPPORTED
        default y
        help
            This enables BLE 4.2 features for Bluedroid which are required for
            the API definitions that are present in the esp_gap_ble_api header.

endmenu
```

## examples/protocols/esp_local_ctrl/sdkconfig.defaults.esp32h2
```kconfig
# Override some defaults so BT stack is enabled and
CONFIG_BT_ENABLED=y
CONFIG_BT_NIMBLE_ENABLED=y

CONFIG_EXAMPLE_LOCAL_CTRL_TRANSPORT_BLE=y
```

## examples/protocols/http2_request/sdkconfig.defaults
```kconfig
# Defaults for generating a new "sdkconfig" file (project settings).
# https://docs.espressif.com/projects/esp-idf/en/latest/esp32/api-guides/build-system.html#custom-sdkconfig-defaults
#
# NOTE - if this file changes, to get new defaults, you must erase any existing
# "sdkconfig" file (this will undo manual settings from "idf.py menuconfig").

CONFIG_MBEDTLS_CERTIFICATE_BUNDLE_DEFAULT_CMN=y
```

## examples/protocols/http_server/async_handlers/main/Kconfig.projbuild
```kconfig
menu "Example Configuration"

    config EXAMPLE_MAX_ASYNC_REQUESTS
        int "Max Simultaneous Requests"
        default 2
        help
            The maximum number of simultaneous async requests that the
            web server can handle.

    config EXAMPLE_ASYNC_WORKER_TASK_STACK_SIZE
        int "Async Worker Task Stack Size"
        default 2560
        help
            The stack size allocated for each async worker task.

endmenu
```

## examples/protocols/http_server/captive_portal/main/Kconfig.projbuild
```kconfig
menu "Example Configuration"

    config ESP_WIFI_SSID
        string "SoftAP SSID"
        default "esp32_ssid"
        help
            SSID (network name) to set up the softAP with.

    config ESP_WIFI_PASSWORD
        string "SoftAP Password"
        default "esp32_pwd"
        help
            WiFi password (WPA or WPA2) for the example to use for the softAP.

    config ESP_MAX_STA_CONN
        int "Maximal STA connections"
        default 4
        range 1 4 if IDF_TARGET_ESP32C2
        range 1 15
        help
            Maximum number of STAs allowed to connect to the soft-AP (wifi_config_t.ap.max_connection).
            Upper bound matches ESP_WIFI_MAX_CONN_NUM in esp_wifi_types_native.h:
            1-4 on ESP32-C2, 1-15 on other Wi-Fi chips.
            Soft-AP and ESP-NOW share encryption keys; see Wi-Fi driver documentation
            if ESP-NOW is enabled.

    config ESP_ENABLE_DHCP_CAPTIVEPORTAL
        bool "DHCP Captive portal"
        default y
        help
            Enables more modern DHCP-based Option 114 to provide clients with the captive portal URI
endmenu
```

## examples/protocols/http_server/file_serving/main/Kconfig.projbuild
```kconfig
menu "HTTP file_serving example menu"

    config EXAMPLE_MOUNT_SD_CARD
        bool "Use SD card for file storage"
        default n
        help
            If this config item is set, the file you upload to server can be chosen to save in the SDcard.

    config EXAMPLE_FORMAT_IF_MOUNT_SDCARD_FAILED
        bool "Format the card if mount failed"
        default n
        depends on EXAMPLE_MOUNT_SD_CARD
        help
            If this config item is set, the card will be formatted if mount has failed.

    config EXAMPLE_USE_SDMMC_HOST
        bool "Use SDMMC host"
        default y
        depends on EXAMPLE_MOUNT_SD_CARD && SOC_SDMMC_HOST_SUPPORTED
        help
            If this config item is set, SDMMC is used to mount the SDcard.
            Otherwise, will use SPI host to access and mount the SDcard.

    menu "SD card pin configuration (SPI)"
        depends on EXAMPLE_MOUNT_SD_CARD && !EXAMPLE_USE_SDMMC_HOST

        config EXAMPLE_PIN_MOSI
            int "MOSI GPIO number"
            default 15 if IDF_TARGET_ESP32
            default 35 if IDF_TARGET_ESP32S2
            default 35 if IDF_TARGET_ESP32S3
            default 4  # C3 and others

        config EXAMPLE_PIN_MISO
            int "MISO GPIO number"
            default 2 if IDF_TARGET_ESP32
            default 37 if IDF_TARGET_ESP32S2
            default 37 if IDF_TARGET_ESP32S3
            default 6  # C3 and others

        config EXAMPLE_PIN_CLK
            int "CLK GPIO number"
            default 14 if IDF_TARGET_ESP32
            default 36 if IDF_TARGET_ESP32S2
            default 36 if IDF_TARGET_ESP32S3
            default 5  # C3 and others

        config EXAMPLE_PIN_CS
            int "CS GPIO number"
            default 13 if IDF_TARGET_ESP32
            default 34 if IDF_TARGET_ESP32S2
            default 34 if IDF_TARGET_ESP32S3
            default 1  # C3 and others

    endmenu

    menu "SD card pin configuration (SDMMC)"
        depends on EXAMPLE_USE_SDMMC_HOST && SOC_SDMMC_USE_GPIO_MATRIX

        config EXAMPLE_PIN_CMD
            int "CMD GPIO number"
            default 35 if IDF_TARGET_ESP32S3
            default 1

        config EXAMPLE_PIN_CLK
            int "CLK GPIO number"
            default 36 if IDF_TARGET_ESP32S3
            default 2

        config EXAMPLE_PIN_D0
            int "D0 GPIO number"
            default 37 if IDF_TARGET_ESP32S3
            default 3

        config EXAMPLE_PIN_D1
            int "D1 GPIO number"
            default 38 if IDF_TARGET_ESP32S3
            default 4

        config EXAMPLE_PIN_D2
            int "D2 GPIO number"
            default 33 if IDF_TARGET_ESP32S3
            default 5

        config EXAMPLE_PIN_D3
            int "D3 GPIO number"
            default 34 if IDF_TARGET_ESP32S3
            default 6

    endmenu

    config EXAMPLE_HTTPD_CONN_CLOSE_HEADER
        bool "Send connection close header from request handlers"
        default y
        help
            If this config item is set, Connection: close header will be set in handlers.
            This closes HTTP connection and frees the server socket instantly.
endmenu
```

## examples/protocols/http_server/file_serving/sdkconfig.defaults
```kconfig
CONFIG_PARTITION_TABLE_CUSTOM=y
CONFIG_PARTITION_TABLE_CUSTOM_FILENAME="partitions_example.csv"
CONFIG_PARTITION_TABLE_FILENAME="partitions_example.csv"
CONFIG_HTTPD_MAX_REQ_HDR_LEN=1024
```

## examples/protocols/http_server/file_serving/sdkconfig.defaults.esp32c5
```kconfig
CONFIG_PARTITION_TABLE_CUSTOM=y
CONFIG_PARTITION_TABLE_CUSTOM_FILENAME="partitions_example_c5.csv"
CONFIG_PARTITION_TABLE_FILENAME="partitions_example_c5.csv"
CONFIG_ESPTOOLPY_FLASHSIZE_4MB=y
CONFIG_ESPTOOLPY_FLASHSIZE="4MB"
```

## examples/protocols/http_server/persistent_sockets/main/Kconfig.projbuild
```kconfig
menu "Example Configuration"

    config EXAMPLE_SESSION_CTX_HANDLERS
        bool "Update session ctx from another handler"
        default n
        help
            Feature to show how session ctx can be manipulated by other handlers.

endmenu
```

## examples/protocols/http_server/restful_server/main/Kconfig.projbuild
```kconfig
menu "Example Configuration"

    config EXAMPLE_MDNS_HOST_NAME
        string "mDNS Host Name"
        default "dashboard"
        help
            Specify the domain name used in the mDNS service.
            Note that webpage also take it as a part of URL where it will send GET/POST requests to.

    config EXAMPLE_WEB_MOUNT_POINT
        string "Website mount point in VFS"
        default "/www"
        help
            Specify the mount point in VFS.

    config EXAMPLE_DEPLOY_WEB_PAGES
        bool "Deploy web pages to device's filesystem"
        default n
        help
            If enabled, the example will deploy web pages to the device's filesystem.
            Ensure that the necessary files (html, css, js, etc.) are available in the `front/web-demo/dist` directory.
endmenu
```

## examples/protocols/http_server/restful_server/sdkconfig.defaults
```kconfig
CONFIG_SPIFFS_OBJ_NAME_LEN=64
CONFIG_FATFS_LFN_HEAP=y
CONFIG_ESPTOOLPY_FLASHSIZE_4MB=y
CONFIG_PARTITION_TABLE_CUSTOM=y
CONFIG_PARTITION_TABLE_CUSTOM_FILENAME="partitions_example.csv"
CONFIG_PARTITION_TABLE_FILENAME="partitions_example.csv"
```

## examples/protocols/http_server/simple/main/Kconfig.projbuild
```kconfig
menu "Example Configuration"

    config EXAMPLE_BASIC_AUTH
        bool "Basic Authentication"
        default n
        help
            Basic Authentication is a method for an HTTP user agent (e.g. a web browser)
            to provide a user name and password when making a request. It is the simplest
            technique for enforcing access controls to web resources. because it doesn't
            require cookies, session identifiers, or login pages; rather, it uses standard
            fields in the HTTP header.
            Note that, Basic Authentication is not encrypted channel and also easy to retrieve
            credentials as they are sent in plain text format.

    config EXAMPLE_BASIC_AUTH_USERNAME
        string "Basic Authenticate User Name"
        depends on EXAMPLE_BASIC_AUTH
        default "ESP32"
        help
            The client's user name which used for basic authenticate.

    config EXAMPLE_BASIC_AUTH_PASSWORD
        string "Basic Authenticate Password"
        depends on EXAMPLE_BASIC_AUTH
        default "ESP32Webserver"
        help
            The client's password which used for basic authenticate.

endmenu
```

## examples/protocols/https_request/main/Kconfig.projbuild
```kconfig
menu "Example Configuration"

    config EXAMPLE_USING_ESP_TLS_MBEDTLS
        bool
        depends on ESP_TLS_USING_MBEDTLS
        default y

    config EXAMPLE_CLIENT_SESSION_TICKETS
        bool "Enable Client session ticket support"
        default n
        select ESP_TLS_CLIENT_SESSION_TICKETS
        help
            Enable the client session ticket support for the example.

    config EXAMPLE_LOCAL_SERVER_URL
        string "Local Server URL for testing session tickets"
        default "https://192.168.0.106:8070"
        depends on EXAMPLE_CLIENT_SESSION_TICKETS
        help
            The url of the server to which the example is going to connect in order to test the session ticket support.

    config EXAMPLE_LOCAL_SERVER_URL_FROM_STDIN
        bool
        default y if EXAMPLE_LOCAL_SERVER_URL = "FROM_STDIN"

endmenu
```

## examples/protocols/https_request/sdkconfig.defaults
```kconfig
CONFIG_MBEDTLS_HAVE_TIME_DATE=y
CONFIG_LWIP_DNS_DYNAMIC_SORT=y
CONFIG_LWIP_IPV6_AUTOCONFIG=y
CONFIG_LWIP_IPV6_DHCP6=y
CONFIG_LWIP_IPV6_RDNSS_MAX_DNS_SERVERS=2
CONFIG_LWIP_SNTP_MAX_SERVERS=2
CONFIG_PARTITION_TABLE_SINGLE_APP_LARGE=y
```

## examples/protocols/https_server/simple/main/Kconfig.projbuild
```kconfig
menu "Example Configuration"

    config EXAMPLE_ENABLE_HTTPS_USER_CALLBACK
        bool "Enable user callback with HTTPS Server"
        help
            Enable user callback for esp_https_server which can be used to get SSL context (connection information)
            E.g. Certificate of the connected client

    config EXAMPLE_ENABLE_SKIP_CLIENT_CERT
        bool "Skip client certificate (WARNING: ONLY FOR TESTING PURPOSE, READ HELP)"
        default n
        select ESP_TLS_SERVER_MIN_AUTH_MODE_OPTIONAL
        help
            Allow clients to connect without providing a client certificate.
            This is useful for testing purposes. When enabled, the server request
            client certificates but does not require them for the connection to be established.
            If a client certificate is provided, it will be verified.

endmenu
```
