## examples/network/wifi_eth_usb_bridge/main/Kconfig.projbuild
```kconfig
menu "Example Configuration"

    choice EXAMPLE_WIFI_CONFIGURATION
        prompt "WiFi configuration"
        default EXAMPLE_WIFI_CONFIGURATION_MANUAL
        help
            Choose how the WiFi settings should be configured.

        config EXAMPLE_WIFI_CONFIGURATION_MANUAL
            bool
            prompt "Manual configuration via http server"
        config EXAMPLE_WIFI_CONFIGURATION_PROVISIONING
            bool
            prompt "Using unified provisioning"
    endchoice

endmenu
```

## examples/network/wifi_eth_usb_bridge/sdkconfig.defaults
```kconfig
#
# USB Network Class (NCM)
#
CONFIG_TINYUSB_NCM_ENABLE=y
# end of USB Network Class (NCM)
```

## examples/openthread/extension_command/Kconfig.projbuild
```kconfig
menu "OpenThread Extension CLI"

    menuconfig OPENTHREAD_CLI_ESP_EXTENSION
        depends on OPENTHREAD_FTD || OPENTHREAD_MTD
        bool "Enable Espressif's extended features"
        default y
        help
            Enable Espressif's extended features.

    config OPENTHREAD_CLI_IPERF
        bool "Enable iperf command"
        depends on OPENTHREAD_CLI_ESP_EXTENSION
        default y

    config OPENTHREAD_CLI_TCP_SOCKET
        bool "Enable TCP socket command"
        depends on OPENTHREAD_CLI_ESP_EXTENSION
        default y

    config OPENTHREAD_CLI_TCP_SERVER_PORT
        int "the port of TCP server"
        default 12345
        depends on OPENTHREAD_CLI_TCP_SOCKET
        help
            Set the connect port of socket

    config OPENTHREAD_CLI_UDP_SOCKET
        bool "Enable UDP socket command"
        depends on OPENTHREAD_CLI_ESP_EXTENSION
        default y

    config OPENTHREAD_CLI_UDP_SERVER_PORT
        int "the port of UDP server"
        default 54321
        depends on OPENTHREAD_CLI_UDP_SOCKET
        help
            Set the connect port of socket

    config OPENTHREAD_CLI_WIFI
        bool "Enable wifi connection command"
        depends on OPENTHREAD_CLI_ESP_EXTENSION && OPENTHREAD_BORDER_ROUTER
        default y

endmenu
```

## examples/openthread/ot_br/main/Kconfig.projbuild
```kconfig
menu "OpenThread Border Router Example"

    config OPENTHREAD_SUPPORT_HW_RESET_RCP
        bool 'Enable hardware RCP resetting'
        default n
        help
            If enabled, the Thread Border Router will support hardware resetting the RCP
            when processing RCP failure.

    config OPENTHREAD_HW_RESET_RCP_PIN
        int 'Pin to RCP reset'
        depends on OPENTHREAD_SUPPORT_HW_RESET_RCP
        default 7

endmenu
```

## examples/openthread/ot_br/sdkconfig.defaults.esp32p4
```kconfig
# Enable BR auto start for Ethernet builds
CONFIG_OPENTHREAD_NETWORK_AUTO_START=y
CONFIG_OPENTHREAD_BORDER_ROUTER_AUTO_START=y

# Enable PPP support as a workaround to ensure LWIP thread-lib compatibility for Ethernet builds
CONFIG_LWIP_PPP_SUPPORT=y
CONFIG_LWIP_PPP_SERVER_SUPPORT=y
```

## examples/openthread/ot_br/sdkconfig.defaults.esp32s2
```kconfig
#
# ESP PSRAM
#
CONFIG_SPIRAM=y
CONFIG_SPIRAM_ALLOW_BSS_SEG_EXTERNAL_MEMORY=y
# end of ESP PSRAM

#
# OpenThread
#
CONFIG_OPENTHREAD_PLATFORM_MSGPOOL_MANAGEMENT=y
# end of OpenThread
```

## examples/openthread/ot_cli/main/Kconfig.projbuild
```kconfig
menu "OpenThread CLI Example"

    config OPENTHREAD_AUTO_START
        bool 'Enable the automatic start mode.'
        default False
        help
            If enabled, the Openthread Device will create or connect to thread network with pre-configured
            network parameters automatically. Otherwise, user need to configure Thread via CLI command manually.
endmenu
```

## examples/openthread/ot_cli/sdkconfig.defaults
```kconfig
#
# Partition Table
#
CONFIG_PARTITION_TABLE_CUSTOM=y
CONFIG_PARTITION_TABLE_CUSTOM_FILENAME="partitions.csv"
CONFIG_PARTITION_TABLE_FILENAME="partitions.csv"
CONFIG_PARTITION_TABLE_OFFSET=0x8000
CONFIG_PARTITION_TABLE_MD5=y
# end of Partition Table

#
# mbedTLS
#
CONFIG_MBEDTLS_CMAC_C=y
CONFIG_MBEDTLS_SSL_PROTO_DTLS=y
CONFIG_MBEDTLS_KEY_EXCHANGE_ECJPAKE=y
CONFIG_MBEDTLS_ECJPAKE_C=y
# end of mbedTLS

#
# OpenThread
#
CONFIG_OPENTHREAD_ENABLED=y
CONFIG_OPENTHREAD_BORDER_ROUTER=n
CONFIG_OPENTHREAD_DNS64_CLIENT=y
# end of OpenThread

#
# lwIP
#
CONFIG_LWIP_TCPIP_TASK_STACK_SIZE=4096
CONFIG_LWIP_IPV6_NUM_ADDRESSES=8
CONFIG_LWIP_MULTICAST_PING=y
CONFIG_LWIP_HOOK_IP6_SELECT_SRC_ADDR_CUSTOM=y
# end of lwIP
```

## examples/openthread/ot_cli/sdkconfig.defaults.esp32h2
```kconfig
#
# mbedTLS
#

# ESP32H2-TODO: enable HW acceleration
CONFIG_MBEDTLS_HARDWARE_AES=n
CONFIG_MBEDTLS_HARDWARE_MPI=n
CONFIG_MBEDTLS_HARDWARE_SHA=n
# end of mbedTLS

#
# OpenThread
#
CONFIG_OPENTHREAD_BORDER_ROUTER=n
# end of OpenThread

#
# IEEE 802.15.4
#
CONFIG_IEEE802154_ENABLED=y
# end of IEEE 802.15.4
```

## examples/openthread/ot_common_components/ot_examples_br/Kconfig.projbuild
```kconfig
menu "OpenThread Border Router Config"
    depends on OPENTHREAD_BORDER_ROUTER

    config OPENTHREAD_BORDER_ROUTER_AUTO_START
        depends on OPENTHREAD_BORDER_ROUTER
        bool 'Enable the border router auto start'
        default n
        help
            If enabled, the program will automatically connect to the backbone network and
            initialize the border router at startup.

endmenu
```

## examples/openthread/ot_common_components/ot_examples_common/Kconfig.projbuild
```kconfig
menu "Config for OpenThread Examples"
    depends on OPENTHREAD_ENABLED

    config OPENTHREAD_NETWORK_AUTO_START
        bool 'Enable the automatic start mode of Thread network.'
        depends on OPENTHREAD_FTD || OPENTHREAD_MTD
        default n
        help
            If enabled, the Openthread Device will create or connect to Thread network with pre-configured
            network parameters automatically. Otherwise, user need to configure Thread via CLI command manually.

    menu "External Console Commands"
        config OPENTHREAD_IPERF_CMD_ENABLE
            bool "Enable iperf command"
            depends on OPENTHREAD_FTD || OPENTHREAD_MTD
            default y
            help
                If enabled, iperf will be registered and available as a console command.
                This allows network performance testing using iperf over the Thread network.
    endmenu # External Console Commands

    menu "External coexist wire type and pin config"
        depends on ESP_COEX_EXTERNAL_COEXIST_ENABLE

        choice EXTERNAL_COEX_WORK_MODE
            prompt "The work mode of external coexist"
            default EXTERNAL_COEX_WORK_MODE_FOLLOWER if SOC_IEEE802154_SUPPORTED
            default EXTERNAL_COEX_WORK_MODE_LEADER if !SOC_IEEE802154_SUPPORTED && SOC_WIFI_SUPPORTED
            help
                Select work mode for external coexist, the work mode defined in esp_extern_coex_work_mode_t.

            config EXTERNAL_COEX_WORK_MODE_LEADER
                bool "Leader mode"
                help
                    Select this to set the external coexistence work mode to leader mode.

            config EXTERNAL_COEX_WORK_MODE_FOLLOWER
                bool "Follower mode"
                help
                    Select this to set the external coexistence work mode to follower mode.

            config EXTERNAL_COEX_WORK_MODE_UNKNOWN
                bool "Unknown mode"
                help
                    Select this to set the external coexistence work mode to unknown mode.
        endchoice

        config EXTERNAL_COEX_WIRE_TYPE
            int "The wire_type of external coexist"
            depends on ESP_COEX_EXTERNAL_COEXIST_ENABLE
            default 3
            range 0 3
            help
                Select wire_type for external coexist, the wire_type define in external_coex_wire_t.

        config EXTERNAL_COEX_REQUEST_PIN
            int "The number of external coexist request pin"
            depends on ESP_COEX_EXTERNAL_COEXIST_ENABLE && (EXTERNAL_COEX_WIRE_TYPE >= 0)
            default 0

        config EXTERNAL_COEX_GRANT_PIN
            int "The number of external coexist grant pin"
            depends on ESP_COEX_EXTERNAL_COEXIST_ENABLE && (EXTERNAL_COEX_WIRE_TYPE >= 1)
            default 1

        config EXTERNAL_COEX_PRIORITY_PIN
            int "The number of external coexist priority pin"
            depends on ESP_COEX_EXTERNAL_COEXIST_ENABLE && (EXTERNAL_COEX_WIRE_TYPE >= 2)
            default 2

        config EXTERNAL_COEX_TX_LINE_PIN
            int "The number of external coexist tx_line pin"
            depends on ESP_COEX_EXTERNAL_COEXIST_ENABLE && (EXTERNAL_COEX_WIRE_TYPE = 3)
            default 3
    endmenu # External coexist wire type and pin config

endmenu
```

## examples/openthread/ot_common_components/ot_led/Kconfig.projbuild
```kconfig
menu "OpenThread Device Role Indicator"

    orsource "$IDF_PATH/examples/common_components/env_caps/$IDF_TARGET/Kconfig.env_caps"

    config OPENTHREAD_STATE_INDICATOR_ENABLE
        depends on SOC_RMT_SUPPORTED
        bool 'Enable the LED for openthread deivce'
        default False
        help
            If enabled, the LED of ESP Openthread Device will display different colors based on the current role.

    config OPENTHREAD_STATE_INDICATOR_GPIO
        depends on OPENTHREAD_STATE_INDICATOR_ENABLE
        int "Blink GPIO number"
        range ENV_GPIO_RANGE_MIN ENV_GPIO_OUT_RANGE_MAX
        default 5 if IDF_TARGET_ESP32
        default 18 if IDF_TARGET_ESP32S2
        default 48 if IDF_TARGET_ESP32S3
        default 8
        help
            GPIO number (IOxx) to blink on and off the LED.
            Some GPIOs are used for other purposes (flash connections, etc.) and cannot be used to blink.

    menu "Indicator of Leader Device"
        config LEADER_INDICATOR_RED
            depends on OPENTHREAD_STATE_INDICATOR_ENABLE
            int "red config"
            range 0 255
            default 40
            help
                Red config of LED for OpenThread leader device

        config LEADER_INDICATOR_GREEN
            depends on OPENTHREAD_STATE_INDICATOR_ENABLE
            int "green config"
            range 0 255
            default 0
            help
                Red config of LED for OpenThread leader device

        config LEADER_INDICATOR_BLUE
            depends on OPENTHREAD_STATE_INDICATOR_ENABLE
            int "blue config"
            range 0 255
            default 0
            help
                Blue config of LED for OpenThread leader device
    endmenu

    menu "Indicator of Router Device"
        config ROUTER_INDICATOR_RED
            depends on OPENTHREAD_STATE_INDICATOR_ENABLE
            int "red config"
            range 0 255
            default 0
            help
                Red config of LED for OpenThread router device

        config ROUTER_INDICATOR_GREEN
            depends on OPENTHREAD_STATE_INDICATOR_ENABLE
            int "green config"
            range 0 255
            default 0
            help
                Green config of LED for OpenThread router device

        config ROUTER_INDICATOR_BLUE
            depends on OPENTHREAD_STATE_INDICATOR_ENABLE
            int "blue config"
            range 0 255
            default 40
            help
                Blue config of LED for OpenThread router device
    endmenu

    menu "Indicator of Child Device"
        config CHILD_INDICATOR_RED
            depends on OPENTHREAD_STATE_INDICATOR_ENABLE
            int "red config"
            range 0 255
            default 0
            help
                Red config of LED for OpenThread child device

        config CHILD_INDICATOR_GREEN
            depends on OPENTHREAD_STATE_INDICATOR_ENABLE
            int "green config"
            range 0 255
            default 40
            help
                Green config of LED for OpenThread child device

        config CHILD_INDICATOR_BLUE
            depends on OPENTHREAD_STATE_INDICATOR_ENABLE
            int "blue config"
            range 0 255
            default 0
            help
                Blue config of LED for OpenThread child device
    endmenu

    menu "Indicator of Detached Device"
        config DETACHED_INDICATOR_RED
            depends on OPENTHREAD_STATE_INDICATOR_ENABLE
            int "red config"
            range 0 255
            default 20
            help
                Red config of LED for OpenThread detached device

        config DETACHED_INDICATOR_GREEN
            depends on OPENTHREAD_STATE_INDICATOR_ENABLE
            int "green config"
            range 0 255
            default 20
            help
                Green config of LED for OpenThread detached device

        config DETACHED_INDICATOR_BLUE
            depends on OPENTHREAD_STATE_INDICATOR_ENABLE
            int "blue config"
            range 0 255
            default 20
            help
                Blue config of LED for OpenThread detached device
    endmenu

endmenu
```

## examples/openthread/ot_rcp/main/Kconfig.projbuild
```kconfig
menu "OpenThread RCP Example"

    config OPENTHREAD_UART_PIN_MANUAL
        bool "Configure RCP UART pin manually"
        default n
        help
            Select this to choose UART pin manually

    config OPENTHREAD_UART_RX_PIN
        int "The number of RX pin"
        depends on OPENTHREAD_UART_PIN_MANUAL
        default 4
        range 0 25

    config OPENTHREAD_UART_TX_PIN
        int "The number of TX pin"
        depends on OPENTHREAD_UART_PIN_MANUAL
        default 5
        range 0 25

    menu "External coexist wire type and pin config"
        config EXTERNAL_COEX_WIRE_TYPE
            int "The wire_type of external coexist"
            depends on ESP_COEX_EXTERNAL_COEXIST_ENABLE
            default 3
            range 0 3
            help
                Select wire_type for external coexist, the wire_type define in external_coex_wire_t.

        config EXTERNAL_COEX_REQUEST_PIN
            int "The number of external coexist request pin"
            depends on ESP_COEX_EXTERNAL_COEXIST_ENABLE && (EXTERNAL_COEX_WIRE_TYPE >= 0)
            default 0

        config EXTERNAL_COEX_GRANT_PIN
            int "The number of external coexist grant pin"
            depends on ESP_COEX_EXTERNAL_COEXIST_ENABLE && (EXTERNAL_COEX_WIRE_TYPE >= 1)
            default 1

        config EXTERNAL_COEX_PRIORITY_PIN
            int "The number of external coexist priority pin"
            depends on ESP_COEX_EXTERNAL_COEXIST_ENABLE && (EXTERNAL_COEX_WIRE_TYPE >= 2)
            default 2

        config EXTERNAL_COEX_TX_LINE_PIN
            int "The number of external coexist tx_line pin"
            depends on ESP_COEX_EXTERNAL_COEXIST_ENABLE && (EXTERNAL_COEX_WIRE_TYPE = 3)
            default 3
    endmenu # External coexist wire type and pin config
endmenu
```
