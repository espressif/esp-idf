## examples/openthread/ot_rcp/sdkconfig.defaults
```kconfig
#
# Partition Table
#
CONFIG_PARTITION_TABLE_CUSTOM=y
CONFIG_PARTITION_TABLE_CUSTOM_FILENAME="partitions.csv"
CONFIG_PARTITION_TABLE_FILENAME="partitions.csv"
CONFIG_PARTITION_TABLE_OFFSET=0x8000
CONFIG_PARTITION_TABLE_MD5=y
# end of Partition Table

#
# Wireless Coexistence
#
CONFIG_ESP_COEX_SW_COEXIST_ENABLE=n

#
# OpenThread
#
CONFIG_OPENTHREAD_ENABLED=y
CONFIG_OPENTHREAD_RADIO=y
CONFIG_OPENTHREAD_DIAG=n
CONFIG_OPENTHREAD_COMMISSIONER=n
CONFIG_OPENTHREAD_JOINER=n
CONFIG_OPENTHREAD_BORDER_ROUTER=n
CONFIG_OPENTHREAD_CLI=n
CONFIG_OPENTHREAD_SRP_CLIENT=n
CONFIG_OPENTHREAD_DNS_CLIENT=n
CONFIG_OPENTHREAD_TASK_SIZE=3072
CONFIG_OPENTHREAD_CONSOLE_ENABLE=n
# end of OpenThread


#
# Deprecated options for backward compatibility
#
CONFIG_BOOTLOADER_LOG_LEVEL_ERROR=y
CONFIG_BOOTLOADER_LOG_LEVEL_INFO=n
# End of deprecated options

#
# Configurations for optimizing the size of ot_rcp firmware
#
CONFIG_COMPILER_OPTIMIZATION_SIZE=y
CONFIG_COMPILER_OPTIMIZATION_ASSERTIONS_SILENT=y
CONFIG_COMPILER_OPTIMIZATION_CHECKS_SILENT=y
CONFIG_COMPILER_SAVE_RESTORE_LIBCALLS=y
CONFIG_ESP_ERR_TO_NAME_LOOKUP=n
CONFIG_ESP_SYSTEM_PANIC_SILENT_REBOOT=y
CONFIG_LOG_DEFAULT_LEVEL_NONE=y
CONFIG_LIBC_NEWLIB_NANO_FORMAT=y
CONFIG_OPENTHREAD_LOG_LEVEL_DYNAMIC=n
CONFIG_OPENTHREAD_LOG_LEVEL_NONE=y
CONFIG_OPENTHREAD_TIMING_OPTIMIZATION=y
CONFIG_FREERTOS_HZ=1000
```

## examples/openthread/ot_rcp/sdkconfig.defaults.debug
```kconfig
#
# Turn on RCP console, overriding default log level from sdkconfig.defaults
# We also increase the timeout for watchdog timer to account for large prints.
#
CONFIG_OPENTHREAD_RCP_SPINEL_CONSOLE=y
CONFIG_LOG_DEFAULT_LEVEL_INFO=y
CONFIG_ESP_TASK_WDT_TIMEOUT_S=10
CONFIG_IEEE802154_DEBUG=y
CONFIG_IEEE802154_PRINT_PHY_REG=y
```

## examples/openthread/ot_sleepy_device/deep_sleep/sdkconfig.defaults
```kconfig
#
# Partition Table
#
CONFIG_PARTITION_TABLE_CUSTOM=y
CONFIG_PARTITION_TABLE_CUSTOM_FILENAME="partitions.csv"
CONFIG_PARTITION_TABLE_FILENAME="partitions.csv"
# end of Partition Table

#
# mbedTLS
#
CONFIG_MBEDTLS_CMAC_C=y
CONFIG_MBEDTLS_SSL_PROTO_DTLS=y
CONFIG_MBEDTLS_KEY_EXCHANGE_ECJPAKE=y
CONFIG_MBEDTLS_ECJPAKE_C=y
# end of mbedTLS

#
# OpenThread
#
CONFIG_OPENTHREAD_ENABLED=y
CONFIG_OPENTHREAD_BORDER_ROUTER=n
CONFIG_OPENTHREAD_DNS64_CLIENT=y
# end of OpenThread

#
# lwIP
#
CONFIG_LWIP_TCPIP_TASK_STACK_SIZE=4096
CONFIG_LWIP_IPV6_NUM_ADDRESSES=8
CONFIG_LWIP_IPV4=n
CONFIG_LWIP_ND6=n
# end of lwIP

#
# IEEE 802.15.4
#
CONFIG_IEEE802154_ENABLED=y
# end of IEEE 802.15.4

#
# deep sleep
#
CONFIG_ULP_COPROC_ENABLED=y
CONFIG_ULP_COPROC_RESERVE_MEM=512
CONFIG_NEWLIB_TIME_SYSCALL_USE_RTC_HRT=y
CONFIG_RTC_CLK_SRC_INT_RC=y
CONFIG_BOOTLOADER_SKIP_VALIDATE_IN_DEEP_SLEEP=y
```

## examples/openthread/ot_sleepy_device/light_sleep/sdkconfig.defaults
```kconfig
#
# Partition Table
#
CONFIG_PARTITION_TABLE_CUSTOM=y
CONFIG_PARTITION_TABLE_CUSTOM_FILENAME="partitions.csv"
CONFIG_PARTITION_TABLE_FILENAME="partitions.csv"
# end of Partition Table

#
# mbedTLS
#
CONFIG_MBEDTLS_CMAC_C=y
CONFIG_MBEDTLS_SSL_PROTO_DTLS=y
CONFIG_MBEDTLS_KEY_EXCHANGE_ECJPAKE=y
CONFIG_MBEDTLS_ECJPAKE_C=y
# end of mbedTLS

#
# OpenThread
#
CONFIG_OPENTHREAD_ENABLED=y
CONFIG_OPENTHREAD_BORDER_ROUTER=n
CONFIG_OPENTHREAD_DNS64_CLIENT=y
CONFIG_OPENTHREAD_CLI=y
# end of OpenThread

#
# lwIP
#
CONFIG_LWIP_TCPIP_TASK_STACK_SIZE=4096
CONFIG_LWIP_IPV6_NUM_ADDRESSES=8
CONFIG_LWIP_IPV4=n
CONFIG_LWIP_ND6=n
# end of lwIP

#
# IEEE 802.15.4
#
CONFIG_IEEE802154_ENABLED=y
# end of IEEE 802.15.4

#
# light sleep
#
CONFIG_PM_ENABLE=y
CONFIG_FREERTOS_USE_TICKLESS_IDLE=y
CONFIG_PM_POWER_DOWN_PERIPHERAL_IN_LIGHT_SLEEP=y
CONFIG_IEEE802154_SLEEP_ENABLE=y
# Use 1000Hz freertos tick to lower sleep time threshold
CONFIG_FREERTOS_HZ=1000
CONFIG_ESP_SLEEP_POWER_DOWN_FLASH=y
# end of light sleep
```

## examples/performance/tcp_perf/main/Kconfig.projbuild
```kconfig
menu "Example Configuration"

#choice 
#   prompt "TCP_PERF_MODE "
#	default MODE_TCP_SHIELDBOX
#	help
#	    This option set performance mode.
#	    
#	    - Testing in shieldbox for "Performance in shieldbox" setting.
#		
#	    - Testing in air for "Performance in air" setting.
#	    		
#	    - Testing in long distance for "Performance in long distance" setting.
#		
#					
#config MODE_TCP_SHIELDBOX
#    bool "Performance in shieldbox"
#config MODE_TCP_AIR
#    bool "Performance in air"
#config MODE_TCP_LONG_DISTANCE
#    bool "Performance in long distance"
#endchoice

choice TCP_PERF_WIFI_MODE
    prompt "AP or STA"
    default TCP_PERF_ESP_IS_STATION
    help
        Whether the esp32 is softAP or station.

config TCP_PERF_ESP_IS_SOFTAP
    bool "SoftAP"
config TCP_PERF_ESP_IS_STATION
    bool "Station"
endchoice

config TCP_PERF_WIFI_MODE_AP
    bool
    default y if TCP_PERF_ESP_IS_SOFTAP
    default n if TCP_PERF_ESP_IS_STATION

choice TCP_PERF_SERVER_CLIENT
    prompt "server or client"
    default TCP_PERF_ESP_IS_CLIENT
    help
	Whether the esp32 is tcp server or client.
		
	We suggest to choose "client" if you choose "station" in "wifi mode".

config TCP_PERF_ESP_IS_SERVER
    bool "server"
config TCP_PERF_ESP_IS_CLIENT
    bool "client"
endchoice

config TCP_PERF_SERVER
    bool
    default y if TCP_PERF_ESP_IS_SERVER
    default n if TCP_PERF_ESP_IS_CLIENT

choice TCP_PERF_TX_RX
    prompt "send or receive"
    default TCP_PERF_ESP_RECV
    help
	Whether the esp32 will send or receive.

config TCP_PERF_ESP_SEND
    bool "send"
config TCP_PERF_ESP_RECV
    bool "receive"
endchoice

config TCP_PERF_TX
    bool
    default y if TCP_PERF_ESP_SEND
    default n if TCP_PERF_ESP_RECV

config TCP_PERF_DELAY_DEBUG
    bool "TCP performance delay info enable"
    depends on TCP_PERF_TX
    default n
    help
	Show TCP performance delay info.
		
	Ignore in TCP RX.

config TCP_PERF_WIFI_SSID
    string "WiFi SSID"
    default "esp_wifi_test1"
    help
	SSID (network name) for the example to connect to.

config TCP_PERF_WIFI_PASSWORD
    string "WiFi Password"
    default "1234567890"
    help
	WiFi password (WPA or WPA2) for the example to use.
		
config TCP_PERF_SERVER_PORT
    int "TCP server port"
    default 4567
    help 
	Which will the tcp server use.
				
config TCP_PERF_SERVER_IP
    string "TCP server ip"
    depends on TCP_PERF_ESP_IS_CLIENT
    default "192.168.4.1" 
    help
	IP of TCP server.
		
	Ignore in TCP server.
	
config TCP_PERF_PKT_SIZE
    int "Size of TCP packet"
    default 1460
    help
	the data send&recv packet size. 
		
endmenu
```

## examples/performance/udp_esp2ap/main/Kconfig.projbuild
```kconfig
menu "Example Configuration"

config WIFI_SSID
    string "WiFi SSID"
    default "tp_wifi_test1"
    help
        SSID (network name) for the example to connect to.

config WIFI_PASSWORD
    string "WiFi Password"
    default "1234567890"
    help
        WiFi password (WPA or WPA2) for the example to use.

config SEVER_PORT
	int "tcp sever port"
	default 4567
	help 
		which will the udp sever use.
	
config BUFF_SIZE
	int "buff size"
	default 1024
	help
		the data send&recv buff size. 

choice 
    prompt "test mode"
	default PERFORMANCE_MODE
	help
		This option performance mode.
	
		- for "udp receive" setting,it will receive data by udp.
		
		- for "udp send" setting, it will send data by udp.
		
config MODE_UDP_RECV
    bool "udp receive"
config MODE_UDP_SEND
    bool "udp send"
endchoice

endmenu
```

## examples/performance/udp_perf/main/Kconfig.projbuild
```kconfig
menu "Example Configuration"

#choice 
#   prompt "UDP_PERF_MODE "
#	default MODE_UDP_SHIELDBOX
#	help
#	    This option set performance mode.
#	    
#	    - Testing in shieldbox for "Performance in shieldbox" setting.
#		
#	    - Testing in air for "Performance in air" setting.
#	    		
#	    - Testing in long distance for "Performance in long distance" setting.
#		
#					
#config MODE_UDP_SHIELDBOX
#    bool "Performance in shieldbox"
#config MODE_UDP_AIR
#    bool "Performance in air"
#config MODE_UDP_LONG_DISTANCE
#    bool "Performance in long distance"
#endchoice
#

choice UDP_PERF_WIFI_MODE
    prompt "AP or STA"
    default UDP_PERF_ESP_IS_STATION
    help
        Whether the esp32 is softAP or station.

config UDP_PERF_ESP_IS_SOFTAP
    bool "SoftAP"
config UDP_PERF_ESP_IS_STATION
    bool "Station"
endchoice

config UDP_PERF_WIFI_MODE_AP
    bool
    default y if UDP_PERF_ESP_IS_SOFTAP
    default n if UDP_PERF_ESP_IS_STATION

choice UDP_PERF_SERVER_CLIENT
    prompt "server or client"
    default UDP_PERF_ESP_IS_CLIENT
    help
	Whether the esp32 is tcp server or client.
		
	We suggest to choose "client" if you choose "station" in "wifi mode".

config UDP_PERF_ESP_IS_SERVER
    bool "server"
config UDP_PERF_ESP_IS_CLIENT
    bool "client"
endchoice

config UDP_PERF_SERVER
    bool
    default y if UDP_PERF_ESP_IS_SERVER
    default n if UDP_PERF_ESP_IS_CLIENT

choice UDP_PERF_TX_RX
    prompt "send or receive"
    default UDP_PERF_ESP_RECV
    help
	Whether the esp32 will send or receive.

config UDP_PERF_ESP_SEND
    bool "send"
config UDP_PERF_ESP_RECV
    bool "receive"
endchoice

config UDP_PERF_TX
    bool
    default y if UDP_PERF_ESP_SEND
    default n if UDP_PERF_ESP_RECV


config UDP_PERF_WIFI_SSID
    string "WiFi SSID"
	default "esp_wifi_test1"
	help
	    SSID (network name) for the example to connect to.

config UDP_PERF_WIFI_PASSWORD
    string "WiFi Password"
	default "1234567890"
	help
	    WiFi password (WPA or WPA2) for the example to use.
		
config UDP_PERF_SERVER_PORT
    int "UDP server port"
	default 4567
	help 
	    Which will the udp server use.
				
config UDP_PERF_SERVER_IP
    string "UDP server ip"
	default "192.168.4.1" 
	help
	    IP of UDP server.
		
	    Ignore in UDP server.
	
config UDP_PERF_PKT_SIZE
    int "Size of UDP packet"
	default 1460
	help
	    the data send&recv packet size. 
		
endmenu
```

## examples/peripherals/adc2/main/Kconfig.projbuild
```kconfig
menu "Example Configuration"

    choice EXAMPLE_ADC2_CHANNEL
        bool "ADC2 Channel Num"
        default EXAMPLE_ADC2_CHANNEL_7
        help
            The channel of ADC2 used in this example.

        config EXAMPLE_ADC2_CHANNEL_0
            bool "ADC2 Channel 0 (GPIO 4)"
        config EXAMPLE_ADC2_CHANNEL_1
            bool "ADC2 Channel 1 (GPIO 0)"
        config EXAMPLE_ADC2_CHANNEL_2
            bool "ADC2 Channel 2 (GPIO 2)"
        config EXAMPLE_ADC2_CHANNEL_3
            bool "ADC2 Channel 3 (GPIO 15)"
        config EXAMPLE_ADC2_CHANNEL_4
            bool "ADC2 Channel 4 (GPIO 13)"
        config EXAMPLE_ADC2_CHANNEL_5
            bool "ADC2 Channel 5 (GPIO 12)"
        config EXAMPLE_ADC2_CHANNEL_6
            bool "ADC2 Channel 6 (GPIO 14)"
        config EXAMPLE_ADC2_CHANNEL_7
            bool "ADC2 Channel 7 (GPIO 27)"
        config EXAMPLE_ADC2_CHANNEL_8
            bool "ADC2 Channel 8 (GPIO 25)"
        config EXAMPLE_ADC2_CHANNEL_9
            bool "ADC2 Channel 9 (GPIO 26)"
    endchoice

    config EXAMPLE_ADC2_CHANNEL
        int
        default 0 if EXAMPLE_ADC2_CHANNEL_0
        default 1 if EXAMPLE_ADC2_CHANNEL_1
        default 2 if EXAMPLE_ADC2_CHANNEL_2
        default 3 if EXAMPLE_ADC2_CHANNEL_3
        default 4 if EXAMPLE_ADC2_CHANNEL_4
        default 5 if EXAMPLE_ADC2_CHANNEL_5
        default 6 if EXAMPLE_ADC2_CHANNEL_6
        default 7 if EXAMPLE_ADC2_CHANNEL_7
        default 8 if EXAMPLE_ADC2_CHANNEL_8
        default 9 if EXAMPLE_ADC2_CHANNEL_9

    choice EXAMPLE_DAC_CHANNEL
        bool "DAC Channel Num"
        default EXAMPLE_DAC_CHANNEL_1
        help
            The channel of DAC used in this example.

        config EXAMPLE_DAC_CHANNEL_1
            bool "DAC Channel 1 (GPIO25)"
        config EXAMPLE_DAC_CHANNEL_2
            bool "DAC Channel 2 (GPIO26)"
    endchoice

    config EXAMPLE_DAC_CHANNEL
        int
        default 1 if EXAMPLE_DAC_CHANNEL_1
        default 2 if EXAMPLE_DAC_CHANNEL_2

endmenu
```
