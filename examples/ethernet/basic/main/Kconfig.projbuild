## examples/gpio_wakeup/main/Kconfig.projbuild
```kconfig
menu "Example Configuration"

    config EXAMPLE_TOUCH_WAKEUP
        bool "Enable touch wake up"
        default y
        depends on SOC_PM_SUPPORT_TOUCH_SENSOR_WAKEUP
        help
            This option enables wake up from deep sleep using touch pads.
            ESP32 - TOUCH8 and TOUCH9, which correspond to GPIO33 and GPIO32.
            ESP32S2/S3 - TOUCH9, which corresponds to GPIO9.

            Note: On ESP32, touch wakeup source can not be used together with ext0 wakeup source.

    menu "GPIO wakeup configuration"

        config EXAMPLE_GPIO_WAKEUP_SLEEP_NUM
            int "Enable wakeup from GPIO"
            default 6 if IDF_TARGET_ESP32S3
            range 0 15 if IDF_TARGET_ESP32S3

        config EXAMPLE_GPIO_WAKEUP_HIGH_LEVEL
            bool "Enable GPIO high-level wakeup"
            default y
            help
                This option set the gpio wake-up trigger signal, In deep sleep, only high or low level wake-up is
                supported. If this option is enabled, it is a high level wake up, otherwise it is a low level wake up.
    endmenu

endmenu
```

## examples/lowpower/power_management/main/Kconfig.esp32c2.supported_freq
```kconfig
choice EXAMPLE_PM_MAX_FREQ_MHZ
    prompt "Max CPU frequency (MHz)"
    default EXAMPLE_PM_MAX_FREQ_MHZ_120
    config EXAMPLE_PM_MAX_FREQ_MHZ_10
        bool "10"
    config EXAMPLE_PM_MAX_FREQ_MHZ_20
        bool "20"
    config EXAMPLE_PM_MAX_FREQ_MHZ_40
        bool "40"
    config EXAMPLE_PM_MAX_FREQ_MHZ_80
        bool "80"
    config EXAMPLE_PM_MAX_FREQ_MHZ_120
        bool "120"
endchoice

config EXAMPLE_PM_MAX_FREQ
    int
    default 10 if EXAMPLE_PM_MAX_FREQ_MHZ_10
    default 20 if EXAMPLE_PM_MAX_FREQ_MHZ_20
    default 40 if EXAMPLE_PM_MAX_FREQ_MHZ_40
    default 80 if EXAMPLE_PM_MAX_FREQ_MHZ_80
    default 120 if EXAMPLE_PM_MAX_FREQ_MHZ_120

choice EXAMPLE_PM_MIN_FREQ_MHZ
    prompt "Min CPU frequency (MHz)"
    default EXAMPLE_PM_MIN_FREQ_MHZ_40
    config EXAMPLE_PM_MIN_FREQ_MHZ_10
        bool "10"
    config EXAMPLE_PM_MIN_FREQ_MHZ_20
        bool "20"
    config EXAMPLE_PM_MIN_FREQ_MHZ_40
        bool "40"
    config EXAMPLE_PM_MIN_FREQ_MHZ_80
        bool "80"
    config EXAMPLE_PM_MIN_FREQ_MHZ_120
        bool "120"
endchoice

config EXAMPLE_PM_MIN_FREQ
    int
    default 10 if EXAMPLE_PM_MIN_FREQ_MHZ_10
    default 20 if EXAMPLE_PM_MIN_FREQ_MHZ_20
    default 40 if EXAMPLE_PM_MIN_FREQ_MHZ_40
    default 80 if EXAMPLE_PM_MIN_FREQ_MHZ_80
    default 120 if EXAMPLE_PM_MIN_FREQ_MHZ_120
```

## examples/lowpower/power_management/main/Kconfig.esp32c5.supported_freq
```kconfig
choice EXAMPLE_PM_MAX_FREQ_MHZ
    prompt "Max CPU frequency (MHz)"
    default EXAMPLE_PM_MAX_FREQ_MHZ_240
    config EXAMPLE_PM_MAX_FREQ_MHZ_12
        bool "12"
    config EXAMPLE_PM_MAX_FREQ_MHZ_24
        bool "24"
    config EXAMPLE_PM_MAX_FREQ_MHZ_40
        bool "40"
    config EXAMPLE_PM_MAX_FREQ_MHZ_48
        bool "48"
    config EXAMPLE_PM_MAX_FREQ_MHZ_80
        bool "80"
    config EXAMPLE_PM_MAX_FREQ_MHZ_160
        bool "160"
    config EXAMPLE_PM_MAX_FREQ_MHZ_240
        bool "240"
endchoice

config EXAMPLE_PM_MAX_FREQ
    int
    default 12 if EXAMPLE_PM_MAX_FREQ_MHZ_12
    default 24 if EXAMPLE_PM_MAX_FREQ_MHZ_24
    default 40 if EXAMPLE_PM_MAX_FREQ_MHZ_40
    default 48 if EXAMPLE_PM_MAX_FREQ_MHZ_48
    default 80 if EXAMPLE_PM_MAX_FREQ_MHZ_80
    default 160 if EXAMPLE_PM_MAX_FREQ_MHZ_160
    default 240 if EXAMPLE_PM_MAX_FREQ_MHZ_240

choice EXAMPLE_PM_MIN_FREQ_MHZ
    prompt "Min CPU frequency (MHz)"
    default EXAMPLE_PM_MIN_FREQ_MHZ_48
    config EXAMPLE_PM_MIN_FREQ_MHZ_12
        bool "12"
    config EXAMPLE_PM_MIN_FREQ_MHZ_24
        bool "24"
    config EXAMPLE_PM_MIN_FREQ_MHZ_40
        bool "40 (use with 40MHz XTAL)"
    config EXAMPLE_PM_MIN_FREQ_MHZ_48
        bool "48 (use with 48MHz XTAL)"
    config EXAMPLE_PM_MIN_FREQ_MHZ_80
        bool "80"
    config EXAMPLE_PM_MIN_FREQ_MHZ_160
        bool "160"
    config EXAMPLE_PM_MIN_FREQ_MHZ_240
        bool "240"
endchoice

config EXAMPLE_PM_MIN_FREQ
    int
    default 12 if EXAMPLE_PM_MIN_FREQ_MHZ_12
    default 24 if EXAMPLE_PM_MIN_FREQ_MHZ_24
    default 40 if EXAMPLE_PM_MIN_FREQ_MHZ_40
    default 48 if EXAMPLE_PM_MIN_FREQ_MHZ_48
    default 80 if EXAMPLE_PM_MIN_FREQ_MHZ_80
    default 160 if EXAMPLE_PM_MIN_FREQ_MHZ_160
    default 240 if EXAMPLE_PM_MIN_FREQ_MHZ_240
```

## examples/lowpower/power_management/main/Kconfig.esp32h4.supported_freq
```kconfig
# ESP32-H4: 8, 16, 32, 48, 64, 96

choice EXAMPLE_PM_MAX_FREQ_MHZ
    prompt "Max CPU frequency (MHz)"
    default EXAMPLE_PM_MAX_FREQ_MHZ_96
    config EXAMPLE_PM_MAX_FREQ_MHZ_8
        bool "8"
    config EXAMPLE_PM_MAX_FREQ_MHZ_16
        bool "16"
    config EXAMPLE_PM_MAX_FREQ_MHZ_32
        bool "32"
    config EXAMPLE_PM_MAX_FREQ_MHZ_48
        bool "48"
    config EXAMPLE_PM_MAX_FREQ_MHZ_64
        bool "64"
    config EXAMPLE_PM_MAX_FREQ_MHZ_96
        bool "96"
endchoice

config EXAMPLE_PM_MAX_FREQ
    int
    default 8 if EXAMPLE_PM_MAX_FREQ_MHZ_8
    default 16 if EXAMPLE_PM_MAX_FREQ_MHZ_16
    default 32 if EXAMPLE_PM_MAX_FREQ_MHZ_32
    default 48 if EXAMPLE_PM_MAX_FREQ_MHZ_48
    default 64 if EXAMPLE_PM_MAX_FREQ_MHZ_64
    default 96 if EXAMPLE_PM_MAX_FREQ_MHZ_96

choice EXAMPLE_PM_MIN_FREQ_MHZ
    prompt "Min CPU frequency (MHz)"
    default EXAMPLE_PM_MIN_FREQ_MHZ_32
    config EXAMPLE_PM_MIN_FREQ_MHZ_8
        bool "8"
    config EXAMPLE_PM_MIN_FREQ_MHZ_16
        bool "16"
    config EXAMPLE_PM_MIN_FREQ_MHZ_32
        bool "32"
    config EXAMPLE_PM_MIN_FREQ_MHZ_48
        bool "48"
    config EXAMPLE_PM_MIN_FREQ_MHZ_64
        bool "64"
    config EXAMPLE_PM_MIN_FREQ_MHZ_96
        bool "96"
endchoice

config EXAMPLE_PM_MIN_FREQ
    int
    default 8 if EXAMPLE_PM_MIN_FREQ_MHZ_8
    default 16 if EXAMPLE_PM_MIN_FREQ_MHZ_16
    default 32 if EXAMPLE_PM_MIN_FREQ_MHZ_32
    default 48 if EXAMPLE_PM_MIN_FREQ_MHZ_48
    default 64 if EXAMPLE_PM_MIN_FREQ_MHZ_64
    default 96 if EXAMPLE_PM_MIN_FREQ_MHZ_96
```

## examples/lowpower/power_management/main/Kconfig.esp32s31.supported_freq
```kconfig
choice EXAMPLE_PM_MAX_FREQ_MHZ
    prompt "Max CPU frequency (MHz)"
    default EXAMPLE_PM_MAX_FREQ_MHZ_320
    config EXAMPLE_PM_MAX_FREQ_MHZ_10
        bool "10"
    config EXAMPLE_PM_MAX_FREQ_MHZ_20
        bool "20"
    config EXAMPLE_PM_MAX_FREQ_MHZ_40
        bool "40"
    config EXAMPLE_PM_MAX_FREQ_MHZ_80
        bool "80"
    config EXAMPLE_PM_MAX_FREQ_MHZ_160
        bool "160"
    config EXAMPLE_PM_MAX_FREQ_MHZ_240
        bool "240"
    config EXAMPLE_PM_MAX_FREQ_MHZ_320
        bool "320"
endchoice

config EXAMPLE_PM_MAX_FREQ
    int
    default 10 if EXAMPLE_PM_MAX_FREQ_MHZ_10
    default 20 if EXAMPLE_PM_MAX_FREQ_MHZ_20
    default 40 if EXAMPLE_PM_MAX_FREQ_MHZ_40
    default 80 if EXAMPLE_PM_MAX_FREQ_MHZ_80
    default 160 if EXAMPLE_PM_MAX_FREQ_MHZ_160
    default 240 if EXAMPLE_PM_MAX_FREQ_MHZ_240
    default 320 if EXAMPLE_PM_MAX_FREQ_MHZ_320

choice EXAMPLE_PM_MIN_FREQ_MHZ
    prompt "Min CPU frequency (MHz)"
    default EXAMPLE_PM_MIN_FREQ_MHZ_40
    config EXAMPLE_PM_MIN_FREQ_MHZ_10
        bool "10"
    config EXAMPLE_PM_MIN_FREQ_MHZ_20
        bool "20"
    config EXAMPLE_PM_MIN_FREQ_MHZ_40
        bool "40"
    config EXAMPLE_PM_MIN_FREQ_MHZ_80
        bool "80"
    config EXAMPLE_PM_MIN_FREQ_MHZ_160
        bool "160"
    config EXAMPLE_PM_MIN_FREQ_MHZ_240
        bool "240"
    config EXAMPLE_PM_MIN_FREQ_MHZ_320
        bool "320"
endchoice

config EXAMPLE_PM_MIN_FREQ
    int
    default 10 if EXAMPLE_PM_MIN_FREQ_MHZ_10
    default 20 if EXAMPLE_PM_MIN_FREQ_MHZ_20
    default 40 if EXAMPLE_PM_MIN_FREQ_MHZ_40
    default 80 if EXAMPLE_PM_MIN_FREQ_MHZ_80
    default 160 if EXAMPLE_PM_MIN_FREQ_MHZ_160
    default 240 if EXAMPLE_PM_MIN_FREQ_MHZ_240
    default 320 if EXAMPLE_PM_MIN_FREQ_MHZ_320
```
