## examples/ethernet/ptp/components/ptpd/Kconfig.projbuild
```kconfig
#
# For a description of the syntax of this configuration file,
# see the file kconfig-language.txt in the NuttX tools repository.
#
menu "PTP Daemon Configuration"

    config NETUTILS_PTPD
        bool "PTPD client/server"
        default y
    #depends on NET_IPv4
    #depends on NET_IGMP
    #depends on NET_UDP
        help
            Build a minimal implementation of IEEE-1588 precision time protocol.
            Uses system gettimeofday() and adjtime() calls to synchronize clock
            with a master clock through network, or to provide a master clock to
            other systems.

    if NETUTILS_PTPD

        config NETUTILS_PTPD_DEBUG
            bool "Enable PTP debug messages"
            default n
            depends on DEBUG_INFO
            help
                Enable PTP debug messages even if CONFIG_DEBUG_NET_INFO is not enabled.

        config NETUTILS_PTPD_CLIENT
            bool "Enable client support"
            default y
            help
                Act as a PTP client, synchronizing the NuttX clock to a remote master
                clock.

        config NETUTILS_PTPD_SERVER
            bool "Enable server support"
            default n
            help
                Act as a PTP server, providing NuttX clock time to other systems.

                Both server and client can be simultaneously enabled. NuttX will then
                synchronize to a higher priority master clock, or act as a master
                clock itself if it has the highest priority.
                Refer to Best Master Clock algorithm in IEEE-1588 for details.

        config NETUTILS_PTPD_STACKSIZE
            int "PTP daemon stack stack size"
            default 4096 # DEFAULT_TASK_STACKSIZE

        config NETUTILS_PTPD_SERVERPRIO
            int "PTP daemon priority"
            default 100

        config NETUTILS_PTPD_DOMAIN
            int    "PTP domain selection"
            default 0
            range 0 127
            help
                Set PTP domain to participate in. Default domain is 0, other domains
                can be used to isolate reference clocks from each other.

        if NETUTILS_PTPD_SERVER

            config NETUTILS_PTPD_PRIORITY1
                int "PTP server priority1"
                default 128
                range 0 255
                help
                    Set clock priority to announce when acting as a PTP server.
                    Lower value is higher priority.
                    A higher priority1 clock will be selected without regard to announced
                    clock quality fields.
                    Refer to Best Master Clock algorithm in IEEE-1588 for details.

            config NETUTILS_PTPD_PRIORITY2
                int "PTP server priority2"
                default 128
                range 0 255
                help
                    Set clock subpriority to announce when acting as a PTP server.
                    This will distinguish between two clocks that are equivalent in
                    priority1, class and accuracy values.
                    Lower value is higher priority.

            config NETUTILS_PTPD_CLASS
                int "PTP server class"
                default 248
                range 0 255
                help
                    Set master clock class to announce when acting as a PTP server.
                    Lower value means higher quality clock source.
                    248 is the default for unknown class.

            config NETUTILS_PTPD_ACCURACY
                int "PTP server accuracy"
                default 254
                range 0 255
                help
                    Set master clock accuracy to announce when acting as a PTP server.
                    Logarithmic scale is defined in IEEE-1588:
                    32: +-  25 ns
                    33: +- 100 ns
                    34: +- 250 ns
                    35: +-   1 us
                    36: +-   2.5 us
                    37: +-  10 us
                    38: +-  25 us
                    39: +- 100 us
                    40: +- 250 us
                    41: +-   1 ms
                    42: +-   2.5 ms
                    43: +-  10 ms
                    44: +-  25 ms
                    45: +- 100 ms
                    46: +- 250 ms
                    47: +-   1 s
                    48: +-  10 s
                    49: +-  more than 10 s
                    254: Unknown

            config NETUTILS_PTPD_CLOCKSOURCE
                int "PTP server clock source type"
                default 160
                range 0 255
                help
                    Set clock source type to announce when acting as a PTP server.
                    Common values:
                    32: GPS
                    64: PTP
                    80: NTP
                    144: Other
                    160: Internal oscillator

            config NETUTILS_PTPD_SYNC_INTERVAL_MSEC
                int "PTP server sync transmit interval (ms)"
                default 1000
                help
                    How often to transmit sync packets in server mode.

            config NETUTILS_PTPD_ANNOUNCE_INTERVAL_MSEC
                int "PTP server announce transmit interval (ms)"
                default 10000
                help
                    How often to transmit announce packets in server mode.

            config NETUTILS_PTPD_TWOSTEP_SYNC
                bool "PTP server sends two-step synchronization packets"
                default y
                help
                    If enabled, sends a follow-up packet after every sync packet.
                    This helps compensate for the time taken to initiate the transmission.

            config NETUTILS_PTPD_DELAYRESP_INTERVAL
                int "PTP server suggested interval of delay requests"
                range 0 255
                default 4
                help
                    When responding to a delay request, the server can inform the client
                    how often it should test path delay. This is done using header field
                    logMessageInterval. The delay will be 2^N seconds.

                    Default value 4 results in 16 second interval.

        endif # NETUTILS_PTPD_SERVER

        if NETUTILS_PTPD_CLIENT

            config NETUTILS_PTPD_TIMEOUT_MS
                int "PTP client timeout for changing clock source (ms)"
                default 60000
                help
                    If no packets are being received from currently chosen clock source,
                    fall back to next best clock source after this many seconds.

            config NETUTILS_PTPD_SETTIME_THRESHOLD_MS
                int "PTP client threshold for changing system time (ms)"
                default 1000
                help
                    If difference between local and remote clock exceeds this threshold,
                    time is reset with settimeofday() instead of changing the rate with
                    adjtime().

        # Commented options not used by ESP_PTP
        #config NETUTILS_PTPD_MULTICAST_TIMEOUT_MS
        #    int "PTP client timeout to rejoin multicast group (ms)"
        #    default 30000 #esp32
        #    default 0
        #    help
        #        If no PTP multicast packets are being received, attempt to rejoin the
        #        multicast group. This can be necessary if network topology changes, or
        #        depending on hardware, after some error recovery events.
        #        Set to 0 to disable.

        #config NETUTILS_PTPD_DRIFT_AVERAGE_S
        #    int "PTP client clock drift rate averaging time (s)"
        #    default 600
        #    range 10 86400
        #    help
        #        Clock drift rate is averaged over this time pediod. Larger value
        #        gives more stable estimate but reacts slower to crystal oscillator speed
        #        changes (such as caused by temperature changes).

            config NETUTILS_PTPD_SEND_DELAYREQ
                bool "PTP client enable delay requests"
                default n
                help
                    If enabled, sends delay request messages to measure the network delay
                    to server. If disabled, assumes zero delay.

            if NETUTILS_PTPD_SEND_DELAYREQ

                config NETUTILS_PTPD_MAX_PATH_DELAY_NS
                    int "PTP client maximum path delay (ns)"
                    default 100000
                    range 1 1000000000
                    help
                        Measured path delay longer than this is ignored. Delay requests are
                        also not transmitted until clock synchronization is better than this.

                config NETUTILS_PTPD_DELAYREQ_AVGCOUNT
                    int "PTP client path delay averaging count"
                    default 100
                    help
                        Measured path delay is averaged over this many samples.

                config NETUTILS_PTPD_PATH_DELAY_STABILITY_NS
                    int "PTP client send delay request when clock stability (ns)"
                    default 250
                    help
                        Sends path delay request only once the internal clock is stable and skews only
                        in defined interval.

            endif # NETUTILS_PTPD_SEND_DELAYREQ

        endif # NETUTILS_PTPD_CLIENT

    endif # NETUTILS_PTPD

endmenu # PTP Daemon Configuration
```

## examples/ethernet/ptp/main/Kconfig.projbuild
```kconfig
menu "PTP Example Configuration"

    orsource "$IDF_PATH/examples/common_components/env_caps/$IDF_TARGET/Kconfig.env_caps"

    config EXAMPLE_PTPD_CLIENT_ONLY
        bool "Set to client only mode"
        default n
        help
            Act as a PTP client only, synchronizing the clock to a remote master
            clock.

            When disabled, both server and client are simultaneously enabled.
            PTPd will then synchronize to a higher priority master clock, or
            act as a master clock itself if it has the highest priority.
            Refer to Best Master Clock algorithm in IEEE-1588 for details.

    config EXAMPLE_PTPD_SEND_DELAYREQ
        bool "PTP client enable delay requests"
        default n
        help
            If enabled, sends delay request messages to measure the network delay
            to server. If disabled, assumes zero delay.

    config EXAMPLE_PTPD_BMCA
        bool "Enable Best Master Clock Algorithm (BMCA)"
        default y
        help
            When enabled, PTPd participates in IEEE 1588 best master clock
            selection (compares remote masters and may become grandmaster when
            appropriate). When disabled, BMCA-related state transitions are
            skipped.

    choice EXAMPLE_PTP_PULSE_SOURCE
        prompt "Pulse Source"
        default EXAMPLE_PTP_PULSE_EMAC_PPS
        help
            Select source for sync pulse generation.

        config EXAMPLE_PTP_PULSE_EMAC_PPS
            depends on !ESP32P4_SELECTS_REV_LESS_V3
            bool "Generate internally by EMAC PPS"
            help
                Pulse per second signal is generated internally by EMAC.

        config EXAMPLE_PTP_PULSE_CALLBACK
            bool "Generate by interrupt and callback function"
            help
                Pulse is generated by callback function invoked by EMAC interrupt. The interrupt is
                raised on EMAC timer event which is continuously reconfigured in the callback function
                to align with configured pulse width.
    endchoice

    config EXAMPLE_PTP_PULSE_GPIO
        int "Pulse GPIO number"
        range ENV_GPIO_RANGE_MIN ENV_GPIO_OUT_RANGE_MAX
        default 20
        help
            Set the GPIO number at which the Pulse signal is outputted.

    config EXAMPLE_PTP_PPS_FREQ_HZ
        depends on EXAMPLE_PTP_PULSE_EMAC_PPS
        int "PPS Frequency Configuration"
        range 0 16384
        default 0
        help
            Select EMAC PPS output frequency as 0 = 1PPS (narrow pulse), other values generate square clock signal.
            The clock frequency must be power of two and less than or equal to 16384 Hz.

    config EXAMPLE_PTP_PULSE_WIDTH_NS
        depends on EXAMPLE_PTP_PULSE_CALLBACK
        int "Pulse width (ns)"
        range 5000 999999999
        default 500000000
        help
            Set pulse width in ns.
            WARNING: Since the new pulse target time is set programmatically in the callback
            function, width accuracy may vary or it may be lost completely when you select
            very short pulse width.


    config EXAMPLE_PTPD_STACKSIZE
        int "PTP daemon stack stack size"
        default 2048

    config EXAMPLE_PTPD_TASKPRIO
        int "PTP daemon task priority"
        default 5
endmenu
```

## examples/ethernet/ptp/sdkconfig.defaults
```kconfig
CONFIG_IDF_TARGET="esp32p4"

CONFIG_ESP_NETIF_L2_TAP=y

CONFIG_ETHERNET_INTERNAL_SUPPORT=y
CONFIG_ETHERNET_PHY_IP101=y

CONFIG_NETUTILS_PTPD=y
CONFIG_NETUTILS_PTPD_CLIENT=y
CONFIG_NETUTILS_PTPD_SERVER=y

CONFIG_NETUTILS_PTPD_PRIORITY1=246
CONFIG_NETUTILS_PTPD_SERVERPRIO=100
CONFIG_NETUTILS_PTPD_TIMEOUT_MS=10000
CONFIG_NETUTILS_PTPD_SETTIME_THRESHOLD_MS=100
CONFIG_EXAMPLE_PTP_PULSE_GPIO=20
CONFIG_EXAMPLE_PTP_PULSE_WIDTH_NS=250000000
```

## examples/get-started/blink/main/Kconfig.projbuild
```kconfig
menu "Example Configuration"

    orsource "$IDF_PATH/examples/common_components/env_caps/$IDF_TARGET/Kconfig.env_caps"

    choice BLINK_LED
        prompt "Blink LED type"
        default BLINK_LED_GPIO if IDF_TARGET_ESP32 || !SOC_RMT_SUPPORTED
        default BLINK_LED_RMT
        help
            Defines the default peripheral for blink example

        config BLINK_LED_GPIO
            bool "GPIO"
        config BLINK_LED_RMT
            bool "RMT - Addressable LED"
    endchoice

    config BLINK_GPIO
        int "Blink GPIO number"
        range ENV_GPIO_RANGE_MIN ENV_GPIO_OUT_RANGE_MAX
        default 5 if IDF_TARGET_ESP32
        default 18 if IDF_TARGET_ESP32S2
        default 48 if IDF_TARGET_ESP32S3
        default 8
        help
            GPIO number (IOxx) to blink on and off or the RMT signal for the addressable LED.
            Some GPIOs are used for other purposes (flash connections, etc.) and cannot be used to blink.

    config BLINK_PERIOD
        int "Blink period in ms"
        range 10 3600000
        default 1000
        help
            Define the blinking period in milliseconds.

endmenu
```

## examples/get-started/blink/sdkconfig.defaults.esp32s3
```kconfig
CONFIG_BLINK_LED_STRIP=y
#
# Please Note:
# ESP32-S3-DevKitC v1.1 uses GPIO38 for the on-board LED
# ESP32-S3-DevKitC v1.0 uses GPIO48 for the on-board LED
#
CONFIG_BLINK_GPIO=38
```

## examples/get-started/blink/sdkconfig.defaults.esp32s31
```kconfig
CONFIG_BLINK_LED_STRIP=y
#
# Please Note:
# ESP32-S31 function core board uses GPIO60 for the on-board LED
# ESP32-S31 Korvo board uses GPIO37 for the on-board LED
#
CONFIG_BLINK_GPIO=37
```
