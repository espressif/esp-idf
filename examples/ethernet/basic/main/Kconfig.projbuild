## examples/ethernet/enc28j60/main/Kconfig.projbuild
```kconfig
menu "Example Configuration"

    orsource "$IDF_PATH/examples/common_components/env_caps/$IDF_TARGET/Kconfig.env_caps"

    config EXAMPLE_ENC28J60_SPI_HOST
        int "SPI Host Number"
        range 0 2
        default 1
        help
            Set the SPI host used to communicate with the SPI Ethernet Controller.

    config EXAMPLE_ENC28J60_SCLK_GPIO
        int "SPI SCLK GPIO number"
        range ENV_GPIO_RANGE_MIN ENV_GPIO_OUT_RANGE_MAX
        default 14 if IDF_TARGET_ESP32
        default 12 if IDF_TARGET_ESP32S2 || IDF_TARGET_ESP32S3
        default 6 if IDF_TARGET_ESP32C3 || IDF_TARGET_ESP32C2 || IDF_TARGET_ESP32C6
        default 4 if IDF_TARGET_ESP32H2
        default 33 if IDF_TARGET_ESP32P4
        help
            Set the GPIO number used by SPI SCLK.

    config EXAMPLE_ENC28J60_MOSI_GPIO
        int "SPI MOSI GPIO number"
        range ENV_GPIO_RANGE_MIN ENV_GPIO_OUT_RANGE_MAX
        default 13 if IDF_TARGET_ESP32
        default 11 if IDF_TARGET_ESP32S2 || IDF_TARGET_ESP32S3
        default 7 if IDF_TARGET_ESP32C3 || IDF_TARGET_ESP32C2 || IDF_TARGET_ESP32C6
        default 5 if IDF_TARGET_ESP32H2
        default 32 if IDF_TARGET_ESP32P4
        help
            Set the GPIO number used by SPI MOSI.

    config EXAMPLE_ENC28J60_MISO_GPIO
        int "SPI MISO GPIO number"
        range ENV_GPIO_RANGE_MIN ENV_GPIO_IN_RANGE_MAX
        default 12 if IDF_TARGET_ESP32
        default 13 if IDF_TARGET_ESP32S2 || IDF_TARGET_ESP32S3
        default 2 if IDF_TARGET_ESP32C3 || IDF_TARGET_ESP32C2 || IDF_TARGET_ESP32C6
        default 0 if IDF_TARGET_ESP32H2
        default 52 if IDF_TARGET_ESP32P4
        help
            Set the GPIO number used by SPI MISO.

    config EXAMPLE_ENC28J60_CS_GPIO
        int "SPI CS GPIO number"
        range ENV_GPIO_RANGE_MIN ENV_GPIO_OUT_RANGE_MAX
        default 15 if IDF_TARGET_ESP32
        default 10 if IDF_TARGET_ESP32S2 || IDF_TARGET_ESP32C3 || IDF_TARGET_ESP32S3 || IDF_TARGET_ESP32C2
        default 3 if IDF_TARGET_ESP32C6
        default 1 if IDF_TARGET_ESP32H2
        default 53 if IDF_TARGET_ESP32P4
        help
            Set the GPIO number used by SPI CS.

    config EXAMPLE_ENC28J60_SPI_CLOCK_MHZ
        int "SPI clock speed (MHz)"
        range 5 20
        default 8
        help
            Set the clock speed (MHz) of SPI interface.

    config EXAMPLE_ENC28J60_INT_GPIO
        int "Interrupt GPIO number"
        range ENV_GPIO_RANGE_MIN ENV_GPIO_IN_RANGE_MAX
        default 4 if IDF_TARGET_ESP32 || IDF_TARGET_ESP32S2 || IDF_TARGET_ESP32C3 || IDF_TARGET_ESP32S3
        default 4 if IDF_TARGET_ESP32C2 || IDF_TARGET_ESP32C6
        default 10 if IDF_TARGET_ESP32H2
        default 48 if IDF_TARGET_ESP32P4
        help
            Set the GPIO number used by ENC28J60 interrupt.

    choice EXAMPLE_ENC28J60_DUPLEX_MODE
        prompt "Duplex Mode"
        default EXAMPLE_ENC28J60_DUPLEX_HALF
        help
            Select ENC28J60 Duplex operation mode.

        config EXAMPLE_ENC28J60_DUPLEX_FULL
            bool "Full Duplex"
            help
                Set ENC28J60 to Full Duplex mode. Do not forget to manually set the remote node (switch, router
                or Ethernet controller) to full-duplex operation mode too.

        config EXAMPLE_ENC28J60_DUPLEX_HALF
            bool "Half Duplex"
            help
                Set ENC28J60 to Half Duplex mode.
    endchoice # EXAMPLE_ENC28J60_DUPLEX_MODE
endmenu
```

## examples/ethernet/eth2ap/main/Kconfig.projbuild
```kconfig
menu "Example Configuration"

    config EXAMPLE_USE_SPI_ETHERNET
        bool

    choice EXAMPLE_ETHERNET_TYPE
        prompt "Ethernet Type"
        default EXAMPLE_USE_INTERNAL_ETHERNET if IDF_TARGET_ESP32
        default EXAMPLE_USE_W5500
        help
            Select which kind of Ethernet will be used in the example.

        config EXAMPLE_USE_INTERNAL_ETHERNET
            depends on IDF_TARGET_ESP32
            select ETH_USE_ESP32_EMAC
            bool "Internal EMAC"
            help
                Select internal Ethernet MAC controller.

        config EXAMPLE_USE_DM9051
            bool "DM9051 Module"
            select EXAMPLE_USE_SPI_ETHERNET
            select ETH_USE_SPI_ETHERNET
            select ETH_SPI_ETHERNET_DM9051
            help
                Select external SPI-Ethernet module (DM9051).

        config EXAMPLE_USE_W5500
            bool "W5500 Module"
            select EXAMPLE_USE_SPI_ETHERNET
            select ETH_USE_SPI_ETHERNET
            select ETH_SPI_ETHERNET_W5500
            help
                Select external SPI-Ethernet module (W5500).
    endchoice # EXAMPLE_ETHERNET_TYPE

    if EXAMPLE_USE_INTERNAL_ETHERNET
        choice EXAMPLE_ETH_PHY_MODEL
            prompt "Ethernet PHY Device"
            default EXAMPLE_ETH_PHY_IP101
            help
                Select the Ethernet PHY device to use in the example.

            config EXAMPLE_ETH_PHY_IP101
                bool "IP101"
                help
                    IP101 is a single port 10/100 MII/RMII/TP/Fiber Fast Ethernet Transceiver.
                    Goto http://www.icplus.com.tw/pp-IP101G.html for more information about it.

            config EXAMPLE_ETH_PHY_RTL8201
                bool "RTL8201/SR8201"
                help
                    RTL8201F/SR8201F is a single port 10/100Mb Ethernet Transceiver with auto MDIX.
                    Goto http://www.corechip-sz.com/productsview.asp?id=22 for more information about it.

            config EXAMPLE_ETH_PHY_LAN8720
                bool "LAN8720"
                help
                    LAN8720A is a small footprint RMII 10/100 Ethernet Transceiver with HP Auto-MDIX Support.
                    Goto https://www.microchip.com/LAN8720A for more information about it.

            config EXAMPLE_ETH_PHY_DP83848
                bool "DP83848"
                help
                    DP83848 is a single port 10/100Mb/s Ethernet Physical Layer Transceiver.
                    Goto http://www.ti.com/product/DP83848J for more information about it.

            config EXAMPLE_ETH_PHY_KSZ8041
                bool "KSZ8041"
                help
                    The KSZ8041 is a single supply 10Base-T/100Base-TX Physical Layer Transceiver.
                    Goto https://www.microchip.com/wwwproducts/en/KSZ8041 for more information about it.
        endchoice # EXAMPLE_ETH_PHY_MODEL

        config EXAMPLE_ETH_MDC_GPIO
            int "SMI MDC GPIO number"
            default 23
            help
                Set the GPIO number used by SMI MDC.

        config EXAMPLE_ETH_MDIO_GPIO
            int "SMI MDIO GPIO number"
            default 18
            help
                Set the GPIO number used by SMI MDIO.
    endif # EXAMPLE_USE_INTERNAL_ETHERNET

    if EXAMPLE_USE_SPI_ETHERNET
        config EXAMPLE_ETH_SPI_HOST
            int "SPI Host Number"
            range 0 2
            default 1
            help
                Set the SPI host used to communicate with the SPI Ethernet Controller.

        config EXAMPLE_ETH_SPI_SCLK_GPIO
            int "SPI SCLK GPIO number"
            range 0 33
            default 20
            help
                Set the GPIO number used by SPI SCLK.

        config EXAMPLE_ETH_SPI_MOSI_GPIO
            int "SPI MOSI GPIO number"
            range 0 33
            default 19
            help
                Set the GPIO number used by SPI MOSI.

        config EXAMPLE_ETH_SPI_MISO_GPIO
            int "SPI MISO GPIO number"
            range 0 33
            default 18
            help
                Set the GPIO number used by SPI MISO.

        config EXAMPLE_ETH_SPI_CS_GPIO
            int "SPI CS GPIO number"
            range 0 33
            default 21
            help
                Set the GPIO number used by SPI CS.

        config EXAMPLE_ETH_SPI_CLOCK_MHZ
            int "SPI clock speed (MHz)"
            range 5 80
            default 36
            help
                Set the clock speed (MHz) of SPI interface.

        config EXAMPLE_ETH_SPI_INT_GPIO
            int "Interrupt GPIO number"
            default 4
            help
                Set the GPIO number used by the SPI Ethernet module interrupt line.
    endif # EXAMPLE_USE_SPI_ETHERNET

    config EXAMPLE_ETH_PHY_RST_GPIO
        int "PHY Reset GPIO number"
        default 5
        help
            Set the GPIO number used to reset PHY chip.
            Set to -1 to disable PHY chip hardware reset.

    config EXAMPLE_ETH_PHY_ADDR
        int "PHY Address"
        range 0 31
        default 1
        help
            Set PHY address according your board schematic.

    config EXAMPLE_WIFI_SSID
        string "Wi-Fi SSID"
        default "eth2ap"
        help
            Set the SSID of Wi-Fi ap interface.

    config EXAMPLE_WIFI_PASSWORD
        string "Wi-Fi Password"
        default "12345678"
        help
            Set the password of Wi-Fi ap interface.

    config EXAMPLE_WIFI_CHANNEL
        int "WiFi channel"
        range 1 13
        default 1
        help
            Set the channel of Wi-Fi ap.

    config EXAMPLE_MAX_STA_CONN
        int "Maximum STA connections"
        default 4
        help
            Maximum number of the station that allowed to connect to current Wi-Fi hotspot.

endmenu
```

## examples/ethernet/ethernet/main/Kconfig.projbuild
```kconfig
menu "Example Configuration"

choice PHY_MODEL
    prompt "Ethernet PHY"
    default CONFIG_PHY_TLK110
    help
        Select the PHY driver to use for the example.

config PHY_TLK110
    bool "TI TLK110 PHY"
    help
        Select this to use the TI TLK110 PHY

config PHY_LAN8720
    bool "Microchip LAN8720 PHY"
    help
        Select this to use the Microchip LAN8720 PHY

endchoice


config PHY_ADDRESS
    int "PHY Address (0-31)"
    default 31
    range 0 31
    help
        Select the PHY Address (0-31) for the hardware configuration and PHY model.
        TLK110 default 31
        LAN8720 default 1 or 0


choice PHY_CLOCK_MODE
    prompt "EMAC clock mode"
    default PHY_CLOCK_GPIO0_IN
    help
        Select external (input on GPIO0) or internal (output on GPIO0, GPIO16 or GPIO17) clock


config PHY_CLOCK_GPIO0_IN
    bool "GPIO0 input"
    help
        Input of 50MHz refclock on GPIO0

config PHY_CLOCK_GPIO0_OUT
    bool "GPIO0 Output(READ HELP)"
    help
        GPIO0 can be set to output a pre-divided PLL clock (test only!).
        Enabling this option will configure GPIO0 to output a 50MHz clock.
        In fact this clock doesn't have directly relationship with EMAC peripheral.
        Sometimes this clock won't work well with your PHY chip. You might need to
        add some extra devices after GPIO0 (e.g. inverter).
        Note that outputting RMII clock on GPIO0 is an experimental practice.
        If you want the Ethernet to work with WiFi, don't select GPIO0 output mode for stability.

config PHY_CLOCK_GPIO16_OUT
    bool "GPIO16 output"
    help
        Output the internal 50MHz APLL clock on GPIO16

config PHY_CLOCK_GPIO17_OUT
    bool "GPIO17 output (inverted)"
    help
        Output the internal 50MHz APLL clock on GPIO17 (inverted signal)

endchoice

config PHY_CLOCK_MODE
    int
    default 0 if PHY_CLOCK_GPIO0_IN
    default 1 if PHY_CLOCK_GPIO0_OUT
    default 2 if PHY_CLOCK_GPIO16_OUT
    default 3 if PHY_CLOCK_GPIO17_OUT


config PHY_USE_POWER_PIN
    bool "Use PHY Power (enable/disable) pin"
    default y
    help
        Use a GPIO "power pin" to power the PHY on/off during operation.
        Consult the example README for more details

config PHY_POWER_PIN
    int "PHY Power GPIO"
    default 17
    range 0 33
    depends on PHY_USE_POWER_PIN
    help
        GPIO number to use for powering on/off the PHY.

config PHY_SMI_MDC_PIN
    int "SMI MDC Pin"
    default 23
    range 0 33
    help
        GPIO number to use for SMI clock output MDC to PHY.

config PHY_SMI_MDIO_PIN
    int "SMI MDIO Pin"
    default 18
    range 0 33
    help
       GPIO number to use for SMI data pin MDIO to/from PHY.

endmenu
```

## examples/ethernet/iperf/main/Kconfig.projbuild
```kconfig
menu "Example Configuration"

    config EXAMPLE_STORE_HISTORY
        bool "Store command history in flash"
        default y
        help
            Linenoise line editing library provides functions to save and load
            command history. If this option is enabled, initalizes a FAT filesystem
            and uses it to store command history.

    choice EXAMPLE_ETH_PHY_MODEL
        prompt "Ethernet PHY Device"
        default EXAMPLE_ETH_PHY_IP101
        help
            Select the Ethernet PHY device to use in the example.

        config EXAMPLE_ETH_PHY_IP101
            bool "IP101"
            help
                IP101 is a single port 10/100 MII/RMII/TP/Fiber Fast Ethernet Transceiver.
                Goto http://www.icplus.com.tw/pp-IP101G.html for more information about it.

        config EXAMPLE_ETH_PHY_RTL8201
            bool "RTL8201/SR8201"
            help
                RTL8201F/SR8201F is a single port 10/100Mb Ethernet Transceiver with auto MDIX.
                Goto http://www.corechip-sz.com/productsview.asp?id=22 for more information about it.

        config EXAMPLE_ETH_PHY_LAN8720
            bool "LAN8720"
            help
                LAN8720A is a small footprint RMII 10/100 Ethernet Transceiver with HP Auto-MDIX Support.
                Goto https://www.microchip.com/LAN8720A for more information about it.

        config EXAMPLE_ETH_PHY_DP83848
            bool "DP83848"
            help
                DP83848 is a single port 10/100Mb/s Ethernet Physical Layer Transceiver.
                Goto http://www.ti.com/product/DP83848J for more information about it.
    endchoice

endmenu
```

## examples/ethernet/iperf/sdkconfig.defaults
```kconfig
# Defaults for generating a new "sdkconfig" file (project settings).
# https://docs.espressif.com/projects/esp-idf/en/latest/esp32/api-guides/build-system.html#custom-sdkconfig-defaults
#
# NOTE - if this file changes, to get new defaults, you must erase any existing
# "sdkconfig" file (this will undo manual settings from "idf.py menuconfig").

# Increase main task stack size
CONFIG_ESP_MAIN_TASK_STACK_SIZE=7168

# Enable filesystem
CONFIG_PARTITION_TABLE_CUSTOM=y
CONFIG_PARTITION_TABLE_CUSTOM_FILENAME="partitions_example.csv"
CONFIG_PARTITION_TABLE_FILENAME="partitions_example.csv"

# Enable FreeRTOS stats formatting functions, needed for 'tasks' command
CONFIG_FREERTOS_USE_TRACE_FACILITY=y
CONFIG_FREERTOS_USE_STATS_FORMATTING_FUNCTIONS=y

# Run FreeRTOS only on the first core
CONFIG_FREERTOS_UNICORE=y

CONFIG_ESPTOOLPY_FLASHSIZE_4MB=y

# Disable watch dog
CONFIG_ESP_INT_WDT=n
CONFIG_ESP_TASK_WDT=n

# Enable lwIP IRAM optimization
CONFIG_LWIP_IRAM_OPTIMIZATION=y
```
