## proj_s31/thirdparty/xymodem/Kconfig
```kconfig
menu "X/YMODEM"
    config XYMODEM_ENABLE_DEBUG_LOG
        bool "Enable debug log"
        default n
        help
            Whether to enable the debug log messages for X/YMODEM component.

endmenu
```

## tools/test_apps/linux_compatible/linux_freertos/sdkconfig.defaults
```kconfig
CONFIG_IDF_TARGET="linux"
CONFIG_FREERTOS_SMP=n
CONFIG_ESP_INT_WDT=n
CONFIG_ESP_TASK_WDT_EN=n
```
