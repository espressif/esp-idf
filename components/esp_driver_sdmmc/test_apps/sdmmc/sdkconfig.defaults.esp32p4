## components/esp_event/Kconfig
```kconfig
menu "Event Loop Library"

    config ESP_EVENT_LOOP_PROFILING
        bool "Enable event loop profiling"
        default n
        help
            Enables collections of statistics in the event loop library such as the number of events posted
            to/received by an event loop, number of callbacks involved, number of events dropped to to a full event
            loop queue, run time of event handlers, and number of times/run time of each event handler.

    config ESP_EVENT_POST_FROM_ISR
        bool "Support posting events from ISRs"
        default y
        help
            Enable posting events from interrupt handlers.

    config ESP_EVENT_POST_FROM_ISR_SIZE
        int "Max size of data from events (bytes)"
        default 4
        depends on ESP_EVENT_POST_FROM_ISR
        range 4 256
        help
            Maximum size (in bytes) of event data that will be kept in the inline event
            storage.

            When ESP_EVENT_POST_FROM_ISR is enabled, event data with size less
            than or equal to this value is copied into the fixed-size inline storage.
            If event's data is larger than this limit, a heap allocation is performed
            and the data is copied into the allocated buffer before posting.

            When ESP_EVENT_POST_FROM_ISR is disabled, event data is always
            copied to a heap-allocated buffer to ensure the data remains valid until the
            event is processed.

            Choose this value to trade static RAM footprint of the inline storage
            against the frequency of heap allocations: smaller values reduce static
            memory usage; larger values reduce heap allocations and fragmentation.

    config ESP_EVENT_POST_FROM_IRAM_ISR
        bool "Support posting events from ISRs placed in IRAM"
        default y
        depends on ESP_EVENT_POST_FROM_ISR
        help
            Enable posting events from interrupt handlers placed in IRAM. Enabling this option places API functions
            esp_event_post and esp_event_post_to in IRAM.

    config ESP_EVENT_LOOP_IN_EXT_RAM
        bool "Place event loop related allocations in external RAM"
        default n
        depends on SPIRAM
        depends on FREERTOS_TASK_CREATE_ALLOW_EXT_MEM
        help
            When this configuration is enabled, the event loop will place all of its
            event loop related allocations in external RAM.

            Note that when CONFIG_ESP_EVENT_POST_FROM_IRAM_ISR is enabled, queue related
            allocations will still be placed in internal RAM to ensure that posting events
            from IRAM ISR works correctly.

endmenu
```

## components/esp_event/host_test/esp_event_unit_test/sdkconfig.defaults
```kconfig
CONFIG_UNITY_ENABLE_IDF_TEST_RUNNER=n
CONFIG_IDF_TARGET="linux"
CONFIG_CXX_EXCEPTIONS=y
CONFIG_LOG_DEFAULT_LEVEL_NONE=y
```

## components/esp_event/test_apps/sdkconfig.defaults.esp32
```kconfig
# Set CPU frequency to max for performance tests
CONFIG_ESP_DEFAULT_CPU_FREQ_MHZ_240=y
CONFIG_ESP_EVENT_LOOP_PROFILING=y
```

## components/esp_gdbstub/Kconfig
```kconfig
menu "GDB Stub"

    # Hidden option which is selected from the "Panic handler behavior"
    # menu in the target component.
    config ESP_GDBSTUB_ENABLED
        bool

    config ESP_SYSTEM_GDBSTUB_RUNTIME
        bool "GDBStub at runtime"
        select ESP_GDBSTUB_ENABLED
        help
            Enable builtin GDBStub.
            This allows to debug the target device using serial port:
            - Run 'idf.py monitor'.
            - Wait for the device to initialize.
            - Press Ctrl+C to interrupt the execution and enter GDB attached to your device for debugging.
            NOTE: all UART input will be handled by GDBStub.

    config ESP_GDBSTUB_SUPPORT_TASKS
        bool "Enable listing FreeRTOS tasks through GDB Stub"
        depends on ESP_GDBSTUB_ENABLED
        default y
        help
            If enabled, GDBStub can supply the list of FreeRTOS tasks to GDB.
            Thread list can be queried from GDB using 'info threads' command.
            Note that if GDB task lists were corrupted, this feature may not work.
            If GDBStub fails, try disabling this feature.

    config ESP_GDBSTUB_MAX_TASKS
        int "Maximum number of tasks supported by GDB Stub"
        default 32
        depends on ESP_GDBSTUB_SUPPORT_TASKS
        help
            Set the number of tasks which GDB Stub will support.

endmenu
```

## components/esp_hal_gpio/Kconfig.hal_gpio
```kconfig
config HAL_GPIO_USE_ROM_IMPL
    bool "Use ROM implementation of GPIO HAL driver"
    default y
    help
        Enable this flag to use HAL functions from ROM when applicable instead of ESP-IDF.

        If keeping this as "n" in your project, you will have less free IRAM.
        When compiling an application for a CPU that cannot access to the ROM memory,
        this option should be disabled.
```
