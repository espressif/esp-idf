## components/esp_driver_sdmmc/test_apps/sdmmc/sdkconfig.defaults.esp32p4
```kconfig
CONFIG_SDMMC_BOARD_ESP32P4_EV_BOARD=y

CONFIG_SPIRAM=y
CONFIG_IDF_EXPERIMENTAL_FEATURES=y
CONFIG_SPIRAM_SPEED_200M=y
CONFIG_ESP_CONSOLE_USB_SERIAL_JTAG=y
```

## components/esp_driver_spi/Kconfig
```kconfig
menu "ESP-Driver:SPI Configurations"
    depends on SOC_GPSPI_SUPPORTED
    config SPI_MASTER_IN_IRAM
        bool "Place transmitting functions of SPI master into IRAM"
        default n
        depends on !FREERTOS_PLACE_FUNCTIONS_INTO_FLASH
        select SPI_MASTER_ISR_IN_IRAM
        select ESP_SPI_BUS_LOCK_FUNCS_IN_IRAM
        help
            Normally only the ISR of SPI master is placed in the IRAM, so that it
            can work without the flash when interrupt is triggered.
            For other functions, there's some possibility that the flash cache
            miss when running inside and out of SPI functions, which may increase
            the interval of SPI transactions.
            Enable this to put ``queue_trans``, ``get_trans_result`` and
            ``transmit`` functions into the IRAM to avoid possible cache miss.

            This configuration won't be available if `CONFIG_FREERTOS_PLACE_FUNCTIONS_INTO_FLASH` is enabled.

            During unit test, this is enabled to measure the ideal case of api.

    config SPI_MASTER_ISR_IN_IRAM
        bool "Place SPI master ISR function into IRAM"
        default y
        depends on !HEAP_PLACE_FUNCTION_INTO_FLASH
        select PERIPH_CTRL_FUNC_IN_IRAM
        select HAL_SPI_MASTER_FUNC_IN_IRAM
        select ESP_SPI_BUS_LOCK_ISR_FUNCS_IN_IRAM
        select GDMA_CTRL_FUNC_IN_IRAM if SOC_GDMA_SUPPORTED
        help
            Place the SPI master ISR in to IRAM to avoid possible cache miss.

            Enabling this configuration is possible only when HEAP_PLACE_FUNCTION_INTO_FLASH
            is disabled since the spi master uses can allocate transactions buffers into DMA
            memory section using the heap component API that ipso facto has to be placed in IRAM.

            Also you can forbid the ISR being disabled during flash writing
            access, by add ESP_INTR_FLAG_IRAM when initializing the driver.

    config SPI_SLAVE_IN_IRAM
        bool "Place transmitting functions of SPI slave into IRAM"
        default n
        select SPI_SLAVE_ISR_IN_IRAM
        help
            Normally only the ISR of SPI slave is placed in the IRAM, so that it
            can work without the flash when interrupt is triggered.
            For other functions, there's some possibility that the flash cache
            miss when running inside and out of SPI functions, which may increase
            the interval of SPI transactions.
            Enable this to put ``queue_trans``, ``get_trans_result`` and
            ``transmit`` functions into the IRAM to avoid possible cache miss.

    config SPI_SLAVE_ISR_IN_IRAM
        bool "Place SPI slave ISR function into IRAM"
        default y
        select PERIPH_CTRL_FUNC_IN_IRAM
        select HAL_SPI_SLAVE_FUNC_IN_IRAM
        help
            Place the SPI slave ISR in to IRAM to avoid possible cache miss.

            Also you can forbid the ISR being disabled during flash writing
            access, by add ESP_INTR_FLAG_IRAM when initializing the driver.

endmenu # SPI Configuration
```

## components/esp_driver_spi/test_apps/master/sdkconfig.defaults.esp32
```kconfig
CONFIG_ESP_DEFAULT_CPU_FREQ_MHZ_240=y
CONFIG_XTAL_FREQ_AUTO=y
CONFIG_ESPTOOLPY_FLASHSIZE_4MB=y
CONFIG_SPI_FLASH_SHARE_SPI1_BUS=y
CONFIG_PARTITION_TABLE_CUSTOM=y
CONFIG_PARTITION_TABLE_CUSTOM_FILENAME="partition_table_esp32_flash.csv"
CONFIG_PARTITION_TABLE_FILENAME="partition_table_esp32_flash.csv"
CONFIG_PARTITION_TABLE_OFFSET=0x8000
```

## components/esp_driver_touch_sens/Kconfig
```kconfig
menu "ESP-Driver:Touch Sensor Configurations"
    depends on SOC_TOUCH_SENSOR_SUPPORTED
    config TOUCH_CTRL_FUNC_IN_IRAM
        bool "Place touch sensor control functions into IRAM"
        default n
        help
            Place touch sensor oneshot scanning and continuous scanning functions into IRAM,
            so that these function can be IRAM-safe and able to be called when the flash cache is disabled.
            Enabling this option can improve driver performance as well.

    config TOUCH_ISR_IRAM_SAFE
        bool "Touch sensor ISR IRAM-Safe"
        default n
        help
            Ensure the touch sensor interrupt is IRAM-Safe by allowing the interrupt handler to be
            executable when the cache is disabled (e.g. SPI Flash write).

    config TOUCH_ENABLE_DEBUG_LOG
        bool "Enable debug log"
        default n
        help
            Whether to enable the debug log message for touch driver.
            Note that, this option only controls the touch driver log, won't affect other drivers.

endmenu # Touch Sensor Configuration
```

## components/esp_driver_tsens/Kconfig
```kconfig
menu "ESP-Driver:Temperature Sensor Configurations"
    depends on SOC_TEMP_SENSOR_SUPPORTED

    config TEMP_SENSOR_ENABLE_DEBUG_LOG
        bool "Enable debug log"
        default n
        help
            whether to enable the debug log message for temperature sensor driver.
            Note that, this option only controls the temperature sensor driver log, won't affect other drivers.

    config TEMP_SENSOR_ISR_IRAM_SAFE
        depends on SOC_TEMPERATURE_SENSOR_INTR_SUPPORT
        bool "Temperature sensor ISR IRAM-Safe"
        default n
        help
            Ensure the Temperature Sensor interrupt is IRAM-Safe by allowing the interrupt handler to be
            executable when the cache is disabled (e.g. SPI Flash write).

endmenu # TEMP_SENSOR Configuration
```

## components/esp_driver_twai/Kconfig
```kconfig
menu "ESP-Driver:TWAI Configurations"
    depends on SOC_TWAI_SUPPORTED

    config TWAI_ISR_IN_IRAM
        bool "Place TWAI ISR function in IRAM"
        select TWAI_OBJ_CACHE_SAFE
        default n
        help
            Place the TWAI ISR in to IRAM to reduce latency and increase performance

    config TWAI_ISR_CACHE_SAFE
        bool "Allow TWAI ISR execute when cache disabled" if !SPI_FLASH_AUTO_SUSPEND
        select TWAI_ISR_IN_IRAM
        select ESP_PERIPH_CTRL_FUNC_IN_IRAM if TWAI_ERRATA_FIX_RX_FRAME_INVALID || TWAI_ERRATA_FIX_RX_FIFO_CORRUPT
        default n
        help
            Allow TWAI works under Cache disabled (such as when writing to SPI Flash),
            to enabled this config, all callbacks and user_ctx should also place in IRAM

    config TWAI_OBJ_CACHE_SAFE
        bool
        default n
        help
            This will ensure the TWAI driver object will not be allocated from a memory region
            where its cache can be disabled.

    config TWAI_ENABLE_DEBUG_LOG
        bool "Force enable debug log"
        default n
        help
            If enabled, TWAI driver component will:
            1. ignore the global logging settings
            2. compile all log messages into the binary
            3. set the runtime log level to VERBOSE
            Please enable this option by caution, as it will increase the binary size.

endmenu # TWAI Configuration
```

## components/esp_driver_uart/Kconfig
```kconfig
menu "ESP-Driver:UART Configurations"

    config UART_ISR_IN_IRAM
        bool "Place UART ISR function into IRAM"
        depends on !RINGBUF_PLACE_ISR_FUNCTIONS_INTO_FLASH
        select VFS_SELECT_IN_RAM if VFS_SUPPORT_SELECT
        default n
        help
            If this option is not selected, UART interrupt will be disabled for a long time and
            may cause data lost when doing spi flash operation.

endmenu

menu "ESP-Driver:UHCI Configurations"

    config UHCI_ISR_HANDLER_IN_IRAM
        bool "Place UHCI ISR function into IRAM"
        default n
        select GDMA_CTRL_FUNC_IN_IRAM if SOC_GDMA_SUPPORTED
        help
            If this option is not selected, UHCI interrupt will be disabled for a long time and
            may cause data lost when doing spi flash operation.

    config UHCI_ISR_CACHE_SAFE
        bool "Allow UHCI ISR to execute when cache is disabled" if !SPI_FLASH_AUTO_SUSPEND
        select UHCI_ISR_HANDLER_IN_IRAM
        select GDMA_ISR_HANDLER_IN_IRAM if SOC_GDMA_SUPPORTED
        default n
        help
            Enable this option to allow the ISR for UHCI to execute even when the cache is disabled.
            This can be useful in scenarios where the cache might be turned off, but the UHCI
            functionality is still required to operate correctly.

    config UHCI_ENABLE_DEBUG_LOG
        bool "Enable debug log"
        default n
        help
            whether to enable the debug log message for UHCI driver.
            Note that, this option only controls the UHCI driver log, won't affect other drivers.

endmenu
```

## components/esp_driver_uart/test_apps/rs485/sdkconfig.defaults.esp32
```kconfig
# For ESP32, only UART0 port has DTR/DSR signal
# In order to run the rs485 test cases fully, use UART1 as the console uart, so that UART0 can be the test port
CONFIG_ESP_CONSOLE_UART_CUSTOM=y
CONFIG_ESP_CONSOLE_UART_CUSTOM_NUM_1=y
```

## components/esp_driver_uart/test_apps/uart_vfs/sdkconfig.defaults
```kconfig
# Enable Unity fixture support
CONFIG_UNITY_ENABLE_FIXTURE=n
CONFIG_UNITY_ENABLE_IDF_TEST_RUNNER=y

# Custom partition table for this test app
CONFIG_PARTITION_TABLE_CUSTOM=y
CONFIG_PARTITION_TABLE_CUSTOM_FILENAME="partitions.csv"

CONFIG_ESP_TASK_WDT_INIT=n
```

## components/esp_driver_usb_serial_jtag/Kconfig
```kconfig
menu "ESP-Driver:USB Serial/JTAG Configuration"
    depends on SOC_USB_SERIAL_JTAG_SUPPORTED

    config USJ_ENABLE_USB_SERIAL_JTAG
        bool "Enable USB-Serial-JTAG Module"
        default y
        help
            The USB-Serial-JTAG module on ESP chips is turned on by default after power-on.
            If your application does not need it and not rely on it to be used as system
            console or use the built-in JTAG for debugging, you can disable this option,
            then the clock of this module will be disabled at startup, which will save
            some power consumption.

    config USJ_NO_AUTO_LS_ON_CONNECTION
        bool "Don't enter the automatic light sleep when USB Serial/JTAG port is connected"
        depends on PM_ENABLE && ESP_CONSOLE_USB_SERIAL_JTAG_ENABLED && !SOC_USB_SERIAL_JTAG_SUPPORT_LIGHT_SLEEP \
            && USJ_ENABLE_USB_SERIAL_JTAG
        default n
        help
            If enabled, the chip will constantly monitor the connection status of the USB Serial/JTAG port. As long
            as the USB Serial/JTAG is connected, a ESP_PM_NO_LIGHT_SLEEP power management lock will be acquired to
            prevent the system from entering light sleep.
            This option can be useful if serial monitoring is needed via USB Serial/JTAG while power management is
            enabled, as the USB Serial/JTAG cannot work under light sleep and after waking up from light sleep.
            Note. This option can only control the automatic Light-Sleep behavior. If esp_light_sleep_start() is
            called manually from the program, enabling this option will not prevent light sleep entry even if the
            USB Serial/JTAG is in use.
endmenu # USB Serial/JTAG Configuration
```

## components/esp_driver_usb_serial_jtag/test_apps/usb_serial_jtag/sdkconfig.defaults
```kconfig
CONFIG_FREERTOS_HZ=1000
CONFIG_ESP_TASK_WDT_INIT=n
CONFIG_ESP_CONSOLE_USB_SERIAL_JTAG=y
```

## components/esp_driver_usb_serial_jtag/test_apps/usb_serial_jtag_vfs/sdkconfig.defaults
```kconfig
# Enable Unity fixture support
CONFIG_UNITY_ENABLE_FIXTURE=n
CONFIG_UNITY_ENABLE_IDF_TEST_RUNNER=y

# Custom partition table for this test app
CONFIG_ESP_TASK_WDT_INIT=n

CONFIG_ESP_CONSOLE_USB_SERIAL_JTAG=y
```

## components/esp_eth/test_apps/main/Kconfig.projbuild
```kconfig
menu "esp_eth TEST_APPS Configuration"

    config ETH_TEST_UNITY_TEST_TASK_PRIO
        int "Unity test task priority"
        range 0 25
        default 5
        help
            Unity test task priority.

    config ETH_TEST_UNITY_TEST_TASK_STACK
        int "Unity test task stack size"
        default 4096
        help
            Unity test task stack size in B.

    config ETH_TEST_MAC_ADDR_UI
        bool "Expect Universal & Individual MAC address"
        default y
        help
            Enable this option to expect Universal & Individual MAC address.
            This should be disabled for SPI Ethernet devices.

    config ETH_TEST_PHY_ADDRESS_DISABLED
        bool "Disable PHY address test"
        default n
        help
            Disable PHY address testing.
            This should be disabled for SPI Ethernet devices.

    config ETH_TEST_LOOPBACK_DISABLED
        bool "Disable loopback test"
        default n
        help
            Disable loopback testing as some chips may not support it.

    config ETH_TEST_10MB_LOOPBACK_DISABLED
        depends on !ETH_TEST_LOOPBACK_DISABLED
        bool "Disable 10MB loopback test"
        default n
        help
            Disable 10MB loopback testing as some chips may not support it.

    config ETH_TEST_10MB_LOOPBACK_IGNORE_FAILURES
        depends on !ETH_TEST_LOOPBACK_DISABLED
        bool "Ignore 10MB loopback test failures"
        default y
        help
            Ignore failures in 10MB loopback tests.

    config ETH_TEST_LOOPBACK_WITH_AUTONEGOTIATION_DISABLED
        depends on !ETH_TEST_LOOPBACK_DISABLED
        bool "Disable loopback with autonegotiation test"
        default n
        help
            Disable loopback testing with autonegotiation.

    config ETH_TEST_FILL_RX_BUFFER_ITERATIONS
        int "Number of iterations for fill RX buffer test"
        range 1 100
        default 10
        help
            Number of iterations to fill RX buffer of module under test.
            For internal EMAC, it should be set as ETH_DMA_RX_BUFFER_NUM.
            For SPI modules, it should be set as RX_MEM_SIZE / ETH_MAX_PACKET_SIZE, where RX_MEM_SIZE is
            module specific RX buffer size in bytes as defined in datasheet.

    config ETH_TEST_LAN8720_ERRATA_ENABLED
        bool "Enable LAN8720 errata workaround"
        default n
        help
            Enable workaround for LAN8720 errata.
            Enable only when LAN8720 is under test!!

    config ETH_TEST_W5500_IP6_MCAST_DEVIATION_ENABLED
        bool "Enable W5500 IPv6 multicast deviation test"
        default n
        help
            W5500 always receives IPv6 multicast packets, even if the filter is set to block multicast.
            Enable only when W5500 is under test!!

    config ETH_TEST_STRESS_TEST_TASK_PRIO
        int "Start/stop stress test task priority"
        range -1 25
        default -1
        help
            The Rx Task may occupy all the resources under heavy Rx traffic and it would not be possible
            to access the Ethernet module to stop it. Therefore, the test task priority can be set higher than
            the Rx task to be able to preempt the Rx task.
            This option should be set for SPI Ethernet modules (>15), otherwise set -1 to use default priority.

endmenu
```
