## components/vfs/Kconfig
```kconfig
menu "Virtual file system"

    config VFS_SUPPORT_IO
        bool "Provide basic I/O functions"
        default y
        help
            If enabled, the following functions are provided by the VFS component.

            open, close, read, write, pread, pwrite, lseek, fstat, fsync, ioctl, fcntl

            Filesystem drivers can then be registered to handle these functions
            for specific paths.

            Disabling this option can save memory when the support for these functions
            is not required.

            Note that the following functions can still be used with socket file descriptors
            when this option is disabled:

            close, read, write, ioctl, fcntl.

    config VFS_SUPPORT_DIR
        bool "Provide directory related functions"
        default y
        # If some filesystem is used, adding I/O support is probably needed and
        # is not a big overhead, compared to code size of the filesystem,
        # so make this depend on IO.
        depends on VFS_SUPPORT_IO
        help
            If enabled, the following functions are provided by the VFS component.

            stat, link, unlink, rename, utime, access, truncate, rmdir, mkdir,
            opendir, closedir, readdir, readdir_r, seekdir, telldir, rewinddir

            Filesystem drivers can then be registered to handle these functions
            for specific paths.

            Disabling this option can save memory when the support for these functions
            is not required.

    config VFS_SUPPORT_SELECT
        bool "Provide select function"
        default y
        # Dependency on !LWIP_USE_ONLY_LWIP_SELECT is for compatibility
        depends on VFS_SUPPORT_IO && !LWIP_USE_ONLY_LWIP_SELECT
        help
            If enabled, select function is provided by the VFS component, and can be used
            on peripheral file descriptors (such as UART) and sockets at the same time.

            If disabled, the default select implementation will be provided by LWIP for
            sockets only.

            Disabling this option can reduce code size if support for "select" on UART file
            descriptors is not required.

    config VFS_SUPPRESS_SELECT_DEBUG_OUTPUT
        bool "Suppress select() related debug outputs"
        depends on VFS_SUPPORT_SELECT
        default y
        help
            Select() related functions might produce an inconveniently lot of
            debug outputs when one sets the default log level to DEBUG or higher.
            It is possible to suppress these debug outputs by enabling this
            option.

    config VFS_SELECT_IN_RAM
        bool "Make VFS driver select() callbacks IRAM-safe"
        default n
        depends on VFS_SUPPORT_SELECT
        help
            If enabled, VFS driver select() callback function will be placed in IRAM.

    config VFS_SUPPORT_TERMIOS
        bool "Provide termios.h functions"
        default y
        # Very likely, only makes sense for UART VFS driver, which itself depends on VFS_SUPPORT_IO
        depends on VFS_SUPPORT_IO
        help
            Disabling this option can save memory when the support for termios.h is not required.

    config VFS_MAX_COUNT
        int "Maximum Number of Virtual Filesystems"
        default 8
        range 1 20
        depends on VFS_SUPPORT_IO
        help
            Define maximum number of virtual filesystems that can be registered.


    menu "Host File System I/O (Semihosting)"
        depends on VFS_SUPPORT_IO

        config VFS_SEMIHOSTFS_MAX_MOUNT_POINTS
            int "Host FS: Maximum number of the host filesystem mount points"
            default 1
            help
                Define maximum number of host filesystem mount points.
    endmenu

endmenu
```

## components/wear_levelling/Kconfig
```kconfig
menu "Wear Levelling"

    choice WL_SECTOR_SIZE
        bool "Wear Levelling library sector size"
        default WL_SECTOR_SIZE_4096
        help
            Sector size used by wear levelling library.
            You can set default sector size or size that will
            fit to the flash device sector size.

            With sector size set to 4096 bytes, wear levelling library is more
            efficient. However if FAT filesystem is used on top of wear levelling
            library, it will need more temporary storage: 4096 bytes for each
            mounted filesystem and 4096 bytes for each opened file.

            With sector size set to 512 bytes, wear levelling library will perform
            more operations with flash memory, but less RAM will be used by FAT
            filesystem library (512 bytes for the filesystem and 512 bytes for each
            file opened).

        config WL_SECTOR_SIZE_512
            bool "512"
        config WL_SECTOR_SIZE_4096
            bool "4096"
    endchoice

    config WL_SECTOR_SIZE
        int
        default 512 if WL_SECTOR_SIZE_512
        default 4096 if WL_SECTOR_SIZE_4096

    choice WL_SECTOR_MODE
        bool "Sector store mode"
        depends on WL_SECTOR_SIZE_512
        default WL_SECTOR_MODE_SAFE
        help
            Specify the mode to store data into flash:

            - In Performance mode a data will be stored to the RAM and then
              stored back to the flash. Compared to the Safety mode, this operation is
              faster, but if power will be lost when erase sector operation is in
              progress, then the data from complete flash device sector will be lost.

            - In Safety mode data from complete flash device sector will be read from
              flash, modified, and then stored back to flash.
              Compared to the Performance mode, this operation is slower, but if
              power is lost during erase sector operation, then the data from full
              flash device sector will not be lost.

        config WL_SECTOR_MODE_PERF
            bool "Performance"

        config WL_SECTOR_MODE_SAFE
            bool "Safety"
    endchoice

    config WL_SECTOR_MODE
        int
        default 0 if WL_SECTOR_MODE_PERF
        default 1 if WL_SECTOR_MODE_SAFE

endmenu
```
