## components/unity/Kconfig
```kconfig
menu "Unity unit testing library"

    config UNITY_ENABLE_FLOAT
        bool "Support for float type"
        default y
        help
            If not set, assertions on float arguments will not be available.


    config UNITY_ENABLE_DOUBLE
        bool "Support for double type"
        default y
        help
            If not set, assertions on double arguments will not be available.

    config UNITY_ENABLE_64BIT
        bool "Support for 64-bit integer types"
        default n
        help
            If not set, assertions on 64-bit integer types will always fail.
            If this feature is enabled, take care not to pass pointers (which are 32 bit)
            to UNITY_ASSERT_EQUAL, as that will cause pointer-to-int-cast warnings.

    config UNITY_ENABLE_COLOR
        bool "Colorize test output"
        default n
        help
            If set, Unity will colorize test results using console escape sequences.


    config UNITY_ENABLE_IDF_TEST_RUNNER
        bool "Include ESP-IDF test registration/running helpers"
        default y
        help
            If set, then the following features will be available:

            - TEST_CASE macro which performs automatic registration of test functions
            - Functions to run registered test functions: unity_run_all_tests,
              unity_run_tests_with_filter, unity_run_single_test_by_name.
            - Interactive menu which lists test cases and allows choosing the tests to
              be run, available via unity_run_menu function.

            Disable if a different test registration mechanism is used.

    config UNITY_ENABLE_FIXTURE
        bool "Include Unity test fixture"
        default n
        help
            If set, unity_fixture.h header file and associated source files are part of
            the build. These provide an optional set of macros and functions to
            implement test groups.

    config UNITY_ENABLE_BACKTRACE_ON_FAIL
        bool "Print a backtrace when a unit test fails"
        default n
        help
            If set, the unity framework will print the backtrace information before
            jumping back to the test menu. The jumping is usually occurs in assert
            functions such as TEST_ASSERT, TEST_FAIL etc.

endmenu # "Unity unit testing library"
```

## components/usb/Kconfig
```kconfig
menu "USB-OTG"
    depends on SOC_USB_OTG_SUPPORTED

    config USB_HOST_CONTROL_TRANSFER_MAX_SIZE
        int "Largest size (in bytes) of transfers to/from default endpoints"
        default 256
        help
            Each USB device attached is allocated a dedicated buffer for its OUT/IN transfers to/from the device's
            control endpoint. The maximum size of that buffer is determined by this option. The limited size of the
            transfer buffer have the following implications:
            - The maximum length of control transfers is limited
            - Device's with configuration descriptors larger than this limit cannot be supported

    choice USB_HOST_HW_BUFFER_BIAS
        prompt "Hardware FIFO size biasing"
        default USB_HOST_HW_BUFFER_BIAS_BALANCED
        help
            The underlying hardware has size adjustable FIFOs to cache USB packets on reception (IN) or for
            transmission (OUT). The size of these FIFOs will affect the largest MPS (maximum packet size) and the
            maximum number of packets that can be cached at any one time. The hardware contains the following
            FIFOS: RX (for all IN packets), Non-periodic TX (for Bulk and Control OUT packets), and Periodic TX
            (for Interrupt and Isochronous OUT packets). This configuration option allows biasing the FIFO sizes
            towards a particular use case, which may be necessary for devices that have endpoints with large MPS.
            The MPS limits for each biasing are listed below:

            Balanced:
            - IN (all transfer types), 408 bytes
            - OUT non-periodic (Bulk/Control), 192 bytes (i.e., 3 x 64 byte packets)
            - OUT periodic (Interrupt/Isochronous), 192 bytes

            Bias IN:
            - IN (all transfer types), 600 bytes
            - OUT non-periodic (Bulk/Control), 64 bytes (i.e., 1 x 64 byte packets)
            - OUT periodic (Interrupt/Isochronous), 128 bytes

            Bias Periodic OUT:
            - IN (all transfer types), 128 bytes
            - OUT non-periodic (Bulk/Control), 64 bytes (i.e., 1 x 64 byte packets)
            - OUT periodic (Interrupt/Isochronous), 600 bytes

        config USB_HOST_HW_BUFFER_BIAS_BALANCED
            bool "Balanced"
        config USB_HOST_HW_BUFFER_BIAS_IN
            bool "Bias IN"
        config USB_HOST_HW_BUFFER_BIAS_PERIODIC_OUT
            bool "Periodic OUT"
    endchoice

    menu "Root Hub configuration"

        config USB_HOST_DEBOUNCE_DELAY_MS
            int "Debounce delay in ms"
            default 250
            help
                On connection of a USB device, the USB 2.0 specification requires a "debounce interval with a minimum
                duration of 100ms" to allow the connection to stabilize (see USB 2.0 chapter 7.1.7.3 for more details).
                During the debounce interval, no new connection/disconnection events are registered.

                The default value is set to 250 ms to be safe.

        config USB_HOST_RESET_HOLD_MS
            int "Reset hold in ms"
            default 30
            help
                The reset signaling can be generated on any Hub or Host Controller port by request from the USB System
                Software. The USB 2.0 specification requires that "the reset signaling must be driven for a minimum of
                10ms" (see USB 2.0 chapter 7.1.7.5 for more details).  After the reset, the hub port will transition to
                the Enabled state (refer to Section 11.5).

                The default value is set to 30 ms to be safe.

        config USB_HOST_RESET_RECOVERY_MS
            int "Reset recovery delay in ms"
            default 30
            help
                After a port stops driving the reset signal, the USB 2.0 specification requires that the "USB System
                Software guarantees a minimum of 10 ms for reset recovery" before the attached device is expected to
                respond to data transfers (see USB 2.0 chapter 7.1.7.3 for more details). The device may ignore any
                data transfers during the recovery interval.

                The default value is set to 30 ms to be safe.


        config USB_HOST_SET_ADDR_RECOVERY_MS
            int "SetAddress() recovery time in ms"
            default 10
            help
                "After successful completion of the Status stage, the device is allowed a SetAddress() recovery
                interval of 2 ms. At the end of this interval, the device must be able to accept Setup packets
                addressed to the new address. Also, at the end of the recovery interval, the device must not respond to
                tokens sent to the old address (unless, of course, the old and new address is the same)." See USB 2.0
                chapter 9.2.6.3 for more details.

                The default value is set to 10 ms to be safe.

    endmenu #Root Hub configuration

    # Hidden or compatibility options

    config USB_OTG_SUPPORTED
        # Invisible config kept for compatibility
        # Todo: Remove in v6.0 (IDF-8936)
        bool
        default y

    config USB_HOST_ENABLE_ENUM_FILTER_CALLBACK
        bool "Enable enumeration filter callback"
        default n
        help
            The enumeration filter callback is called before enumeration of each newly attached device. This callback
            allows users to control whether a device should be enumerated, and what configuration number to use when
            enumerating a device.

            If enabled, the enumeration filter callback can be set via 'usb_host_config_t' when calling
            'usb_host_install()'.

    config USB_HOST_EXT_HUB_SUPPORT
        depends on IDF_EXPERIMENTAL_FEATURES
        bool "Support USB HUB (Experimental)"
        default n
        help
            Feature is under development.

endmenu #USB-OTG
```

## components/usb/test_apps/common/Kconfig.common
```kconfig
menu "USB PHY Test"
    depends on IDF_TARGET_ESP32S2 || IDF_TARGET_ESP32S3

    orsource "$IDF_PATH/examples/common_components/env_caps/$IDF_TARGET/Kconfig.env_caps"

    config USB_PHY_TEST_OTG_DRVVBUS_ENABLE
        bool "Enable driving VBUS by an internal DRVVBUS signal"
        default n
        help
            USB-OTG peripheral features a DRVVBUS signal, which controls the VBUS voltage. The DRVVBUS signal can be
            either internally connected to a PHY (if a PHY supports it), in such a case the PHY would be controlling
            the VBUS voltage by itself. Or the DRVVBUS can be handled by an external logic (a transistor switch).
            Our PHY does not support the DRVVBUS signal, thus we must use an external logic to control the VBUS
            voltage. The DRVVBUS signal is controlled via HCD_PORT_CMD_POWER_OFF and HCD_PORT_CMD_POWER_ON

    config USB_PHY_TEST_OTG_DRVVBUS_GPIO
        depends on USB_PHY_TEST_OTG_DRVVBUS_ENABLE
        int "Connect a GPIO to the internal DRVVBUS signal"
        range ENV_GPIO_RANGE_MIN ENV_GPIO_OUT_RANGE_MAX
        default 1
        help
            GPIO number, that will be internally connected to the DRVVBUS signal.
            USB Host CI target runners feature an external power switch controlled by this GPIO, to control the VBUS
            voltage of USB devices during test.

endmenu
```

## components/usb/test_apps/enum/main/Kconfig.projbuild
```kconfig
menu "ENUM:: test configuration"

    config TINYUSB_DEBUG_LEVEL
        int "TinyUSB log level (0-3)"
        default 1
        range 0 3
        help
            Specify verbosity of TinyUSB log output.

endmenu
```

## components/usb/test_apps/ext_port/main/Kconfig.projbuild
```kconfig
source "$IDF_PATH/components/usb/test_apps/common/Kconfig.common"

menu "USB Host External Port test"

    config USB_HOST_TEST_HUB_PORT_NUM_DEVICE_FSHS
        int "Port number with Full-/High-speed device"
        default 1
        help
            Configure the number of the port, with a Full-/High-speed USB device.

    config USB_HOST_TEST_HUB_PORT_NUM_DEVICE_LS
        int "Port number with Low-speed device"
        default 2
        help
            Configure the number of the port, with a Low-speed USB device.

    config USB_HOST_TEST_HUB_PORT_NUM_EMPTY
        int "Empty Port number"
        default 3
        help
            Configure the number of the port, without device.

endmenu
```

## components/usb/test_apps/usb_host/main/Kconfig.projbuild
```kconfig
menu "USB Host Library Test"

    orsource "$IDF_PATH/examples/common_components/env_caps/$IDF_TARGET/Kconfig.env_caps"

    config USB_HOST_TEST_CHECK_MANU_STR
        bool "Check manufacturer string descriptor"
        default y
        help
            USB Host tests that check string descriptors will check the manufacturer string
            descriptor of the connected device.

    config USB_HOST_TEST_CHECK_PROD_STR
        bool "Check product string descriptor"
        default n
        help
            USB Host tests that check string descriptors will check the product string descriptor
            of the connected device.

    config USB_HOST_TEST_CHECK_SERIAL_STR
        bool "Check serial string descriptor"
        default n
        help
            USB Host tests that check string descriptors will check the serial string descriptor
            of the connected device.

    config USB_HOST_TEST_OTG_DRVVBUS_ENABLE
        depends on IDF_TARGET_ESP32S2 || IDF_TARGET_ESP32S3
        bool "Enable driving VBUS by an internal DRVVBUS signal from USB-OTG peripheral"
        default n
        help
            USB-OTG peripheral features a DRVVBUS signal, which controls the VBUS voltage. The DRVVBUS signal can be
            either internally connected to a PHY (if a PHY supports it), in such a case the PHY would be controlling
            the VBUS voltage by itself. Or the DRVVBUS can be handled by an external logic (a transistor switch).
            Our PHY does not support the DRVVBUS signal, thus we must use an external logic to control the VBUS
            voltage. The DRVVBUS signal is controlled via HCD_PORT_CMD_POWER_OFF and HCD_PORT_CMD_POWER_ON

    config USB_HOST_TEST_OTG_DRVVBUS_GPIO
        depends on USB_HOST_TEST_OTG_DRVVBUS_ENABLE
        int "Connect a GPIO to the internal DRVVBUS signal"
        range ENV_GPIO_RANGE_MIN ENV_GPIO_OUT_RANGE_MAX
        default 1
        help
            GPIO number, that will be internally connected to the DRVVBUS signal.
            USB Host CI target runners feature an external power switch controlled by this GPIO, to control the VBUS
            voltage of USB devices during test.

endmenu
```
