## components/spiffs/Kconfig
```kconfig
menu "SPIFFS Configuration"

config SPIFFS_MAX_PARTITIONS
    int "Maximum Number of Partitions"
    default 3
    range 1 10
    help
        Define maximum number of partitions that can be mounted.

menu "SPIFFS Cache Configuration"
config SPIFFS_CACHE
    bool "Enable SPIFFS Cache"
    default "y"
    help
        Enables/disable memory read caching of nucleus file system 
        operations.

config SPIFFS_CACHE_WR
    bool "Enable SPIFFS Write Caching"
    default "y"
    depends on SPIFFS_CACHE
    help
        Enables memory write caching for file descriptors in hydrogen.

config SPIFFS_CACHE_STATS
    bool "Enable SPIFFS Cache Statistics"
    default "n"
    depends on SPIFFS_CACHE
    help
        Enable/disable statistics on caching. Debug/test purpose only.

endmenu

config SPIFFS_PAGE_CHECK
    bool "Enable SPIFFS Page Check"
    default "y"
    help
        Always check header of each accessed page to ensure consistent state.
        If enabled it will increase number of reads from flash, especially
        if cache is disabled.

config SPIFFS_GC_MAX_RUNS
    int "Set Maximum GC Runs"
    default 10
    range 1 255
    help
        Define maximum number of GC runs to perform to reach desired free pages.

config SPIFFS_GC_STATS
    bool "Enable SPIFFS GC Statistics"
    default "n"
    help
        Enable/disable statistics on gc. Debug/test purpose only.

config SPIFFS_PAGE_SIZE
	int "SPIFFS logical page size"
	default 256
	range 256 1024
	help
		Logical page size of SPIFFS partition, in bytes. Must be multiple
		of flash page size (which is usually 256 bytes).
		Larger page sizes reduce overhead when storing large files, and
		improve filesystem performance when reading large files.
		Smaller page sizes reduce overhead when storing small (< page size)
		files.

config SPIFFS_OBJ_NAME_LEN
    int "Set SPIFFS Maximum Name Length"
    default 32
    range 1 256
    help
        Object name maximum length. Note that this length include the 
        zero-termination character, meaning maximum string of characters
        can at most be SPIFFS_OBJ_NAME_LEN - 1.
        
        SPIFFS_OBJ_NAME_LEN + SPIFFS_META_LENGTH should not exceed
        SPIFFS_PAGE_SIZE - 64.

config SPIFFS_USE_MAGIC
    bool "Enable SPIFFS Filesystem Magic"
    default "y"
    help
        Enable this to have an identifiable spiffs filesystem. 
        This will look for a magic in all sectors to determine if this
        is a valid spiffs system or not at mount time.

config SPIFFS_USE_MAGIC_LENGTH
    bool "Enable SPIFFS Filesystem Length Magic"
    default "y"
    depends on SPIFFS_USE_MAGIC
    help
        If this option is enabled, the magic will also be dependent 
        on the length of the filesystem. For example, a filesystem 
        configured and formatted for 4 megabytes will not be accepted 
        for mounting with a configuration defining the filesystem as 2 megabytes.

config SPIFFS_META_LENGTH
    int "Size of per-file metadata field"
    default 4
    help
        This option sets the number of extra bytes stored in the file header.
        These bytes can be used in an application-specific manner.
        Set this to at least 4 bytes to enable support for saving file
        modification time.
        
        SPIFFS_OBJ_NAME_LEN + SPIFFS_META_LENGTH should not exceed
        SPIFFS_PAGE_SIZE - 64.

config SPIFFS_USE_MTIME
    bool "Save file modification time"
    default "y"
    depends on SPIFFS_META_LENGTH >= 4
    help
        If enabled, then the first 4 bytes of per-file metadata will be used
        to store file modification time (mtime), accessible through
        stat/fstat functions.
        Modification time is updated when the file is opened.

menu "Debug Configuration"

config SPIFFS_DBG
    bool "Enable general SPIFFS debug"
    default "n"
    help
        Enabling this option will print general debug mesages to the console.

config SPIFFS_API_DBG
    bool "Enable SPIFFS API debug"
    default "n"
    help
        Enabling this option will print API debug mesages to the console.

config SPIFFS_GC_DBG
    bool "Enable SPIFFS Garbage Cleaner debug"
    default "n"
    help
        Enabling this option will print GC debug mesages to the console.

config SPIFFS_CACHE_DBG
    bool "Enable SPIFFS Cache debug"
    default "n"
    depends on SPIFFS_CACHE
    help
        Enabling this option will print cache debug mesages to the console.

config SPIFFS_CHECK_DBG
    bool "Enable SPIFFS Filesystem Check debug"
    default "n"
    help
        Enabling this option will print Filesystem Check debug mesages
        to the console.

config SPIFFS_TEST_VISUALISATION
    bool "Enable SPIFFS Filesystem Visualization"
    default "n"
    help
        Enable this option to enable SPIFFS_vis function in the API.

endmenu

endmenu
```

## components/spiffs/host_test/sdkconfig.defaults
```kconfig
CONFIG_IDF_TARGET="linux"
CONFIG_COMPILER_CXX_EXCEPTIONS=y
CONFIG_UNITY_ENABLE_IDF_TEST_RUNNER=n
CONFIG_UNITY_ENABLE_FIXTURE=y
CONFIG_PARTITION_TABLE_CUSTOM=y
CONFIG_PARTITION_TABLE_CUSTOM_FILENAME="partition_table.csv"
```

## components/spiffs/test_apps/sdkconfig.defaults
```kconfig
# General options for additional checks
CONFIG_HEAP_POISONING_COMPREHENSIVE=y
CONFIG_COMPILER_WARN_WRITE_STRINGS=y
CONFIG_FREERTOS_WATCHPOINT_END_OF_STACK=y
CONFIG_COMPILER_STACK_CHECK_MODE_STRONG=y
CONFIG_COMPILER_STACK_CHECK=y

# Disable the task watchdog since this app uses an interactive menu
CONFIG_ESP_TASK_WDT_INIT=n

# Custom partition table for this test app
CONFIG_PARTITION_TABLE_CUSTOM=y
CONFIG_PARTITION_TABLE_CUSTOM_FILENAME="partitions.csv"

# SPIFFS-specific settings
CONFIG_SPIFFS_USE_MTIME=y

# Set sufficient number of GC runs for SPIFFS:
# size of the storage partition divided by flash sector size.
# See esp_spiffs_gc description for more info.
CONFIG_SPIFFS_GC_MAX_RUNS=64
```

## components/tcp_transport/Kconfig
```kconfig
menu "TCP Transport"

    menu "Websocket"
        config WS_TRANSPORT
            bool "Enable Websocket Transport"
            default y
            help
                Enable support for creating websocket transport.

        config WS_BUFFER_SIZE
            int "Websocket transport buffer size"
            default 1024
            depends on WS_TRANSPORT
            help
                Size of the buffer used for constructing the HTTP Upgrade request during connect

        config WS_DYNAMIC_BUFFER
            bool "Using dynamic websocket transport buffer"
            default n
            depends on WS_TRANSPORT
            help
                If enable this option, websocket transport buffer will be freed after connection
                succeed to save more heap.
    endmenu

endmenu
```

## components/tcpip_adapter/Kconfig
```kconfig
menu "tcpip adapter"

config IP_LOST_TIMER_INTERVAL
    int "IP Address lost timer interval (seconds)"
    range 0 65535
    default 120
    help
        The value of 0 indicates the IP lost timer is disabled, otherwise the timer is enabled.
        
        The IP address may be lost because of some reasons, e.g. when the station disconnects
        from soft-AP, or when DHCP IP renew fails etc. If the IP lost timer is enabled, it will 
        be started everytime the IP is lost. Event SYSTEM_EVENT_STA_LOST_IP will be raised if
        the timer expires. The IP lost timer is stopped if the station get the IP again before
        the timer expires.

endmenu
```

## components/tinyusb/Kconfig
```kconfig
menu "TinyUSB Stack"
    visible if USB_OTG_SUPPORTED

    config TINYUSB
        bool "Use TinyUSB Stack"
        depends on USB_OTG_SUPPORTED
        default n
        help
            Enable TinyUSB stack support.
            Note that, esp-idf only uses the device stack provided by TinyUSB.

    if TINYUSB
        config TINYUSB_DEBUG_LEVEL
            int "TinyUSB log level (0-3)"
            default 0
            range 0 3
            help
                Specify verbosity of TinyUSB log output.

        menu "TinyUSB task configuration"
            config TINYUSB_NO_DEFAULT_TASK
                bool "Do not create a TinyUSB task"
                default n
                help
                    This option allows to not create the FreeRTOS task during the driver initialization.
                    User will have to handle TinyUSB events manually.

            config TINYUSB_TASK_PRIORITY
                int "TinyUSB task priority"
                default 5
                depends on !TINYUSB_NO_DEFAULT_TASK
                help
                    Set the priority of the default TinyUSB main task.

            config TINYUSB_TASK_STACK_SIZE
                int "TinyUSB task stack size (bytes)"
                default 4096
                depends on !TINYUSB_NO_DEFAULT_TASK
                help
                    Set the stack size of the default TinyUSB main task.
        endmenu

        menu "Descriptor configuration"
            config TINYUSB_DESC_USE_ESPRESSIF_VID
                bool "VID: Use Espressif's vendor ID"
                default y
                help
                    Enable this option, USB device will use Espressif's vendor ID as its VID.
                    This is helpful at product develop stage.

            config TINYUSB_DESC_CUSTOM_VID
                hex "VID: Custom vendor ID"
                default 0x1234
                depends on !TINYUSB_DESC_USE_ESPRESSIF_VID
                help
                    Custom Vendor ID.

            config TINYUSB_DESC_USE_DEFAULT_PID
                bool "PID: Use a default PID assigned to TinyUSB"
                default y
                help
                    Default TinyUSB PID assigning uses values 0x4000...0x4007.

            config TINYUSB_DESC_CUSTOM_PID
                hex "PID: Custom product ID"
                default 0x5678
                depends on !TINYUSB_DESC_USE_DEFAULT_PID
                help
                    Custom Product ID.

            config TINYUSB_DESC_BCD_DEVICE
                hex "bcdDevice"
                default 0x0100
                help
                    Version of the firmware of the USB device.

            config TINYUSB_DESC_MANUFACTURER_STRING
                string "Manufacturer name"
                default "Espressif Systems"
                help
                    Name of the manufacturer of the USB device.

            config TINYUSB_DESC_PRODUCT_STRING
                string "Product name"
                default "Espressif Device"
                help
                    Name of the USB device.

            config TINYUSB_DESC_SERIAL_STRING
                string "Serial string"
                default "123456"
                help
                    Serial number of the USB device.

            config TINYUSB_DESC_CDC_STRING
                depends on TINYUSB_CDC_ENABLED
                string "CDC Device String"
                default "Espressif CDC Device"
                help
                    Name of the CDC device.

            config TINYUSB_DESC_MSC_STRING
                depends on TINYUSB_MSC_ENABLED
                string "MSC Device String"
                default "Espressif MSC Device"
                help
                    Name of the MSC device.

            config TINYUSB_DESC_HID_STRING
                depends on TINYUSB_HID_ENABLED
                string "HID Device String"
                default "Espressif HID Device"
                help
                    Name of the HID device
        endmenu # "Descriptor configuration"

        menu "Massive Storage Class (MSC)"
            config TINYUSB_MSC_ENABLED
                bool "Enable TinyUSB MSC feature"
                default n
                help
                    Enable TinyUSB MSC feature.

            config TINYUSB_MSC_BUFSIZE
                depends on TINYUSB_MSC_ENABLED
                int "MSC FIFO size"
                default 512
                help
                    MSC FIFO size, in bytes.
        endmenu # "Massive Storage Class"

        menu "Communication Device Class (CDC)"
            config TINYUSB_CDC_ENABLED
                bool "Enable TinyUSB CDC feature"
                default n
                help
                    Enable TinyUSB CDC feature.

            config TINYUSB_CDC_RX_BUFSIZE
                depends on TINYUSB_CDC_ENABLED
                int "CDC FIFO size of RX channel"
                default 64
                help
                    CDC FIFO size of RX channel.

            config TINYUSB_CDC_TX_BUFSIZE
                depends on TINYUSB_CDC_ENABLED
                int "CDC FIFO size of TX channel"
                default 64
                help
                    CDC FIFO size of TX channel.
        endmenu # "Communication Device Class"
    endif # TINYUSB

endmenu # "TinyUSB Stack"
```

## components/touch_element/Kconfig
```kconfig
menu "Touch Element"

    config TE_SKIP_DSLEEP_WAKEUP_CALIBRATION
        bool "Enable skip deep sleep wakeup calibration"
        default n
        help
            This option allows to store all Touch Sensor channels' threshold into RTC Fast Memory. So that Touch Sensor
            threshold will only be configured once after Power-on Reset.

endmenu
```

## components/touch_element/test_apps/sdkconfig.defaults
```kconfig
CONFIG_FREERTOS_HZ=1000
CONFIG_ESP_TASK_WDT=n
CONFIG_ESP_MAIN_TASK_STACK_SIZE=8192
```

## components/ulp/test_apps/lp_core/lp_core_basic_tests/main/Kconfig.projbuild
```kconfig
menu "Test Configurations"

    config TEST_LP_CORE_VAD_ENABLE
        bool "Enable LP VAD test"
        default n
        help
            Enable this to trigger LP VAD test

endmenu
```

## components/ulp/test_apps/lp_core/lp_core_gpio_wakeup_tests/main/Kconfig.projbuild
```kconfig
menu "LP GPIO Wakeup Test Configuration"

    config TEST_LP_GPIO_WAKEUP_PIN
        int "GPIO pin wired between wakee and waker boards"
        default 2
        help
            RTC GPIO pin used for LP core GPIO wakeup on the sleeping board.
            The same pin number must be wired to the GPIO output on the waker board.

endmenu
```

## components/ulp/test_apps/lp_core/lp_core_hp_mem/sdkconfig.defaults
```kconfig
CONFIG_ESP_TASK_WDT_INIT=n

CONFIG_ULP_COPROC_ENABLED=y
CONFIG_ULP_COPROC_TYPE_LP_CORE=y
CONFIG_ULP_COPROC_RESERVE_MEM=12000
CONFIG_ULP_COPROC_RUN_FROM_HP_MEM=y
CONFIG_ULP_COPROC_RESERVE_HP_MEM_BYTES=0x10000
CONFIG_ULP_HP_UART_CONSOLE_PRINT=y
```

## components/ulp/test_apps/lp_core/sdkconfig.defaults
```kconfig
CONFIG_ESP_TASK_WDT_INIT=n

CONFIG_ULP_COPROC_ENABLED=y
CONFIG_ULP_COPROC_TYPE_LP_CORE=y
CONFIG_ULP_COPROC_RESERVE_MEM=4096
```

## components/ulp/test_apps/ulp_fsm/sdkconfig.defaults
```kconfig
CONFIG_ESP_TASK_WDT=n

CONFIG_ULP_COPROC_ENABLED=y
CONFIG_ULP_COPROC_TYPE_FSM=y
CONFIG_ULP_COPROC_RESERVE_MEM=4096
```

## components/ulp/test_apps/ulp_riscv/sdkconfig.defaults
```kconfig
CONFIG_ESP_TASK_WDT_EN=n

CONFIG_ULP_COPROC_ENABLED=y
CONFIG_ULP_COPROC_TYPE_RISCV=y
CONFIG_ULP_COPROC_RESERVE_MEM=4096

# RTC I2C timeout: default 500 cycles is too short for real I2C transactions.
# At 17.5 MHz ULP clock, the first RX_DATA interrupt arrives after ~1140 cycles.
CONFIG_ULP_RISCV_I2C_RW_TIMEOUT=5000
```
