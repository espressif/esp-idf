## components/esp_sleep/Kconfig
```kconfig
menu "Sleep Config"
    # This is here since this option affect behavior of esp_light_sleep_start
    # regardless of power management configuration.
    config ESP_SLEEP_POWER_DOWN_FLASH
        bool "Power down flash in light sleep when there is no SPIRAM or SPIRAM has independent power supply"
        select PM_SLP_IRAM_OPT
        select ESP_PERIPH_CTRL_FUNC_IN_IRAM
        select ESP_REGI2C_CTRL_FUNC_IN_IRAM
        depends on !SPIRAM || ESP_LDO_RESERVE_PSRAM || SOC_PSRAM_HAS_DEDICATED_LDO
        depends on !(IDF_TARGET_ESP32P4 && (ESP32P4_REV_MIN_FULL < 100))
        depends on !SOC_PM_FLASH_KEEP_POWER_IN_LSLP
        default n
        help
            If enabled, chip will try to power down flash as part of esp_light_sleep_start(), which costs
            more time when chip wakes up. Can only be enabled if there is no SPIRAM configured.

            This option will power down flash under a strict but relatively safe condition. Also, it is possible to
            power down flash under a relaxed condition by using esp_sleep_pd_config() to set ESP_PD_DOMAIN_VDDSDIO
            to ESP_PD_OPTION_OFF. It should be noted that there is a risk in powering down flash, you can refer
            `ESP-IDF Programming Guide/API Reference/System API/Sleep Modes/Power-down of Flash` for more details.

    config ESP_SLEEP_FLASH_LEAKAGE_WORKAROUND
        bool "Pull-up Flash CS pin in light sleep"
        depends on !APP_BUILD_TYPE_PURE_RAM_APP
        default y
        help
            All IOs will be set to isolate(floating) state by default during sleep.
            Since the power supply of SPI Flash is not lost during lightsleep, if its CS pin is recognized as
            low level(selected state) in the floating state, there will be a large current leakage, and the
            data in Flash may be corrupted by random signals on other SPI pins.
            Select this option will set the CS pin of Flash to PULL-UP state during sleep, but this will
            increase the sleep current about 10 uA.
            If you are developing with esp32xx modules, you must select this option, but if you are developing
            with chips, you can also pull up the CS pin of SPI Flash in the external circuit to save power
            consumption caused by internal pull-up during sleep.
            (!!! Don't deselect this option if you don't have external SPI Flash CS pin pullups.)

    config ESP_SLEEP_PSRAM_LEAKAGE_WORKAROUND
        bool "Pull-up PSRAM CS pin in light sleep"
        depends on SPIRAM
        default y
        help
            All IOs will be set to isolate(floating) state by default during sleep.
            Since the power supply of PSRAM is not lost during lightsleep, if its CS pin is recognized as
            low level(selected state) in the floating state, there will be a large current leakage, and the
            data in PSRAM may be corrupted by random signals on other SPI pins.
            Select this option will set the CS pin of PSRAM to PULL-UP state during sleep, but this will
            increase the sleep current about 10 uA.
            If you are developing with esp32xx modules, you must select this option, but if you are developing
            with chips, you can also pull up the CS pin of PSRAM in the external circuit to save power
            consumption caused by internal pull-up during sleep.
            (!!! Don't deselect this option if you don't have external PSRAM CS pin pullups.)

    config ESP_SLEEP_MSPI_NEED_ALL_IO_PU
        bool "Pull-up all SPI pins in light sleep"
        depends on (ESP_SLEEP_PSRAM_LEAKAGE_WORKAROUND || ESP_SLEEP_FLASH_LEAKAGE_WORKAROUND)
        default y if IDF_TARGET_ESP32C2 || IDF_TARGET_ESP32S3
        help
            To reduce leakage current, some types of SPI Flash/RAM only need to pull up the CS pin
            during light sleep. But there are also some kinds of SPI Flash/RAM that need to pull up
            all pins. It depends on the SPI Flash/RAM chip used.

    config ESP_SLEEP_RTC_BUS_ISO_WORKAROUND
        bool
        default y if IDF_TARGET_ESP32 || IDF_TARGET_ESP32S2 || IDF_TARGET_ESP32S3

    config ESP_SLEEP_GPIO_RESET_WORKAROUND
        bool "light sleep GPIO reset workaround"
        default y if !(IDF_TARGET_ESP32 || IDF_TARGET_ESP32S2)
        select PM_SLP_DISABLE_GPIO if FREERTOS_USE_TICKLESS_IDLE
        help
            All existing chips except esp32 and esp32s2 will reset on wake-up if a GPIO receives
            a small electrostatic pulse during light sleep, with specific conditions.

            - GPIO needs to be configured as input-mode only
            - The pin receives a small electrostatic pulse, and reset occurs when the pulse
              voltage is higher than 6 V

            For GPIO set to input mode only, it is not a good practice to leave it open/floating,
            The hardware design needs to controlled it with determined supply or ground voltage
            is necessary.

            This option provides a software workaround for this issue. Configure to isolate all
            GPIO pins in sleep state.

    config ESP_SLEEP_WAIT_FLASH_READY_EXTRA_DELAY
        int "Extra delay (in us) after flash powerdown sleep wakeup to wait flash ready"
        default 2000 if IDF_TARGET_ESP32 || IDF_TARGET_ESP32S3
        default 0
        range 0 5000
        help
            When the chip exits sleep, the CPU and the flash chip are powered on at the same time.
            CPU will run rom code (deepsleep) or ram code (lightsleep) first, and then load or execute
            code from flash.

            Some flash chips need sufficient time to pass between power on and first read operation.
            By default, without any extra delay, this time is approximately 900us, although
            some flash chip types need more than that.

            (!!! Please adjust this value according to the Data Sheet of SPI Flash used in your project.)
            In Flash Data Sheet, the parameters that define the Flash ready timing after power-up (minimum
            time from Vcc(min) to CS active) are usually named tVSL in ELECTRICAL CHARACTERISTICS chapter,
            and the configuration value here should be:
            ESP_SLEEP_WAIT_FLASH_READY_EXTRA_DELAY = tVSL - 900

            For esp32 and esp32s3, the default extra delay is set to 2000us. When optimizing startup time
            for applications which require it, this value may be reduced.

            If you are seeing "flash read err, 1000" message printed to the console after deep sleep reset
            on esp32, or triggered RTC_WDT/LP_WDT after lightsleep wakeup, try increasing this value.
            (For esp32, the delay will be executed in both deep sleep and light sleep wake up flow.
            For chips after esp32, the delay will be executed only in light sleep flow, the delay
            controlled by the EFUSE_FLASH_TPUW in ROM will be executed in deepsleep wake up flow.)

    config ESP_SLEEP_CACHE_SAFE_ASSERTION
        bool "Check the cache safety of the sleep wakeup code in sleep process"
        default n
        select ESP_PANIC_HANDLER_IRAM
        help
            Enabling it will check the cache safety of the code before the flash power is ready after
            light sleep wakeup, and check PM_SLP_IRAM_OPT related code cache safety. This option is
            only for code quality inspection. Enabling it will increase the time overhead of entering
            and exiting sleep. It is not recommended to enable it in the release version.

    config ESP_SLEEP_DEBUG
        bool "esp sleep debug"
        default n
        help
            Enable esp sleep debug.

    config ESP_SLEEP_GPIO_ENABLE_INTERNAL_RESISTORS
        bool "Allow to enable internal pull-up/downs for the Deep-Sleep wakeup IOs"
        default y
        help
            When using rtc gpio wakeup source during deepsleep without external pull-up/downs, you may want to
            make use of the internal ones.

    config ESP_SLEEP_EVENT_CALLBACKS
        bool "Enable registration of sleep event callbacks"
        depends on FREERTOS_USE_TICKLESS_IDLE
        default n
        help
            If enabled, it allows user to register sleep event callbacks. It is primarily designed for internal
            developers and customers can use PM_LIGHT_SLEEP_CALLBACKS as an alternative.

            NOTE: These callbacks are executed from the IDLE task context hence you cannot have any blocking calls
            in your callbacks.

            NOTE: Enabling these callbacks may change sleep duration calculations based on time spent in
            callback and hence it is highly recommended to keep them as short as possible.

    config ESP_SLEEP_SET_FLASH_DPD
        bool "Set SPI flash to deep power-down mode in light sleep"
        depends on (!APP_BUILD_TYPE_PURE_RAM_APP && !ESP_SLEEP_POWER_DOWN_FLASH && !SPI_FLASH_ROM_IMPL)
        default y if SOC_PM_FLASH_KEEP_POWER_IN_LSLP
        default y if (IDF_TARGET_ESP32P4 && ESP32P4_SELECTS_REV_LESS_V3)
        default n
        help
            Deep Power-Down mode is a power mode supported by most SPI Flash, SPI Flash has better power
            consumption performance in this mode comparing to standby mode (hold CS).
            Enabling this option will set the SPI Flash to deep power down mode during lightsleep to save power,
            which will reduce the sleep current by about 10uA. And you can also use this option to reduce power
            consumption when using PSRAM

            NOTE: We have conducted sufficient testing on ESP32-C5, ESP32-C61, ESP32-H21, ESP32-H4 and
            ESP32-P4 (less v3). If you plan to use a customized flash chip, or if you are working with other
            ESP32-series chips, please make sure to check the corresponding flash datasheet or consult us
            directly. This is to ensure that using the B9h command to enter Deep Power-Down mode and ABh to exit.

    config ESP_SLEEP_SPI_FLASH_ENTER_DPD_MODE_DELAY
        int "SPI Flash enter deep power-down time delay (in us)"
        depends on ESP_SLEEP_SET_FLASH_DPD
        default 25
        range 0 100
        help
            When used to set the SPI Flash to enter the Deep Power-Down mode, the command is issued by driving
            CS pin low, shifting the instruction code "B9H" and driving CS high, enter Deep Power-Down mode will
            take the time duration of tDP before the supply current is reduced and Deep Power-down mode is
            entered. The CS pin must keep high during the tDP time duration, adjust the value of this option to
            configure the value of tDP, different types of flash require different tDP values, usually no more
            than 20us, please refer to the datasheet of the used Flash to configure this option.

    config ESP_SLEEP_SPI_FLASH_EXIT_DPD_MODE_DELAY
        int "SPI Flash exit from deep power-down time delay (in us)"
        depends on ESP_SLEEP_SET_FLASH_DPD
        default 40
        range 0 100
        help
            When used to exit the SPI Flash from the Deep Power-Down mode, the command is issued by driving the
            CS pin low, shifting the instruction code "ABH" and driving CS high, release from Deep Power-Down will
            take the time duration of tRES1 before the SPI FLASH will resume normal operation and other command are
            accepted. The CS pin must keep high during the tRES1 time duration, adjust the value of this option
            to configure the value of tRES1, different types of flash require different tRES1 values, usually no
            more than 35us, please refer to the datasheet of the used Flash to configure this option.

    config ESP_SLEEP_ENABLE_RTC_WDT_IN_SLEEP
        bool "Enable rtc wdt during sleep (EXPERIMENTAL)"
        depends on IDF_EXPERIMENTAL_FEATURES
        depends on (SOC_LIGHT_SLEEP_SUPPORTED || SOC_DEEP_SLEEP_SUPPORTED)
        default n
        help
            If enabled, rtc watchdog will remain active during sleep to prevent program runaway. Specifically, its
            timeout will be set as the sum of the sleep duration, hardware overhead time, and RTC slow clock
            compensation time.

            NOTE: This feature only works when a timer wakeup is used. In the current phase, the RTC slow clock
            compensation time remains zero (pending implementation). When using the RC_SLOW_CLK clock without
            calibration, the maximum continuous sleep duration is typically around 5 minutes, and may vary
            between chips. Therefore, avoid configuring sleep periods longer than this when enabling this option.


    config ESP_SLEEP_ENABLE_RTC_WDT_IN_DEEP_SLEEP
        bool "Enable rtc wdt during deep sleep (EXPERIMENTAL)"
        depends on IDF_EXPERIMENTAL_FEATURES
        depends on SOC_DEEP_SLEEP_SUPPORTED
        default n
        help
            If enabled, rtc watchdog will remain active during deep sleep to prevent program runaway.

            NOTE: This feature only works when a timer wakeup is used. In the current phase, the RTC watchdog
            will not be disabled or reset after waking from deep sleep. Even though it will be reconfigured
            during the bootloader phase, there remains a concern that a timeout could occur before this
            reconfiguration is completed.

    orsource "./port/esp32p4/Kconfig.p4_rev3_mspi_workaround"
endmenu
```

## components/esp_stdio/test_apps/custom_io/sdkconfig.defaults
```kconfig
CONFIG_IDF_TARGET="linux"
CONFIG_VFS_SUPPORT_IO=y
CONFIG_ESP_STDIO_MAX_VFS_ENTRIES=3
```

## components/esp_system/test_apps/linux_wdt/sdkconfig.defaults
```kconfig
CONFIG_IDF_TARGET="linux"
CONFIG_ESP_INT_WDT=y
CONFIG_ESP_INT_WDT_TIMEOUT_MS=300
CONFIG_ESP_TASK_WDT_EN=y
CONFIG_ESP_TASK_WDT_INIT=y
CONFIG_ESP_TASK_WDT_TIMEOUT_S=5
CONFIG_ESP_TASK_WDT_CHECK_IDLE_TASK_CPU0=y
```

## components/esp_timer/test_apps/size_metrics/main/Kconfig.projbuild
```kconfig
menu "Size Metrics Test App Configuration"

    choice SIZE_METRICS_FUNCTION_SET
        prompt "Function set to compile"
        default SIZE_METRICS_FUNCTION_SET_MINIMAL
        help
            Select which set of functions to compile for size metrics comparison.
            Minimal set includes only basic functions, full set includes all features.

        config SIZE_METRICS_FUNCTION_SET_MINIMAL
            bool "Minimal function set"

        config SIZE_METRICS_FUNCTION_SET_FULL
            bool "Full function set"

    endchoice

endmenu
```
