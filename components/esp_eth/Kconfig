## components/esp_eth/test_apps/test_app_sublayer/sdkconfig.defaults
```kconfig
CONFIG_ESP_MAIN_TASK_STACK_SIZE=4096

CONFIG_UNITY_ENABLE_FIXTURE=y
CONFIG_UNITY_ENABLE_IDF_TEST_RUNNER=y
CONFIG_ETH_USE_ESP32_EMAC=y
CONFIG_ESP_TASK_WDT_EN=n

# interface configuration
CONFIG_ETHERNET_INTERNAL_SUPPORT=y
CONFIG_ETHERNET_PHY_GENERIC=y
CONFIG_ETHERNET_DEFAULT_EVENT_HANDLER=n

CONFIG_ESP_NETIF_L2_TAP=y
CONFIG_ETH_TRANSMIT_MUTEX=n

CONFIG_IDF_EXPERIMENTAL_FEATURES=y
CONFIG_ETH_SUBLAYER_SUPPORT=y
CONFIG_ETH_SUBLAYER_TRANSMIT_MUTEX=y
CONFIG_ETH_SUBLAYER_TX_BUF_DESC_CAPACITY=3
CONFIG_ETH_SUBLAYER_VLAN_SUPPORT=y
```

## components/esp_hal_security/Kconfig.hal_security
```kconfig
config HAL_ECDSA_GEN_SIG_CM
    bool "Enable countermeasure for ECDSA signature generation"
    depends on IDF_TARGET_ESP32H2
    default n
    help
        Enable this option to apply the countermeasure for ECDSA signature operation
        This countermeasure masks the real ECDSA sign operation
        under dummy sign operations to add randomness in the generated power signature.
        This countermeasure is only necessary for ESP32-H2 < v1.2.

config HAL_ECDSA_ALLOW_ESP32P4_PRE_ECO5
    bool "Allow ECDSA peripheral on ESP32-P4 revisions before v3.0 (insecure)"
    depends on IDF_TARGET_ESP32P4 && ESP32P4_SELECTS_REV_LESS_V3
    default n
    help
        By default the ESP32-P4 hardware ECDSA peripheral is disabled on chip revisions
        before v3.0 (eco5), because those revisions are vulnerable to a side-channel
        attack that can extract the private key.

        Enable this option to use the hardware ECDSA peripheral on these revisions anyway.
        Only do so if the application does not need ECDSA keys to resist physical or
        side-channel attacks.

        Note that the SECP384R1 curve is not supported by the ECDSA peripheral on these
        revisions. SECP384R1 signature verification falls back to software, and hardware
        signing with SECP384R1 keys is rejected.
```

## components/esp_hal_security/test_apps/tee/sdkconfig.defaults.esp32c5
```kconfig
# Enable LP core
CONFIG_ULP_COPROC_ENABLED=y
CONFIG_ULP_COPROC_RESERVE_MEM=8192
CONFIG_ESP_SYSTEM_ALLOW_RTC_FAST_MEM_AS_HEAP=n

# Enable SPIRAM
CONFIG_SPIRAM=y

# TODO: IDF-14145
CONFIG_COMPILER_ENABLE_RISCV_ZCMP=n
```

## components/esp_hal_security/test_apps/tee/sdkconfig.defaults.esp32c61
```kconfig
# Enable SPIRAM
CONFIG_SPIRAM=y

# TODO: IDF-14145
CONFIG_COMPILER_ENABLE_RISCV_ZCMP=n
```

## components/esp_hw_support/Kconfig
```kconfig
menu "Hardware Settings"

    config ESP_HW_SUPPORT_FUNC_IN_IRAM
        bool
        default n if SPI_FLASH_AUTO_SUSPEND
        default y
        select ESP_PERIPH_CTRL_FUNC_IN_IRAM
        select ESP_REGI2C_CTRL_FUNC_IN_IRAM
        select RTC_CLK_FUNC_IN_IRAM
        select RTC_TIME_FUNC_IN_IRAM

    menu "Chip revision"
        # Insert chip-specific HW config
        orsource "./port/$IDF_TARGET/Kconfig.hw_support"

        config ESP_REV_NEW_CHIP_TEST
            bool "Internal test mode"
            depends on IDF_CI_BUILD
            default n
            help
                For internal chip testing, a small number of new versions chips didn't
                update the version field in eFuse, you can enable this option to force the
                software recognize the chip version based on the rev selected in menuconfig.
    endmenu

    menu "MAC Config"
        config ESP_MAC_ADDR_UNIVERSE_WIFI_STA
            bool

        config ESP_MAC_ADDR_UNIVERSE_WIFI_AP
            bool

        config ESP_MAC_ADDR_UNIVERSE_BT
            bool

        config ESP_MAC_ADDR_UNIVERSE_ETH
            bool

        config ESP_MAC_ADDR_UNIVERSE_IEEE802154
            bool

        config ESP_MAC_UNIVERSAL_MAC_ADDRESSES_ONE
            bool

        config ESP_MAC_UNIVERSAL_MAC_ADDRESSES_TWO
            bool

        config ESP_MAC_UNIVERSAL_MAC_ADDRESSES_FOUR
            bool

        config ESP_MAC_UNIVERSAL_MAC_ADDRESSES
            int
            default 1 if ESP_MAC_UNIVERSAL_MAC_ADDRESSES_ONE
            default 2 if ESP_MAC_UNIVERSAL_MAC_ADDRESSES_TWO
            default 4 if ESP_MAC_UNIVERSAL_MAC_ADDRESSES_FOUR

            # Insert chip-specific MAC config
        orsource "./port/$IDF_TARGET/Kconfig.mac"

        config ESP_MAC_IGNORE_MAC_CRC_ERROR
            bool "Ignore MAC CRC error (not recommended)"
            depends on IDF_TARGET_ESP32
            default n
            help
                If you have an invalid MAC CRC (ESP_ERR_INVALID_CRC) problem
                and you still want to use this chip, you can enable this option to bypass such an error.
                This applies to both MAC_FACTORY and CUSTOM_MAC efuses.

        config ESP_MAC_USE_CUSTOM_MAC_AS_BASE_MAC
            bool "Enable using custom mac as base mac"
            default n
            help
                When this configuration is enabled, the user can invoke `esp_read_mac` to obtain the desired type of
                MAC using a custom MAC as the base MAC.
    endmenu

    menu "RTC Clock Config"
        orsource "./port/$IDF_TARGET/Kconfig.rtc"

        config RTC_CLK_FUNC_IN_IRAM
            bool "Place RTC clock module functions into IRAM"
            default y
            help
                Place RTC clock module (all rtc clock functions and const data) into IRAM.

        config RTC_TIME_FUNC_IN_IRAM
            bool "Place RTC time module functions into IRAM"
            default y
            help
                Place RTC time module (all rtc clock functions) into IRAM.
    endmenu

    menu "Peripheral Control"
        config ESP_PERIPH_CTRL_FUNC_IN_IRAM
            bool "Place peripheral control functions into IRAM"
            default y
            help
                Place peripheral control functions (e.g. periph_module_reset) into IRAM,
                so that these functions can be IRAM-safe and able to be called in the other IRAM interrupt context.

        config ESP_REGI2C_CTRL_FUNC_IN_IRAM
            bool "Place regi2c control functions into IRAM"
            default y
            help
                Place analog i2c master control functions (e.g. regi2c_ctrl_read_reg, regi2c_ctrl_write_reg) into IRAM,
                so that these functions can be IRAM-safe and able to be called in the other IRAM interrupt context.

        config ESP_MODEM_CLOCK_ENABLE_CHECKING
            bool "Enable modem clock configuration checking"
            depends on SOC_MODEM_CLOCK_SUPPORTED
            default n
            help
                If enabled, this option will perform additional checks on modem clock configuration
                to ensure proper operation and detect potential configuration issues.

        config ESP_BUS_ENABLE_AUTO_GATE
            bool "Enable bus clock auto-gate"
            depends on SOC_PM_SUPPORT_BUS_CLK_AUTO_GATE
            default y if IDF_CI_BUILD
            default n
            help
                Enable this option to use bus clock auto-gate for the system bus.

                When enabled, AHB/APB/AXI/MEM bus clock gating bypass is cleared, so the bus
                clocks are no longer forced on. Hardware then automatically gates these clocks
                when there is no bus access, reducing power consumption.

                This option has risk: auto-gating may cause unexpected bus access failures or
                system instability on some peripherals/scenarios. Enable with caution and
                verify thoroughly.
    endmenu

    rsource "./etm/Kconfig.etm"

    menu "Main XTAL Config"
        orsource "./port/$IDF_TARGET/Kconfig.xtal"
    endmenu

    orsource "./port/$IDF_TARGET/Kconfig.dcdc"

    orsource "./port/$IDF_TARGET/Kconfig.ldo"

    orsource "./power_supply/port/$IDF_TARGET/Kconfig.power"

    # Invisible bringup bypass options for esp_hw_support component
    config ESP_BRINGUP_BYPASS_CPU_CLK_SETTING
        bool
        default y if !SOC_CLK_TREE_SUPPORTED
        default n
        help
            This option is only used for new chip bringup, when
            clock support isn't done yet. So with this option,
            we use xtal on FPGA as the clock source.

    config ESP_BRINGUP_BYPASS_RANDOM_SETTING
        bool
        default y if !SOC_RNG_SUPPORTED
        default n
        help
            This option is only used for new chip bringup, when
            RNG isn't done yet. So with this option, we use 0x5A
            to fill the random buffers

    config ESP_SPI_BUS_LOCK_ISR_FUNCS_IN_IRAM
        bool
        default n

    config ESP_SPI_BUS_LOCK_FUNCS_IN_IRAM
        bool
        default n

    config ESP_CLK_RC32K_NOT_TO_USE
        bool
        default y if IDF_TARGET_ESP32C5 || IDF_TARGET_ESP32C61
        default n
        help
            Due to the poor low-temperature characteristics of
            RC32K (it cannot operate below -40 degrees Celsius),
            please avoid using it whenever possible

    config ESP_ENABLE_PVT
        bool "Auto adjust hp & lp voltage using pvt function (MUST ENABLE FOR MP)"
        depends on SOC_PMU_PVT_SUPPORTED
        default n if IDF_TARGET_ESP32C6
        default y
        help
            If enabled, hp & lp voltage can be auto adjust by PVT characteristic.
            Otherwise, internal voltage will be set to fix dbias.
            This is a must for stable mass production. Disable for debugging only.

    config ESP_INTR_IN_IRAM
        bool "Place esp_intr_alloc functions in IRAM" if SPI_FLASH_AUTO_SUSPEND
        default y
endmenu
```

## components/esp_hw_support/power_supply/port/esp32h21/Kconfig.power
```kconfig
menu "Power Supplier"

    menu "Brownout Detector"
        config ESP_BROWNOUT_DET
            bool "Hardware brownout detect & reset"
            depends on !IDF_ENV_FPGA
            default y
            help
                The ESP32-H21 has a built-in brownout detector which can detect if the voltage is lower than
                a specific value. If this happens, it will reset the chip in order to prevent unintended
                behaviour.

        choice ESP_BROWNOUT_DET_LVL_SEL
            prompt "Brownout voltage level"
            depends on ESP_BROWNOUT_DET
            default ESP_BROWNOUT_DET_LVL_SEL_7
            help
                Only level 7 is supported on ESP32-H21 (~2.96V). Other values would also
                affect PCM/LDO/VDD_DIG and are not offered.

            config ESP_BROWNOUT_DET_LVL_SEL_7
                bool "2.96V"
        endchoice

        config ESP_BROWNOUT_DET_LVL
            int
            default 7 if ESP_BROWNOUT_DET_LVL_SEL_7

        config ESP_BROWNOUT_USE_INTR
            bool
            default n
            help
                This config allows to trigger an interrupt when brownout detected. Software restart will be done
                at the end of the default callback.
                This is because for some special workflow, the chip needs do more things when brownout happens
                before restart instead of restarting directly. This part needs to be done in callback function
                of interrupt.

    endmenu

endmenu
```

## components/esp_hw_support/power_supply/port/esp32h4/Kconfig.power
```kconfig
menu "Power Supplier"

    choice ESP_HP_VOLTAGE_PROTECT
        prompt "Under-voltage protection"
        default ESP_BROWNOUT_DET if !IDF_ENV_FPGA
        help
            Brownout reset and VDDBAT under-voltage interrupt share the
            VDDBAT_VGOOD comparator, so only one can be selected.

        config ESP_BROWNOUT_DET
            bool "Brownout reset"
            depends on !IDF_ENV_FPGA
            help
                When the comparator detects VDDBAT below ~2.96V, the chip is reset to prevent
                unintended behaviour.

        config ESP_VDDBAT_UNDER_VOLT_PROTECT
            bool "VDDBAT under-voltage interrupt"
            depends on SOC_VDDBAT_PROTECT_SUPPORTED
            help
                When the comparator detects VDDBAT below ~2.96V, an interrupt is raised instead of
                a reset. The application installs the VDDBAT driver, registers a callback and
                enables detection, then decides how to handle the under-voltage.


    endchoice

    menu "Brownout Detector"
        depends on ESP_BROWNOUT_DET

        choice ESP_BROWNOUT_DET_LVL_SEL
            prompt "Brownout voltage level"
            default ESP_BROWNOUT_DET_LVL_SEL_7
            help
                Only level 7 is supported on ESP32-H4 (~2.96V). Other values would also
                affect PCM/LDO/VDD_DIG and are not offered.

            config ESP_BROWNOUT_DET_LVL_SEL_7
                bool "2.96V"
        endchoice

        config ESP_BROWNOUT_DET_LVL
            int
            default 7 if ESP_BROWNOUT_DET_LVL_SEL_7

        config ESP_BROWNOUT_USE_INTR
            bool
            default n
            help
                This config allows to trigger an interrupt when brownout detected. Software restart will be done
                at the end of the default callback.
                This is because for some special workflow, the chip needs do more things when brownout happens
                before restart instead of restarting directly. This part needs to be done in callback function
                of interrupt.

    endmenu

    menu "Battery Under-voltage Protection"
        depends on ESP_VDDBAT_UNDER_VOLT_PROTECT

        config ESP_VDDBAT_UNDER_VOLT_PROTECT_ISR_CACHE_SAFE
            bool "Under voltage ISR IRAM-Safe"
            depends on ESP_VDDBAT_UNDER_VOLT_PROTECT
            default y
            help
                Ensure the under voltage interrupt is IRAM-Safe by allowing the interrupt handler and
                esp_vddbat_protect_disable() to be executable when the cache is disabled.

    endmenu

endmenu
```
