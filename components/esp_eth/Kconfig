## components/esp_wifi/wifi_apps/roaming_app/src/Kconfig.roaming
```kconfig
# Visible if ESP_WIFI_ENABLE_ROAMING_APP enabled in components/esp_wifi/Kconfig
menu "Roaming triggers"
    config ESP_WIFI_ROAMING_LOW_RSSI_ROAMING
        bool "Use Low RSSI to trigger roaming."
        default y
        help
            Enable to use a RSSI threshold to trigger roaming.

    config ESP_WIFI_ROAMING_LOW_RSSI_THRESHOLD
        depends on ESP_WIFI_ROAMING_LOW_RSSI_ROAMING
        int "WiFi RSSI threshold to trigger roaming"
        range -99 -30
        default -60
        help
            WiFi RSSI threshold to trigger roaming value in dBm (-99 to -1). Values under -30 dbm
            might lead to a flood of low rssi events. This interferes with normal functioning and
            TX/Rx performance.

    config ESP_WIFI_ROAMING_LOW_RSSI_OFFSET
        depends on ESP_WIFI_ROAMING_LOW_RSSI_ROAMING
        int "Offset by which to reset the RSSI Threshold after attempt to roam."
        range 0 99
        default 5
        help
            Decide the offset by which to decrease the Low RSSI threshold set by ESP_WIFI_ROAMING_LOW_RSSI_THRESHOLD
            after each failed attempt to roam. This allows for the station to keep scanning for better AP's after
            the Low RSSI threshold is reached in a stepped manner, rather than only attempting to roam the first time
            the current AP's RSSI breaches the set RSSI threshold.
            Setting 0 here may cause station to be flooded with low rssi events,
            therefore that's not recommended to be kept.

    config ESP_WIFI_ROAMING_LOW_RSSI_ROAM_DIFF
        depends on ESP_WIFI_ROAMING_LOW_RSSI_ROAMING
        int "RSSI difference b/w current AP and candidate AP for low RSSI roam"
        range 1 99
        default 5
        help
            Minimum RSSI improvement (in dB) required of a candidate AP before roaming
            when triggered by the low RSSI event. A value of 1 keeps the previous behavior
            (any strictly better AP). Higher values add hysteresis and reduce ping-pong
            between nearby APs with similar RSSI. Prefer a small value here (e.g. 3-5);
            use ESP_WIFI_ROAMING_SCAN_ROAM_RSSI_DIFF for larger proactive improvements.

    config ESP_WIFI_ROAMING_PERIODIC_SCAN_MONITOR
        bool "Conduct periodic scans to check if a better AP is available"
        default y
        help
            Conduct periodic scans periodically to check if a better AP is available.

    config ESP_WIFI_ROAMING_PERIODIC_SCAN_THRESHOLD
        int "Threshold at which to begin periodic scanning for a better AP."
        depends on ESP_WIFI_ROAMING_PERIODIC_SCAN_MONITOR
        range -99 -1
        default -50
        help
            Threshold at which the station will begin scanning to find an AP with better RSSI.

    config ESP_WIFI_ROAMING_SCAN_MONITOR_INTERVAL
        int "Time intervals (in seconds) at which station will initiate a scan"
        depends on ESP_WIFI_ROAMING_PERIODIC_SCAN_MONITOR
        range 1 1500
        default 30
        help
            Intervals at which station will periodically scan to check if better AP is available

    config ESP_WIFI_ROAMING_SCAN_ROAM_RSSI_DIFF
        int "RSSI difference b/w current AP and candidate AP to initiate connection"
        depends on ESP_WIFI_ROAMING_PERIODIC_SCAN_MONITOR
        default 15
        range 0 99
        help
            Minimum RSSI difference b/w current AP and a potential roaming candidate AP
            to trigger a roaming attempt.
endmenu #"Roaming triggers"

menu "Fast connect"
    config ESP_WIFI_ROAMING_FAST_CONNECT
        bool "Remember the AP and connect to it directly next time"
        default n
        help
            Remember the BSSID and channel of the AP each connection ends on, as a connect hint in the
            station configuration (bssid_set, bssid and channel, with WIFI_FAST_SCAN and
            WIFI_CONNECT_AP_BY_SIGNAL). The next connection, after a reboot or a lost link, then tries that
            AP alone instead of scanning every channel first. If that connection fails, for any reason but
            the station's own disconnect or a roam, the hint is cleared on the Wi-Fi task before the
            disconnection event is posted, so the next connection attempt, whoever starts it, scans every
            channel and connects to the strongest AP, and the AP that connection ends on is remembered
            instead. Nothing is written when the AP connected to is the one already remembered.

            With this option the roaming app owns scan_method, sort_method, bssid_set, bssid and channel of
            the station configuration, and the supplicant leaves the hint in place when BTM or MBO is
            enabled. The hint is saved with the rest of the station configuration (in NVS, unless the
            application chose WIFI_STORAGE_RAM): an application that sets a new station configuration at
            every boot replaces it, and so scans every channel at every boot, as without this option.

            Turning fast connect off at run time (roam_config.fast_connect) clears the hint. Turning this
            option off in a later firmware leaves the last hint in the saved station configuration, with
            nothing to clear it after a failure: such a firmware should clear bssid_set once.

    config ESP_WIFI_ROAMING_JOIN_CHECK
        bool "Scan once after each connection for a much stronger AP"
        default y if ESP_WIFI_ROAMING_FAST_CONNECT
        default n
        help
            Once a connection has its IP address, scan once and roam to a candidate AP at least
            ESP_WIFI_ROAMING_JOIN_CHECK_RSSI_DIFF dB stronger than the AP connected to. A connection
            that joins a remembered AP, or the first AP heard, can then still end on the strongest.
            The scan waits for the roaming backoff time after the connection and for the application,
            which can ask it to wait while it has replies outstanding (esp_wifi_roaming_set_app_hold()).
            No check follows a connection the roaming app made itself to roam.

    config ESP_WIFI_ROAMING_JOIN_CHECK_RSSI_DIFF
        int "RSSI difference b/w current AP and candidate AP for the check after a connection"
        depends on ESP_WIFI_ROAMING_JOIN_CHECK
        range 1 99
        default 15
        help
            Minimum RSSI improvement (in dB) required of a candidate AP before the check after a
            connection roams to it. The current AP's RSSI is the stronger of the connection's and the
            scan's, as for the other triggers.

    config ESP_WIFI_ROAMING_JOIN_CHECK_SETTLE_MAX_TIME
        int "Longest wait (in seconds) for the application before the check scan"
        depends on ESP_WIFI_ROAMING_JOIN_CHECK
        range 0 600
        default 60
        help
            The check scan waits while the application reports a reply outstanding or that it is still
            settling after the connection, and then for 500 ms in which it reports neither. It waits at
            most this long after the connection's IP address, and then scans anyway: a scan keeps the
            connection, it only delays traffic while the radio is off channel.

    config ESP_WIFI_ROAMING_JOIN_CHECK_ROAM_WAIT_MAX_TIME
        int "Longest wait (in seconds) for the application before a roam the check chose"
        depends on ESP_WIFI_ROAMING_JOIN_CHECK
        range 1 120
        default 15
        help
            A roam the check chose is never made while the application reports a reply outstanding, or,
            within ESP_WIFI_ROAMING_JOIN_CHECK_SETTLE_MAX_TIME of the IP address, that it is still
            settling. If the application does not report 500 ms of quiet within this time, the roam is
            given up until the next connection: a roam drops the connection briefly, and whatever the
            application waits on would be lost.
endmenu #"Fast connect"

menu "Roaming Methods"
    config ESP_WIFI_ROAMING_LEGACY_ROAMING
        bool "Support Legacy roaming approach"
        default y
        help
            Roaming between APs that do not support 802.11v.
            This will allow station to roam even when connection is not BTM supported,
            by forcefully disconnecting from current AP and connecting to better AP.

    config ESP_WIFI_ROAMING_NETWORK_ASSISTED_ROAM
        bool "Support Network Assisted roaming using 802.11v"
        depends on ESP_WIFI_WNM_SUPPORT
        default y
        help
            Roaming between APs using network assisted Roaming.
            This involves  BSS Transition Management mechanisms outlined in 802.11v.
            Note that this moves the responsibility to the AP's network, and hence isn't
            guaranteed to cause the station to attempt to roam each time.

    config ESP_WIFI_NETWORK_ASSISTED_ROAMING_RETRY_COUNT
        int "Retry count after which to switch to legacy roaming"
        depends on ESP_WIFI_ROAMING_NETWORK_ASSISTED_ROAM
        depends on ESP_WIFI_ROAMING_LEGACY_ROAMING
        range 1 5
        default 2
        help
            Retry threshold after which the station should stop using Network Assisted
            roaming methods and start using legacy roaming instead.

    config ESP_WIFI_ROAMING_IP_RENEW_SKIP
        bool "Skip IP renew after roaming"
        default n
        help
            Skip the default IP renew path when the Wi-Fi stack reports a roaming event.
            Enable this only if your network preserves IP state across a roam, for example
            during 802.11r or BTM-based roaming.

endmenu #"Roaming Methods"

menu "Scan Configuration"

    config ESP_WIFI_ROAMING_SCAN_MIN_SCAN_TIME
        int "Minimum duration (in milliseconds) of station's per channel active scan"
        default 30
        range 0 120
        help
            Minimum duration of active scanning per channel in milliseconds.

    config ESP_WIFI_ROAMING_SCAN_MAX_SCAN_TIME
        int "Maximum duration (in milliseconds) of station's per channel active scan time"
        default 70
        range 30 120
        help
            Maximum duration of active scanning per channel in milliseconds.

    config ESP_WIFI_ROAMING_HOME_CHANNEL_DWELL_TIME
        int "Home channel dwell time scanning between consecutive channels"
        default 30
        range 30 150
        help
            If connected, duration for which the station will return to it's home channel for Tx/Rx of
            frames stored in buffers between scanning on consecutive channels.

    config ESP_WIFI_ROAMING_SCAN_CHAN_LIST
        string "Preferred channel list for scanning"
        default "None"
        help
            Channels your wireless network operates on to allow for faster scanning.
            Specify channels in a comma-separated manner. The list is used as a
            channel filter, not as an ordered scan sequence. When 5 GHz support
            is enabled, valid 5 GHz channels are also accepted.

    config ESP_WIFI_ROAMING_SCAN_EXPIRY_WINDOW
        int "Scan results expiry window (in seconds)"
        default 10
        range 5 20
        help
            Duration for which the results from the most recent scans can be used
            by the roaming app for determining the roaming candidates.



endmenu #"Scan Configuration"

config ESP_WIFI_ROAMING_BACKOFF_TIME
    int "Default time to wait between subsequent roaming attempts."
    default 15
    range 0 120
    help
        Time to wait (in seconds) by station before registering for the RSSI event again
        or start continuous montoring to find better AP.

config ESP_WIFI_ROAMING_PERIODIC_RRM_MONITORING
    bool "Send periodic neighbor report request to AP for internal list updation"
    depends on ESP_WIFI_RRM_SUPPORT
    default n
    help
        This option will enable station to keep sending RRM neighbor list request to AP and
        update its internal list.

config ESP_WIFI_ROAMING_RRM_MONITOR_TIME
    int "Time interval (in seconds) between neighbor report requests to an AP"
    depends on ESP_WIFI_ROAMING_PERIODIC_RRM_MONITORING
    default 60
    range 0 1500
    help
        Enable this to send periodic neighbor report requests to the AP.
        These neighbor report requests provide information about other APs in the same managed
        network. This information is used for more intelligent roaming.

config ESP_WIFI_ROAMING_RRM_MONITOR_THRESHOLD
    int "Threshold for sending periodic neighbor report requests"
    depends on ESP_WIFI_ROAMING_PERIODIC_RRM_MONITORING
    default -20
    range -99 0
    help
        The RSSI threshold beyond which we start sending periodic neighbor report requests.

menu "Blacklist Configuration"
    config ESP_WIFI_ROAMING_BSSID_BLACKLIST
        bool "Enable BSSID blacklisting"
        default n
        help
            Enable this to blacklist BSSIDs.

    config ESP_WIFI_ROAMING_AUTO_BLACKLISTING
        bool "Enable automatic BSSID blacklisting"
        depends on ESP_WIFI_ROAMING_BSSID_BLACKLIST
        help
            Enable this to automatically blacklist BSSIDs after multiple failed connection attempts.

    config ESP_WIFI_ROAMING_MAX_CONN_FAILURES
        int "Maximum connection failures"
        depends on ESP_WIFI_ROAMING_AUTO_BLACKLISTING
        range 1 10
        default 3
        help
            Maximum number of connection failures before a BSSID is blacklisted.

    config ESP_WIFI_ROAMING_BLACKLIST_TIMEOUT
        int "Blacklist timeout (in seconds)"
        depends on ESP_WIFI_ROAMING_BSSID_BLACKLIST
        range 10 3600
        default 300
        help
            Time in seconds for which a BSSID remains in the blacklist.
            This applies to both automatically and manually blacklisted BSSIDs.

    config ESP_WIFI_ROAMING_MAX_CANDIDATES
        int "Maximum number of roaming candidates"
        range 1 10
        default 5
        help
            Maximum number of roaming candidates to consider. This also defines the size of the blacklist.

endmenu # "Blacklist Configuration"
```

## components/riscv/Kconfig
```kconfig
config RISCV_USER_MODE_TRAPS
    bool
    help
        Builds the trap entry and return paths for code that runs in RISC-V user mode (U-mode), and
        the call context they use. Selected by the component that runs U-mode code.
```
