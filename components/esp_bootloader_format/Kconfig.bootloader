## components/esp_driver_dac/Kconfig
```kconfig
menu "ESP-Driver:DAC Configurations"
    depends on SOC_DAC_SUPPORTED
    config DAC_CTRL_FUNC_IN_IRAM
        bool "Place DAC control functions into IRAM"
        default n
        help
            Place DAC control functions (e.g. 'dac_oneshot_output_voltage') into IRAM,
            so that this function can be IRAM-safe and able to be called in the other IRAM interrupt context.
            Enabling this option can improve driver performance as well.

    config DAC_ISR_IRAM_SAFE
        bool "DAC ISR IRAM-Safe"
        default n
        help
            Ensure the DAC interrupt is IRAM-Safe by allowing the interrupt handler to be
            executable when the cache is disabled (e.g. SPI Flash write).

    config DAC_ENABLE_DEBUG_LOG
        bool "Enable debug log"
        default n
        help
            whether to enable the debug log message for DAC driver.
            Note that, this option only controls the DAC driver log, won't affect other drivers.

    config DAC_DMA_AUTO_16BIT_ALIGN
        bool "Align the continuous data to 16 bit automatically"
        depends on SOC_DAC_DMA_16BIT_ALIGN
        default y
        help
            Whether to left shift the continuous data to align every bytes to 16 bits in the driver.
            On ESP32, although the DAC resolution is only 8 bits,
            the hardware requires 16 bits data in continuous mode.
            By enabling this option, the driver will left shift 8 bits for the input data automatically.
            Only disable this option when you decide to do this step by yourself.
            Note that the driver will allocate a new piece of memory to save the converted data.

endmenu # DAC Configuration
```

## components/esp_driver_dac/test_apps/dac/sdkconfig.defaults
```kconfig
CONFIG_FREERTOS_HZ=1000
CONFIG_ESP_TASK_WDT_EN=n
# Disable this config, otherwise DAC will be disabled when ADC initialized
CONFIG_ADC_DISABLE_DAC_OUTPUT=n
```

## components/esp_driver_dma/Kconfig
```kconfig
menu "GDMA Configurations"
    depends on SOC_GDMA_SUPPORTED
    config GDMA_CTRL_FUNC_IN_IRAM
        bool "Place GDMA control functions in IRAM"
        default n
        select GDMA_OBJ_DRAM_SAFE
        help
            Place GDMA control functions (like start/stop/append/reset) into IRAM,
            so that these functions can be IRAM-safe and able to be called in the other IRAM interrupt context.

    config GDMA_ISR_HANDLER_IN_IRAM
        bool "Place GDMA ISR handler in IRAM to reduce latency"
        default y
        select GDMA_OBJ_DRAM_SAFE
        help
            Place GDMA ISR handler functions in IRAM to reduce latency caused by cache miss.

    config GDMA_OBJ_DRAM_SAFE
        bool
        default n
        help
            This will ensure the GDMA object is DRAM-Safe, allow to avoid external memory
            cache misses, and also be accessible whilst the cache is disabled.

    config GDMA_ENABLE_DEBUG_LOG
        bool "Force enable debug log"
        default n
        help
            If enabled, GDMA driver component will:
            1. ignore the global logging settings
            2. compile all log messages into the binary
            3. set the runtime log level to VERBOSE
            Please enable this option by caution, as it will increase the binary size.

    config GDMA_ENABLE_WEIGHTED_ARBITRATION
        depends on SOC_GDMA_SUPPORT_WEIGHTED_ARBITRATION && IDF_EXPERIMENTAL_FEATURES
        bool "GDMA enable weighted arbitration (Experimental)"
        default n
        help
            Whether to enable the weighted arbitration for GDMA driver.
            The default weight of each channel is 1. You need to set weight for each channel before transmissions.
            If this option is enabled, the buffer should be aligned to the burst size.
endmenu # GDMA Configurations

menu "DW_GDMA Configurations"
    depends on SOC_DW_GDMA_SUPPORTED

    config DW_GDMA_CTRL_FUNC_IN_IRAM
        bool
        default n
        select DW_GDMA_OBJ_DRAM_SAFE
        help
            Place DW_GDMA control functions (e.g. dw_gdma_channel_continue) into IRAM,
            so that these functions can be IRAM-safe and able to be called in the other IRAM interrupt context.

    config DW_GDMA_SETTER_FUNC_IN_IRAM
        bool
        default n
        select DW_GDMA_OBJ_DRAM_SAFE
        help
            Place DW_GDMA setter functions (e.g. dw_gdma_channel_set_block_markers) into IRAM,
            so that these functions can be IRAM-safe and able to be called in the other IRAM interrupt context.

    config DW_GDMA_GETTER_FUNC_IN_IRAM
        bool
        default n
        select DW_GDMA_OBJ_DRAM_SAFE
        help
            Place DW_GDMA getter functions (e.g. dw_gdma_link_list_get_item) into IRAM,
            so that these functions can be IRAM-safe and able to be called in the other IRAM interrupt context.

    config DW_GDMA_ISR_IRAM_SAFE
        bool
        default n
        select DW_GDMA_OBJ_DRAM_SAFE
        help
            This will ensure the DW_GDMA interrupt handler is IRAM-Safe, allow to avoid flash
            cache misses, and also be able to run whilst the cache is disabled.
            (e.g. SPI Flash write).

    config DW_GDMA_OBJ_DRAM_SAFE
        bool
        default n
        help
            This will ensure the DW_GDMA object is DRAM-Safe, allow to avoid external memory
            cache misses, and also be accessible whilst the cache is disabled.

    config DW_GDMA_ENABLE_DEBUG_LOG
        bool "Enable debug log"
        default n
        help
            Whether to enable the debug log message for DW_GDMA driver.
            Note that, this option only controls the DW_GDMA driver log, won't affect other drivers.
endmenu # DW_GDMA Configurations

menu "2D-DMA Configurations"
    depends on SOC_DMA2D_SUPPORTED

    config DMA2D_OPERATION_FUNC_IN_IRAM
        bool "Place 2D-DMA operation functions into IRAM"
        default n
        help
            Place 2D-DMA all operation functions, including control functions (e.g. start/stop/append/reset) and setter
            functions (e.g. connect/strategy/callback registration) into IRAM, so that these functions can be IRAM-safe
            and able to be called in the other IRAM interrupt context. It also helps optimizing the performance.

    config DMA2D_ISR_IRAM_SAFE
        bool "2D-DMA ISR IRAM-Safe"
        default n
        help
            This will ensure the 2D-DMA interrupt handler is IRAM-Safe, allow to avoid flash
            cache misses, and also be able to run whilst the cache is disabled.
            (e.g. SPI Flash write).
endmenu # 2D-DMA Configurations
```

## components/esp_driver_dma/test_apps/dma/sdkconfig.defaults
```kconfig
CONFIG_FREERTOS_HZ=1000
CONFIG_ESP_TASK_WDT_EN=n
CONFIG_IDF_EXPERIMENTAL_FEATURES=y
# CONFIG_VFS_SUPPORT_IO resolves to its default (y) in this test's Kconfig closure; the resulting console I/O reduces the internal DMA heap and fails the 200 KB allocation in the "GDMA M2M Weighted Arbitration Test SRAM->SRAM" case. Disable it to free that heap.
CONFIG_VFS_SUPPORT_IO=n
```

## components/esp_driver_gpio/Kconfig
```kconfig
menu "ESP-Driver:GPIO Configurations"
    config GPIO_CTRL_FUNC_IN_IRAM
        bool "Place GPIO control functions into IRAM"
        default n
        help
            Place GPIO control functions (like intr_disable/set_level) into IRAM,
            so that these functions can be IRAM-safe and able to be called in the other IRAM interrupt context.
endmenu
```

## components/esp_driver_gpio/test_apps/gpio/sdkconfig.defaults.esp32p4
```kconfig
CONFIG_SPIRAM=y
CONFIG_SPIRAM_MODE_HEX=y
CONFIG_SPIRAM_MALLOC_ALWAYSINTERNAL=0
# Disable PSRAM halfsleep feature, otherwise P4 spm section overflows with COMPILER_OPTIMIZATION_NONE=y
CONFIG_PM_SLP_SPIRAM_HALFSLEEP_ENABLED=n
```

## components/esp_driver_gptimer/Kconfig
```kconfig
menu "ESP-Driver:GPTimer Configurations"
    depends on SOC_GPTIMER_SUPPORTED

    config GPTIMER_ISR_HANDLER_IN_IRAM
        bool "Place GPTimer ISR handler in IRAM to reduce latency"
        default y
        select GPTIMER_OBJ_CACHE_SAFE
        help
            Place GPTimer ISR handler in IRAM to reduce latency caused by cache miss.

    config GPTIMER_CTRL_FUNC_IN_IRAM
        bool "Place GPTimer control functions in IRAM"
        default n
        select GPTIMER_OBJ_CACHE_SAFE
        help
            Place GPTimer control functions (like start/stop) in IRAM, to reduce latency caused by cache miss.
            If enabled, these functions can also be called when cache is disabled.

    config GPTIMER_ISR_CACHE_SAFE
        bool "Allow GPTimer ISR to execute when cache is disabled" if !SPI_FLASH_AUTO_SUSPEND
        select GPTIMER_ISR_HANDLER_IN_IRAM
        default n
        help
            Enable this option to allow the GPTimer Interrupt Service Routine (ISR)
            to execute even when the cache is disabled. This can be useful in scenarios where the cache
            might be turned off, but the GPTimer functionality is still required to operate correctly.

    config GPTIMER_OBJ_CACHE_SAFE
        bool
        default n
        help
            This will ensure the GPTimer object will not be allocated from a memory region
            where its cache can be disabled.

    config GPTIMER_ENABLE_DEBUG_LOG
        bool "Force enable debug log"
        default n
        help
            If enabled, GPTimer component will:
            1. ignore the global logging settings
            2. compile all log messages into the binary
            3. set the runtime log level to VERBOSE
            Please enable this option by caution, as it will increase the binary size.

endmenu
```

## components/esp_driver_i2c/Kconfig
```kconfig
menu "ESP-Driver:I2C Configurations"
    depends on SOC_I2C_SUPPORTED
    config I2C_ISR_IRAM_SAFE
        bool "I2C ISR IRAM-Safe"
        default n
        help
            Ensure the I2C interrupt is IRAM-Safe by allowing the interrupt handler to be
            executable when the cache is disabled (e.g. SPI Flash write).
            note: This cannot be used in the I2C legacy driver.

    config I2C_ENABLE_DEBUG_LOG
        bool "Enable I2C debug log"
        default n
        help
            whether to enable the debug log message for I2C driver.
            Note that this option only controls the I2C driver log, will not affect other drivers.

            note: This cannot be used in the I2C legacy driver.

endmenu # I2C Configurations
```
