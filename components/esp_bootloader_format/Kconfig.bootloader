## components/esp_common/Kconfig.spiram.common
```kconfig
# Common (non-chip-specific) SPIRAM options
#
# sourced into the "SPIRAM config" submenu for ESP32 or ESP32S2

# invisible option selected by ESP32_SPIRAM_SUPPORT || ESP32S2_SPIRAM_SUPPORT
config SPIRAM
    bool

config SPIRAM_BOOT_INIT
    bool "Initialize SPI RAM during startup"
    default "y"
    help
        If this is enabled, the SPI RAM will be enabled during initial boot. Unless you
        have specific requirements, you'll want to leave this enabled so memory allocated
        during boot-up can also be placed in SPI RAM.

config SPIRAM_IGNORE_NOTFOUND
    bool "Ignore PSRAM when not found"
    default "n"
    depends on SPIRAM_BOOT_INIT && !SPIRAM_ALLOW_BSS_SEG_EXTERNAL_MEMORY
    help
        Normally, if psram initialization is enabled during compile time but not found at runtime, it
        is seen as an error making the CPU panic. If this is enabled, booting will complete
        but no PSRAM will be available.

choice SPIRAM_USE
    prompt "SPI RAM access method"
    default SPIRAM_USE_MALLOC
    help
        The SPI RAM can be accessed in multiple methods: by just having it available as an unmanaged
        memory region in the CPU's memory map, by integrating it in the heap as 'special' memory
        needing heap_caps_malloc to allocate, or by fully integrating it making malloc() also able to
        return SPI RAM pointers.

    config SPIRAM_USE_MEMMAP
        bool "Integrate RAM into memory map"
    config SPIRAM_USE_CAPS_ALLOC
        bool "Make RAM allocatable using heap_caps_malloc(..., MALLOC_CAP_SPIRAM)"
    config SPIRAM_USE_MALLOC
        bool "Make RAM allocatable using malloc() as well"
        select FREERTOS_SUPPORT_STATIC_ALLOCATION
endchoice

config SPIRAM_MEMTEST
    bool "Run memory test on SPI RAM initialization"
    default "y"
    depends on SPIRAM_BOOT_INIT
    help
        Runs a rudimentary memory test on initialization. Aborts when memory test fails. Disable this for
        slightly faster startup.

config SPIRAM_MALLOC_ALWAYSINTERNAL
    int "Maximum malloc() size, in bytes, to always put in internal memory"
    depends on SPIRAM_USE_MALLOC
    default 16384
    range 0 131072
    help
        If malloc() is capable of also allocating SPI-connected ram, its allocation strategy will prefer to
        allocate chunks less than this size in internal memory, while allocations larger than this will be
        done from external RAM. If allocation from the preferred region fails, an attempt is made to allocate
        from the non-preferred region instead, so malloc() will not suddenly fail when either internal or
        external memory is full.

config SPIRAM_TRY_ALLOCATE_WIFI_LWIP
    bool "Try to allocate memories of WiFi and LWIP in SPIRAM firstly. If failed, allocate internal memory"
    depends on SPIRAM_USE_CAPS_ALLOC || SPIRAM_USE_MALLOC
    default "n"
    help
        Try to allocate memories of WiFi and LWIP in SPIRAM firstly. If failed, try to allocate internal
        memory then.

config SPIRAM_MALLOC_RESERVE_INTERNAL
    int "Reserve this amount of bytes for data that specifically needs to be in DMA or internal memory"
    depends on SPIRAM_USE_MALLOC
    default 32768
    range 0 262144
    help
        Because the external/internal RAM allocation strategy is not always perfect, it sometimes may happen
        that the internal memory is entirely filled up. This causes allocations that are specifically done in
        internal memory, for example the stack for new tasks or memory to service DMA or have memory that's
        also available when SPI cache is down, to fail. This option reserves a pool specifically for requests
        like that; the memory in this pool is not given out when a normal malloc() is called.

        Set this to 0 to disable this feature.

        Note that because FreeRTOS stacks are forced to internal memory, they will also use this memory pool;
        be sure to keep this in mind when adjusting this value.

        Note also that the DMA reserved pool may not be one single contiguous memory region, depending on the
        configured size and the static memory usage of the app.

config SPIRAM_ALLOW_BSS_SEG_EXTERNAL_MEMORY
    bool "Allow .bss segment placed in external memory"
    default n
    depends on SPIRAM && IDF_TARGET_ESP32 # TODO ESP32-S2 IDFGH-4320
    help
        If enabled the option,and add EXT_RAM_ATTR defined your variable,then your variable will be placed in
        PSRAM instead of internal memory, and placed most of variables of lwip,net802.11,pp,bluedroid library
        to external memory defaultly.
```

## components/esp_debug/Kconfig
```kconfig
menu "ESP DEBUG"

config ESP32_WIFI_DEBUG_COUNTER
    bool "Enable WiFi Debug Counter"
    default n
    help
        Select this option to enable more debug counters

config ESP32_WIFI_DEBUG_PKT_FILTER_ENABLE
    bool "Enable WiFi Packet Filter "
    default n
    help
        Select this option to enable WiFi packet filter

menu "WiFi Packet Filter Type"
    depends on ESP32_WIFI_DEBUG_PKT_FILTER_ENABLE

config ESP32_WIFI_DEBUG_PKT_FILTER_TCP
    bool "Filter TCP Packets"
    default n
    help
        Select this option to filter TCP packets.

config ESP32_WIFI_DEBUG_PKT_FILTER_UDP
    bool "Filter UDP Packets"
    default n
    help
        Select this option to filter UDP packets.

config ESP32_WIFI_DEBUG_PKT_FILTER_ARP
    bool "Filter ARP Packets"
    default n
    help
        Select this option to filter ARP packets.

config ESP32_WIFI_DEBUG_PKT_FILTER_DHCP
    bool "Filter DHCP Packets"
    default n
    help
        Select this option to filter DHCP packets.

config ESP32_WIFI_DEBUG_PKT_FILTER_DNS
    bool "Filter DNS Packets"
    default n
    help
        Select this option to filter DNS packets.

config ESP32_WIFI_DEBUG_PKT_FILTER_MDNS
    bool "Filter MDNS Packets"
    default n
    help
        Select this option to filter DNS packets.

endmenu


config ESP32_DEBUG_TASK_ENABLE
    bool "Enable Debug Polling Task"
    default n
    help
        Select this option to create debug task.
config ESP32_DEBUG_TASK_PRIORITY
    int "Debug Task priority"
    depends on ESP32_DEBUG_TASK_ENABLE
    range 1 23
    default 10
    help
        Set WiFi debug task priority

config ESP32_DEBUG_TASK_STACK_SIZE
    int "Debug Task Stack Size"
    depends on ESP32_DEBUG_TASK_ENABLE
    default 3072 
    range 1024 65536
    help
        Configure WiFi debug task stack size.

config ESP32_DEBUG_TASK_POLLING_ENABLE
    bool "Enable Debug Task Polling"
    depends on ESP32_DEBUG_TASK_ENABLE
    default n
    help
        Select this option to enable Debug Task Polling.

        When the polling is enabled, the Debug Task query and dump the specified counters periodically.

config ESP32_DEBUG_TASK_POLLING_PERIOD
    int "Debug Task Polling Period (seconds)"
    depends on ESP32_DEBUG_TASK_POLLING_ENABLE
    range 1 65535
    default 30
    help
        Select this option to enable Debug Task Polling

menu "WiFi Polling Modules"
depends on ESP32_DEBUG_TASK_POLLING_ENABLE

config ESP32_DEBUG_TASK_POLLING_WIFI_HARDWARE_DIAG
    bool "Polling WiFi hardware diag registers"
    default n
    help
        Select this option to polling WiFi hardware diag registers

config ESP32_DEBUG_TASK_POLLING_WIFI_HARDWARE_COUNTERS
    bool "Polling WiFi hardware counters"
    default n
    help
        Select this option to polling WiFi hardware counters

config ESP32_DEBUG_TASK_POLLING_WIFI_HARDWARE_MISC
    bool "Polling WiFi hardware misc registers"
    default n
    help
        Select this option to polling WiFi hardware misc registers

config ESP32_DEBUG_TASK_POLLING_WIFI_BUFFER_COUNTERS
    bool "Polling WiFi buffer counters"
    default y
    help
        Select this option to polling WiFi buffer counters

config ESP32_DEBUG_TASK_POLLING_WIFI_INT_COUNTERS
    bool "Polling WiFi interrupt counters"
    default y
    help
        Select this option to polling WiFi interrupt counters


config ESP32_DEBUG_TASK_POLLING_WIFI_RX_COUNTERS
    bool "Polling WiFi receiving packet counters"
    default y
    help
        Select this option to polling WiFi receiving packet counters

config ESP32_DEBUG_TASK_POLLING_WIFI_TX_COUNTERS
    bool "Polling WiFi transmitting packet counters"
    default y
    help
        Select this option to polling WiFi transmitting packet counters

config ESP32_DEBUG_TASK_POLLING_WIFI_BUFFER_COUNTERS
    bool "Polling WiFi buffer counters"
    default y
    help
        Select this option to polling WiFi buffer counters

config ESP32_DEBUG_TASK_POLLING_WIFI_SLEEP_COUNTERS
    bool "Polling WiFi sleep counters"
    default y
    help
        Select this option to polling WiFi sleep counters

config ESP32_DEBUG_TASK_POLLING_WIFI_EVENT_COUNTERS
    bool "Polling WiFi event counters"
    default n
    help
        Select this option to polling WiFi key event counters

config ESP32_DEBUG_TASK_POLLING_WIFI_NVS_INFO
    bool "Polling WiFi NVS info"
    default n
    help
        Select this option to polling WiFi NVS info

config ESP32_DEBUG_TASK_POLLING_WIFI_STA_INFO
    bool "Polling WiFi station internal info"
    default n
    help
        Select this option to polling WiFi station internal info

config ESP32_DEBUG_TASK_POLLING_WIFI_AP_INFO
    bool "Polling WiFi soft-AP internal info"
    default n
    help
        Select this option to polling WiFi soft-AP internal info

config ESP32_DEBUG_TASK_POLLING_WIFI_TRC_INFO
    bool "Polling WiFi rate control info"
    default n
    help
        Select this option to polling WiFi rate control info


config ESP32_DEBUG_TASK_POLLING_WIFI_MEMORY_INFO
    bool "Polling WiFi memory info"
    default n
    help
        Select this option to polling WiFi memory info


endmenu
menu "LWIP Polling Modules"
depends on ESP32_DEBUG_TASK_POLLING_ENABLE

config ESP32_DEBUG_TASK_POLLING_LWIP_SOCKETS
    bool "Polling LWIP sockets info"
    default n
    help
        Select this option to polling WiFi memory info

config ESP32_DEBUG_TASK_POLLING_LWIP_PKT_COUNTER
    bool "Polling LWIP packet counters"
    default n
    help
        Select this option to polling LWIP packet counters
endmenu
menu "System Polling Modules"
depends on ESP32_DEBUG_TASK_POLLING_ENABLE

config ESP32_DEBUG_TASK_POLLING_TASK_INFO
    bool "Polling task info"
    default n
    help
        Select this option to polling LWIP packet counters

config ESP32_DEBUG_TASK_POLLING_MEMORY_INFO
    bool "Polling memory info"
    default n
    help
        Select this option to polling memory info

endmenu


endmenu
```

## components/esp_driver_ana_cmpr/Kconfig
```kconfig
menu "ESP-Driver:Analog Comparator Configurations"
    depends on SOC_ANA_CMPR_SUPPORTED

    config ANA_CMPR_ISR_HANDLER_IN_IRAM
        bool "Place Analog Comparator ISR handler in IRAM to reduce latency"
        default y
        select ANA_CMPR_OBJ_CACHE_SAFE
        help
            Place Analog Comparator ISR handler in IRAM to reduce latency caused by cache miss.

    config ANA_CMPR_CTRL_FUNC_IN_IRAM
        bool "Place Analog Comparator control functions into IRAM"
        default n
        select ANA_CMPR_OBJ_CACHE_SAFE
        help
            Place Analog Comparator control functions (like ana_cmpr_set_internal_reference) into IRAM,
            so that these functions can be IRAM-safe and able to be called in an IRAM interrupt context.
            Enabling this option can improve driver performance as well.

    config ANA_CMPR_ISR_CACHE_SAFE
        bool "Allow Analog Comparator ISR to execute when cache is disabled"
        select ANA_CMPR_ISR_HANDLER_IN_IRAM
        default n
        help
            Enable this option to allow the Analog Comparator Interrupt Service Routine (ISR)
            to execute even when the cache is disabled. This can be useful in scenarios where the cache
            might be turned off, but the comparator functionality is still required to operate correctly.

    config ANA_CMPR_OBJ_CACHE_SAFE
        bool
        default n
        help
            This will ensure the driver object will not be allocated from a memory region
            where its cache can be disabled.

    config ANA_CMPR_ENABLE_DEBUG_LOG
        bool "Force enable debug log"
        default n
        help
            If enabled, the driver component will:
            1. ignore the global logging settings
            2. compile all log messages into the binary
            3. set the runtime log level to VERBOSE
            Please enable this option by caution, as it will increase the binary size.
endmenu # Analog Comparator Configuration
```

## components/esp_driver_bitscrambler/Kconfig
```kconfig
menu "BitScrambler Configurations"
    depends on SOC_BITSCRAMBLER_SUPPORTED
    config BITSCRAMBLER_CTRL_FUNC_IN_IRAM
        bool "Place BitScrambler control functions in IRAM"
        default n
        select BITSCRAMBLER_OBJ_CACHE_SAFE
        help
            Place BitScrambler control functions into IRAM for better performance and fewer cache misses.

    config BITSCRAMBLER_OBJ_CACHE_SAFE
        bool
        default n
        help
            This will ensure the BitScrambler object will not be allocated from a memory region
            where its cache can be disabled.
endmenu # BitScrambler Configurations
```

## components/esp_driver_cam/Kconfig
```kconfig
menu "ESP-Driver:Camera Controller Configurations"

    depends on SOC_MIPI_CSI_SUPPORTED || SOC_LCDCAM_CAM_SUPPORTED

    config CAM_CTLR_MIPI_CSI_ISR_CACHE_SAFE
        bool "CSI ISR Cache-Safe"
        depends on SOC_MIPI_CSI_SUPPORTED
        default n
        select DW_GDMA_ISR_IRAM_SAFE
        select DW_GDMA_CTRL_FUNC_IN_IRAM
        select DW_GDMA_SETTER_FUNC_IN_IRAM
        select DW_GDMA_GETTER_FUNC_IN_IRAM
        help
            Ensure the CSI driver ISR is Cache-Safe. When enabled, the ISR handler
            will be available when the cache is disabled.

    config CAM_CTLR_ISP_DVP_ISR_CACHE_SAFE # IDF-10093
        bool "ISP_DVP ISR Cache-Safe"
        default n
        select DW_GDMA_ISR_IRAM_SAFE
        select DW_GDMA_CTRL_FUNC_IN_IRAM
        select DW_GDMA_SETTER_FUNC_IN_IRAM
        select DW_GDMA_GETTER_FUNC_IN_IRAM
        help
            Ensure the ISP_DVP driver ISR is Cache-Safe. When enabled, the ISR handler
            will be available when the cache is disabled.

    config CAM_CTLR_DVP_CAM_ISR_CACHE_SAFE
        bool "DVP ISR Cache-Safe"
        depends on SOC_LCDCAM_CAM_SUPPORTED
        default n
        select GDMA_ISR_HANDLER_IN_IRAM if SOC_GDMA_SUPPORTED
        select GDMA_CTRL_FUNC_IN_IRAM if SOC_GDMA_SUPPORTED
        help
            Ensure the DVP driver ISR is Cache-Safe. When enabled, the ISR handler
            will be available when the cache is disabled.

endmenu # ESP Camera Controller Configurations
```

## components/esp_driver_cam/test_apps/csi/sdkconfig.defaults.esp32p4
```kconfig
CONFIG_IDF_TARGET="esp32p4"

CONFIG_SPIRAM=y
CONFIG_IDF_EXPERIMENTAL_FEATURES=y
CONFIG_SPIRAM_SPEED_200M=y

CONFIG_CAMERA_OV5647=y
CONFIG_CAMERA_OV5647_MIPI_RAW8_800X640_50FPS=y
```

## components/esp_driver_cam/test_apps/dvp/sdkconfig.defaults.esp32s3
```kconfig
CONFIG_IDF_TARGET="esp32s3"

CONFIG_ESP_CONSOLE_USB_SERIAL_JTAG=y

CONFIG_SPIRAM=y
CONFIG_SPIRAM_MODE_OCT=y
```

## components/esp_driver_cordic/Kconfig
```kconfig
menu "ESP-Driver:Cordic Configurations"
    depends on SOC_CORDIC_SUPPORTED

    config CORDIC_ONESHOT_CTRL_FUNC_IN_IRAM
        bool "Place cordic oneshot calculation function into IRAM"
        default n
        help
            Place cordic oneshot function into IRAM so that cordic oneshot function
            can be safely used in ISR even when cache is disabled.
endmenu
```
