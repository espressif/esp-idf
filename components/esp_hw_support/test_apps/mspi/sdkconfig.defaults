## components/esp_hw_support/test_apps/mspi/sdkconfig.defaults
```kconfig
CONFIG_FREERTOS_HZ=1000
CONFIG_ESP_TASK_WDT_EN=n

CONFIG_SPIRAM_RODATA=y
CONFIG_SPIRAM_FETCH_INSTRUCTIONS=y
```

## components/esp_hw_support/test_apps/mspi_psram_with_dfs/sdkconfig.defaults
```kconfig
CONFIG_FREERTOS_HZ=1000

# For test access psram with DFS enabled
CONFIG_SPIRAM_FETCH_INSTRUCTIONS=y
CONFIG_SPIRAM_RODATA=y
CONFIG_PM_ENABLE=y
CONFIG_FREERTOS_USE_TICKLESS_IDLE=y
CONFIG_FREERTOS_IDLE_TIME_BEFORE_SLEEP=5
```

## components/esp_hw_support/test_apps/rtc_8md256/sdkconfig.defaults
```kconfig
CONFIG_FREERTOS_HZ=1000
CONFIG_ESP_TASK_WDT_EN=n
CONFIG_RTC_CLK_SRC_INT_8MD256=y
```

## components/esp_hw_support/test_apps/sleep_retention/sdkconfig.defaults
```kconfig
CONFIG_FREERTOS_HZ=1000
CONFIG_ESP_TASK_WDT=n

CONFIG_PM_ENABLE=y
CONFIG_PM_POWER_DOWN_CPU_IN_LIGHT_SLEEP=y
CONFIG_PM_POWER_DOWN_PERIPHERAL_IN_LIGHT_SLEEP=y
```

## components/esp_hw_support/test_apps/vad_wakeup/sdkconfig.defaults
```kconfig
CONFIG_ESP_TASK_WDT_INIT=n

CONFIG_ULP_COPROC_ENABLED=y
CONFIG_ULP_COPROC_TYPE_LP_CORE=y
CONFIG_ULP_COPROC_RESERVE_MEM=12000
CONFIG_ULP_PANIC_OUTPUT_ENABLE=y

CONFIG_ESP_CONSOLE_USB_SERIAL_JTAG=y
```

## components/esp_hw_support/test_apps/wakeup_tests/sdkconfig.defaults
```kconfig
CONFIG_ESP_SLEEP_GPIO_RESET_WORKAROUND=n
CONFIG_ESP_SLEEP_GPIO_ENABLE_INTERNAL_RESISTORS=n
```

## components/esp_ipc/Kconfig
```kconfig
menu "IPC (Inter-Processor Call)"

    config ESP_IPC_TASK_STACK_SIZE
        int "Inter-Processor Call (IPC) task stack size"
        range 512 65536 if !APPTRACE_ENABLE
        range 2048 65536 if APPTRACE_ENABLE
        default 2048 if APPTRACE_ENABLE
        default 1536
        help
            Configure the IPC tasks stack size. An IPC task runs on each core (in dual core mode), and allows for
            cross-core function calls. See IPC documentation for more details. The default IPC stack size should be
            enough for most common simple use cases. However, users can increase/decrease the stack size to their
            needs.

    config ESP_IPC_USES_CALLERS_PRIORITY
        bool "IPC runs at caller's priority"
        default y
        depends on !FREERTOS_UNICORE
        help
            If this option is not enabled then the IPC task will keep behavior same as prior to that of ESP-IDF v4.0,
            hence IPC task will run at (configMAX_PRIORITIES - 1) priority.

    config ESP_IPC_ISR_ENABLE
        bool
        default y if !FREERTOS_UNICORE
        help
            The IPC ISR feature is similar to the IPC feature except that the callback function is executed in the
            context of a High Priority Interrupt. The IPC ISR feature is itended for low latency execution of simple
            callbacks written in assembly on another CPU. Due to being run in a High Priority Interrupt, the assembly
            callbacks must be written with particular restrictions (see "IPC" and "High-Level Interrupt" docs for more
            details).

endmenu # "IPC (Inter-Processor Call)
```

## components/esp_lcd/Kconfig
```kconfig
menu "ESP-Driver:LCD Controller Configurations"

    if SOC_LCD_RGB_SUPPORTED
        config LCD_RGB_ISR_IRAM_SAFE
            bool "RGB LCD ISR IRAM-Safe"
            select GDMA_ISR_HANDLER_IN_IRAM # bounce buffer mode relies on GDMA EOF interrupt
            select ESP_PERIPH_CTRL_FUNC_IN_IRAM
            default n
            help
                Ensure the LCD interrupt is IRAM-Safe by allowing the interrupt handler to be
                executable when the cache is disabled (e.g. SPI Flash write).
                If you want the LCD driver to keep flushing the screen even when cache ops disabled,
                you can enable this option. Note, this will also increase the IRAM usage.

        config LCD_RGB_RESTART_IN_VSYNC
            bool "Always restart RGB LCD transmission in VSYNC"
            default n
            help
                Reset the GDMA channel every VBlank to stop permanent desyncs from happening.
                Only need to enable it when in your application, the DMA can't deliver data
                as fast as the LCD consumes it.
    endif # SOC_LCD_RGB_SUPPORTED

    if SOC_MIPI_DSI_SUPPORTED
        config LCD_DSI_ISR_HANDLER_IN_IRAM
            bool "Place DSI ISR handler in IRAM to reduce latency"
            default y
            select LCD_DSI_OBJ_FORCE_INTERNAL
            help
                Place DSI ISR handler in IRAM to reduce latency caused by cache miss.

        config LCD_DSI_ISR_CACHE_SAFE
            bool "Allow DSI ISR to execute when cache is disabled" if !SPI_FLASH_AUTO_SUSPEND
            select LCD_DSI_ISR_HANDLER_IN_IRAM
            select DW_GDMA_ISR_IRAM_SAFE # relies on DW_GDMA Full trans done interrupt
            default n
            help
                Enable this option to allow the DSI Interrupt Service Routine (ISR)
                to execute even when the cache is disabled. This can be useful in scenarios where the cache
                might be turned off, but the DSI functionality is still required to operate correctly.

        config LCD_DSI_OBJ_FORCE_INTERNAL
            bool
            default n
            help
                This will ensure the DSI driver object will always be allocated in internal RAM.
    endif # SOC_MIPI_DSI_SUPPORTED

    config LCD_ENABLE_DEBUG_LOG
        bool "Force enable debug log"
        default n
        help
            If enabled, LCD driver component will:
            1. ignore the global logging settings
            2. compile all log messages into the binary
            3. set the runtime log level to VERBOSE
            Please enable this option by caution, as it will increase the binary size.
endmenu
```

## components/esp_lcd/test_apps/mipi_dsi_lcd/sdkconfig.defaults
```kconfig
CONFIG_ESP_TASK_WDT_INIT=n
CONFIG_FREERTOS_HZ=1000
CONFIG_IDF_EXPERIMENTAL_FEATURES=y
```

## components/esp_lcd/test_apps/rgb_lcd/sdkconfig.defaults.esp32p4
```kconfig
CONFIG_IDF_EXPERIMENTAL_FEATURES=y

CONFIG_SPIRAM=y
CONFIG_SPIRAM_MODE_HEX=y
CONFIG_SPIRAM_SPEED_200M=y
```

## components/esp_lcd/test_apps/rgb_lcd/sdkconfig.defaults.esp32s3
```kconfig
CONFIG_SPIRAM=y
CONFIG_SPIRAM_MODE_OCT=y
CONFIG_SPIRAM_SPEED_80M=y

# Enable the XIP-PSRAM feature, so the ext-mem cache won't be disabled when SPI1 is operating the main flash
CONFIG_SPIRAM_XIP_FROM_PSRAM=y
```

## components/esp_lcd/test_apps/rgb_lcd/sdkconfig.defaults.esp32s31
```kconfig
CONFIG_SPIRAM=y
CONFIG_SPIRAM_MODE_OCT=y
CONFIG_SPIRAM_SPEED_250M=y

# Enable the XIP-PSRAM feature, to increase PSRAM bandwidth
CONFIG_SPIRAM_XIP_FROM_PSRAM=y
```

## components/esp_local_ctrl/test_apps/sdkconfig.defaults
```kconfig
# Enable Security Version 0 (no encryption) so esp_local_ctrl_start() succeeds
# with a minimal null transport (no BLE/Wi-Fi hardware required).
CONFIG_ESP_PROTOCOMM_SUPPORT_SECURITY_VERSION_0=y
CONFIG_ESP_TASK_WDT_INIT=n
```

## components/esp_mm/Kconfig
```kconfig
menu "ESP-MM: Memory Management Configurations"

    config ESP_MM_CACHE_MSYNC_C2M_CHUNKED_OPS
        depends on SOC_CACHE_WRITEBACK_SUPPORTED
        bool "Enable esp_cache_msync C2M chunked operation"
        help
            `esp_cache_msync` C2M direction takes critical sections, which means during
            the operation, the interrupts are disabled. Whereas Cache writebacks for
            large buffers could be especially time intensive, and might cause interrupts
            to be disabled for a significant amount of time.

            Sometimes you want other ISRs to be responded during this C2M process.
            This option is to slice one C2M operation into multiple chunks,
            with CONFIG_ESP_MM_CACHE_MSYNC_C2M_CHUNKED_OPS_MAX_LEN max len. This will give you
            a breath during the C2M process as sometimes the C2M process is quite long.

            Note if the buffer processed by the `esp_cache_msync` (C2M sliced) is interrupted by an ISR,
            and this ISR also accesses this buffer, this may lead to data coherence issue.

    config ESP_MM_CACHE_MSYNC_C2M_CHUNKED_OPS_MAX_LEN
        hex "Max len in bytes per C2M chunk"
        depends on ESP_MM_CACHE_MSYNC_C2M_CHUNKED_OPS
        range 0 0x80000
        default 0x20000 if IDF_TARGET_ESP32P4
        default 0x2000 if IDF_TARGET_ESP32S2
        default 0x8000 if IDF_TARGET_ESP32S3
        help
            Max len in bytes per C2M chunk, operations with size over the max len will be
            sliced into multiple chunks.

endmenu
```

## components/esp_mm/test_apps/mm/sdkconfig.defaults
```kconfig
CONFIG_ESP_TASK_WDT_EN=n

CONFIG_PARTITION_TABLE_CUSTOM=y
CONFIG_PARTITION_TABLE_CUSTOM_FILENAME="partitions.csv"
CONFIG_PARTITION_TABLE_FILENAME="partitions.csv"

CONFIG_COMPILER_DUMP_RTL_FILES=y

CONFIG_ESP_TIMER_SUPPORTS_ISR_DISPATCH_METHOD=y

CONFIG_HAL_ASSERTION_SILENT=y
```

## components/esp_mspi/test_apps/mspi/sdkconfig.defaults
```kconfig
CONFIG_FREERTOS_HZ=1000
CONFIG_ESP_TASK_WDT_EN=n

CONFIG_PARTITION_TABLE_CUSTOM=y
CONFIG_PARTITION_TABLE_CUSTOM_FILENAME="partitions.csv"
CONFIG_PARTITION_TABLE_FILENAME="partitions.csv"
```

## components/esp_netif/Kconfig
```kconfig
menu "ESP NETIF Adapter"

    config ESP_NETIF_IP_LOST_TIMER_INTERVAL
        int "IP Address lost timer interval (seconds)"
        range 0 65535
        default 120
        help
            The value of 0 indicates the IP lost timer is disabled, otherwise the timer is enabled.

            The IP address may be lost because of some reasons, e.g. when the station disconnects
            from soft-AP, or when DHCP IP renew fails etc. If the IP lost timer is enabled, it will
            be started everytime the IP is lost. Event SYSTEM_EVENT_STA_LOST_IP will be raised if
            the timer expires. The IP lost timer is stopped if the station get the IP again before
            the timer expires.

    choice ESP_NETIF_USE_TCPIP_STACK_LIB
        prompt "TCP/IP Stack Library"
        default ESP_NETIF_TCPIP_LWIP
        help
            Choose the TCP/IP Stack to work, for example, LwIP, uIP, etc.
        config ESP_NETIF_TCPIP_LWIP
            bool "LwIP"
            select ESP_NETIF_USES_TCPIP_WITH_BSD_API
            depends on LWIP_ENABLE
            help
                lwIP is a small independent implementation of the TCP/IP protocol suite.

        config ESP_NETIF_LOOPBACK
            bool "Loopback"
            help
                Dummy implementation of esp-netif functionality which connects driver transmit
                to receive function. This option is for testing purpose only

    endchoice

    config ESP_NETIF_USES_TCPIP_WITH_BSD_API
        bool # Set to true if the chosen TCP/IP stack provides BSD socket API

    config ESP_NETIF_RECEIVE_REPORT_ERRORS
        bool "Use esp_err_t to report errors from esp_netif_receive"
        default n
        help
            Enable if esp_netif_receive() should return error code. This is useful to inform upper layers
            that packet input to TCP/IP stack failed, so the upper layers could implement flow control.
            This option is disabled by default due to backward compatibility and will be enabled in v6.0 (IDF-7194)

    config ESP_NETIF_L2_TAP
        bool "Enable netif L2 TAP support"
        select ETH_TRANSMIT_MUTEX
        help
            A user program can read/write link layer (L2) frames from/to ESP TAP device.
            The ESP TAP device can be currently associated only with Ethernet physical interfaces.

    config ESP_NETIF_L2_TAP_MAX_FDS
        depends on ESP_NETIF_L2_TAP
        int "Maximum number of opened L2 TAP File descriptors"
        range 1 10
        default 5
        help
            Maximum number of opened File descriptors (FD's) associated with ESP TAP device. ESP TAP FD's take up
            a certain amount of memory, and allowing fewer FD's to be opened at the same time conserves memory.

    config ESP_NETIF_L2_TAP_RX_QUEUE_SIZE
        depends on ESP_NETIF_L2_TAP
        int "Size of L2 TAP Rx queue"
        range 1 100
        default 20
        help
            Maximum number of frames queued in opened File descriptor. Once the queue is full, the newly arriving
            frames are dropped until the queue has enough room to accept incoming traffic (Tail Drop queue
            management).

    config ESP_NETIF_BRIDGE_EN
        depends on ESP_NETIF_TCPIP_LWIP
        bool "Enable LwIP IEEE 802.1D bridge"
        default n
        help
            Enable LwIP IEEE 802.1D bridge support in ESP-NETIF. Note that "Number of clients store data in netif"
            (LWIP_NUM_NETIF_CLIENT_DATA) option needs to be properly configured to be LwIP bridge avaiable!
endmenu
```

## components/esp_netif/test_apps/test_app_vfs_l2tap/sdkconfig.defaults
```kconfig
CONFIG_UNITY_ENABLE_FIXTURE=y
CONFIG_UNITY_ENABLE_IDF_TEST_RUNNER=y

CONFIG_ETH_USE_ESP32_EMAC=y

CONFIG_ESP_NETIF_L2_TAP=y
CONFIG_LWIP_CHECK_THREAD_SAFETY=y
```

## components/esp_partition/Kconfig
```kconfig
menu "Partition API Configuration"

    config ESP_PARTITION_ENABLE_STATS
        bool "Host test statistics enabled"
        depends on IDF_TARGET_LINUX
        default n
        help
            This option enables gathering host test statistics and SPI flash wear levelling simulation.

    config ESP_PARTITION_ERASE_CHECK
        bool "Check if flash is erased before writing"
        depends on IDF_TARGET_LINUX
        default y
        help
            This option controls whether the partition implementation checks
            if the flash is erased before writing to it.
            This is necessary for SPIFFS, which expects to be able to write without erasing first.

endmenu
```

## components/esp_partition/host_test/partition_api_test/sdkconfig.defaults
```kconfig
CONFIG_IDF_TARGET="linux"
CONFIG_IDF_TARGET_LINUX=y
CONFIG_COMPILER_CXX_EXCEPTIONS=y
CONFIG_UNITY_ENABLE_IDF_TEST_RUNNER=n
CONFIG_UNITY_ENABLE_FIXTURE=y
CONFIG_PARTITION_TABLE_CUSTOM=y
CONFIG_PARTITION_TABLE_CUSTOM_FILENAME="partition_table.csv"
CONFIG_ESP_PARTITION_ENABLE_STATS=y
```
