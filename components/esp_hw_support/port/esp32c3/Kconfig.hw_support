## components/esp_hw_support/port/esp32p4/Kconfig.dcdc
```kconfig
menu "DCDC Regulator Configurations"
    depends on SOC_DCDC_SUPPORTED

    config ESP_SLEEP_DCM_VSET_VAL_IN_SLEEP
        int "DCDC voltage parameter during sleep"
        default 14
        range 0 31
        help
            This value determines the voltage of the DCDC chip during sleep. The same parameter value may
            correspond to different voltage values on different models of DCDC chips. Please update this
            value according to the model of external DCDC selected in your hardware solution.

            For the DCDC chip model recommended by ESP, the recommended configuration
            values are listed below:

            - TI-TLV62569/TLV62569P: 14
endmenu
```

## components/esp_hw_support/port/esp32p4/Kconfig.hw_support
```kconfig
comment "NOTE! Support of ESP32-P4 rev. <3.0 and >=3.0 is mutually exclusive"
comment "Read the help text of the option below for explanation"

config ESP32P4_SELECTS_REV_LESS_V3
    bool "Select ESP32-P4 revisions <3.0 (No >=3.x Support)"
    default n
    help
        Select this option to support ESP32-P4 revisions 0.x and 1.x.
        Revisions higher than 3.0 (included) and revisions less than 3.0
        have huge hardware difference.
        Revisions higher than 3.0 (included) is not compatible with 0.x and 1.x.

choice ESP32P4_REV_MIN
    prompt "Minimum Supported ESP32-P4 Revision"
    default ESP32P4_REV_MIN_300 if IDF_CI_BUILD
    default ESP32P4_REV_MIN_301
    help
        Required minimum chip revision. ESP-IDF will check for it and
        reject to boot if the chip revision fails the check.
        This ensures the chip used will have some modifications (features, or bugfixes).

        The complied binary will only support chips above this revision,
        this will also help to reduce binary size.

    config ESP32P4_REV_MIN_0
        depends on ESP32P4_SELECTS_REV_LESS_V3
        bool "Rev v0.0"
    config ESP32P4_REV_MIN_1
        depends on ESP32P4_SELECTS_REV_LESS_V3
        bool "Rev v0.1"
    config ESP32P4_REV_MIN_100
        depends on ESP32P4_SELECTS_REV_LESS_V3
        bool "Rev v1.0"
    config ESP32P4_REV_MIN_300
        bool "Rev v3.0"
        depends on !ESP32P4_SELECTS_REV_LESS_V3
    config ESP32P4_REV_MIN_301
        bool "Rev v3.1"
        depends on !ESP32P4_SELECTS_REV_LESS_V3
endchoice

config ESP32P4_REV_MIN_FULL
    int
    default 0 if ESP32P4_REV_MIN_0
    default 1 if ESP32P4_REV_MIN_1
    default 100 if ESP32P4_REV_MIN_100
    default 300 if ESP32P4_REV_MIN_300
    default 301 if ESP32P4_REV_MIN_301

config ESP_REV_MIN_FULL
    int
    default ESP32P4_REV_MIN_FULL

    #
    # MAX Revision
    #

    comment "Maximum Supported ESP32-P4 Revision (Rev v1.99)"
    depends on ESP32P4_SELECTS_REV_LESS_V3
    comment "Maximum Supported ESP32-P4 Revision (Rev v3.99)"
    depends on !ESP32P4_SELECTS_REV_LESS_V3
    # Maximum revision that IDF supports.
    # It can not be changed by user.
    # Only Espressif can change it when a new version will be supported in IDF.
    # Supports all chips starting from ESP32P4_REV_MIN_FULL to ESP32P4_REV_MAX_FULL

config ESP32P4_REV_MAX_FULL
    int
    default 399 if !ESP32P4_SELECTS_REV_LESS_V3
    default 199 if ESP32P4_SELECTS_REV_LESS_V3
    # keep in sync the "Maximum Supported Revision" description with this value

config ESP_REV_MAX_FULL
    int
    default ESP32P4_REV_MAX_FULL

config ESP_EFUSE_BLOCK_REV_MIN_FULL
    int "Minimum Supported ESP32-P4 eFuse Block Revision"
    default 0
    help
        Required minimum eFuse Block revision. ESP-IDF will check it at the 2nd bootloader stage
        whether the current image can work correctly for this eFuse Block revision.
        So that to avoid running an incompatible image on a SoC that contains breaking change in the eFuse Block.
        If you want to update this value to run the image that not compatible with the current eFuse Block revision,
        please contact to Espressif's business team for details:
        https://www.espressif.com.cn/en/contact-us/sales-questions

config ESP_EFUSE_BLOCK_REV_MAX_FULL
    int
    default 199
    comment "Maximum Supported ESP32-P4 eFuse Block Revision (eFuse Block Rev v0.99)"
    # The revision in the comment must correspond to the default value of ESP_EFUSE_BLOCK_REV_MAX_FULL
```

## components/esp_hw_support/port/esp32p4/Kconfig.ldo
```kconfig
menu "LDO Regulator Configurations"
    depends on SOC_GP_LDO_SUPPORTED

    config ESP_LDO_RESERVE_SPI_NOR_FLASH
        bool "Reserve one LDO regulator channel for SPI NOR Flash (READ HELP)"
        default y
        help
            The LDO channel 1 can be used to power the SPI Flash chip,
            because the channel 1 is enabled by default after power on reset.
            If your SPI flash chip is not powered by ESP internal LDO, you can disable this option.
            Then you will free up one LDO channel for other general purpose.

    config ESP_LDO_CHAN_SPI_NOR_FLASH_DOMAIN
        int "LDO regulator channel that used to power SPI NOR Flash (READ HELP)"
        depends on ESP_LDO_RESERVE_SPI_NOR_FLASH
        default 1
        range 1 1
        help
            Select which LDO channel to connect to the SPI Flash chip.

    choice ESP_LDO_VOLTAGE_SPI_NOR_FLASH_DOMAIN
        prompt "SPI NOR Flash power domain voltage"
        depends on ESP_LDO_RESERVE_SPI_NOR_FLASH
        default ESP_LDO_VOLTAGE_SPI_NOR_FLASH_3300_MV
        help
            Select the voltage used by the Flash power domain.

        config ESP_LDO_VOLTAGE_SPI_NOR_FLASH_3300_MV
            bool "3.3V"
    endchoice

    config ESP_LDO_VOLTAGE_SPI_NOR_FLASH_DOMAIN
        int
        default 3300 if ESP_LDO_VOLTAGE_SPI_NOR_FLASH_3300_MV

    config ESP_LDO_RESERVE_PSRAM
        bool "Reserve one LDO regulator channel for PSRAM (READ HELP)"
        default y
        help
            The LDO channel 2 can be used to power the PSRAM chip.
            If the PSRAM chip is not powered by ESP internal LDO, you can disable this option.
            Then you will free up one LDO channel for other general purpose.

    config ESP_LDO_CHAN_PSRAM_DOMAIN
        int "LDO regulator channel that used to power PSRAM and MPLL (READ HELP)"
        depends on ESP_LDO_RESERVE_PSRAM
        default 2
        range 2 2
        help
            Select which LDO channel to connect to the PSRAM chip.

    choice ESP_LDO_VOLTAGE_PSRAM_DOMAIN
        prompt "PSRAM power domain voltage"
        depends on ESP_LDO_RESERVE_PSRAM
        default ESP_LDO_VOLTAGE_PSRAM_1900_MV
        help
            Select the voltage used by the PSRAM power domain.

        config ESP_LDO_VOLTAGE_PSRAM_1900_MV
            bool "1.9V"
    endchoice

    config ESP_LDO_VOLTAGE_PSRAM_DOMAIN
        int
        default 1900 if ESP_LDO_VOLTAGE_PSRAM_1900_MV
endmenu
```

## components/esp_hw_support/port/esp32p4/Kconfig.mac
```kconfig
choice ESP32P4_UNIVERSAL_MAC_ADDRESSES
    bool "Number of universally administered (by IEEE) MAC address"
    default ESP32P4_UNIVERSAL_MAC_ADDRESSES_ONE
    help
        Configure the number of universally administered (by IEEE) MAC addresses.

        During initialization, MAC addresses for each network interface are generated or derived from a
        single base MAC address.

        If the number of universal MAC addresses is one, only Ethernet interface receives a universally
        administered MAC address. It's generated by adding 0 to the base MAC address.

        On ESP32-P4 this value is fixed to one, because only Ethernet receives a universally administered
        MAC address.

    config ESP32P4_UNIVERSAL_MAC_ADDRESSES_ONE
        bool "One"
        select ESP_MAC_UNIVERSAL_MAC_ADDRESSES_ONE
        select ESP_MAC_ADDR_UNIVERSE_ETH
endchoice

config ESP32P4_UNIVERSAL_MAC_ADDRESSES
    int
    default 1 if ESP32P4_UNIVERSAL_MAC_ADDRESSES_ONE
```

## components/esp_hw_support/port/esp32s2/Kconfig.mac
```kconfig
choice ESP32S2_UNIVERSAL_MAC_ADDRESSES
    bool "Number of universally administered (by IEEE) MAC address"
    default ESP32S2_UNIVERSAL_MAC_ADDRESSES_TWO
    help
        Configure the number of universally administered (by IEEE) MAC addresses.
        During initialization, MAC addresses for each network interface are generated or derived from a
        single base MAC address.
        If the number of universal MAC addresses is Two, all interfaces (WiFi station, WiFi softap) receive a
        universally administered MAC address. They are generated sequentially by adding 0, and 1 (respectively)
        to the final octet of the base MAC address. If the number of universal MAC addresses is one,
        only WiFi station receives a universally administered MAC address.
        It's generated by adding 0 to the base MAC address.
        The WiFi softap receives local MAC addresses. It's derived from the universal WiFi station MAC addresses.
        When using the default (Espressif-assigned) base MAC address, either setting can be used. When using
        a custom universal MAC address range, the correct setting will depend on the allocation of MAC
        addresses in this range (either 1 or 2 per device.)

    config ESP32S2_UNIVERSAL_MAC_ADDRESSES_ONE
        bool "One"
        select ESP_MAC_UNIVERSAL_MAC_ADDRESSES_ONE
        select ESP_MAC_ADDR_UNIVERSE_WIFI_STA

    config ESP32S2_UNIVERSAL_MAC_ADDRESSES_TWO
        bool "Two"
        select ESP_MAC_UNIVERSAL_MAC_ADDRESSES_TWO
        select ESP_MAC_ADDR_UNIVERSE_WIFI_STA
        select ESP_MAC_ADDR_UNIVERSE_WIFI_AP
endchoice

config ESP32S2_UNIVERSAL_MAC_ADDRESSES
    int
    default 1 if ESP32S2_UNIVERSAL_MAC_ADDRESSES_ONE
    default 2 if ESP32S2_UNIVERSAL_MAC_ADDRESSES_TWO
```

## components/esp_hw_support/port/esp32s2/Kconfig.rtc
```kconfig
choice RTC_CLK_SRC
    prompt "RTC clock source"
    default RTC_CLK_SRC_INT_RC
    help
        Choose which clock is used as RTC clock source.

        - "Internal 90kHz oscillator" option provides lowest deep sleep current
            consumption, and does not require extra external components. However
            frequency stability with respect to temperature is poor, so time may
            drift in deep/light sleep modes.
        - "External 32kHz crystal" provides better frequency stability, at the
            expense of slightly higher (1uA) deep sleep current consumption.
        - "External 32kHz oscillator" allows using 32kHz clock generated by an
            external circuit. In this case, external clock signal must be connected
            to 32K_XP pin. Amplitude should be <1.2V in case of sine wave signal,
            and <1V in case of square wave signal. Common mode voltage should be
            0.1 < Vcm < 0.5Vamp, where Vamp is the signal amplitude.
        - "Internal 8MHz oscillator divided by 256" option results in higher
            deep sleep current (by 5uA) but has better frequency stability than
            the internal 90kHz oscillator. It does not require external components.

    config RTC_CLK_SRC_INT_RC
        bool "Internal 90kHz RC oscillator"
    config RTC_CLK_SRC_EXT_CRYS
        bool "External 32kHz crystal"
        select ESP_SYSTEM_RTC_EXT_XTAL
    config RTC_CLK_SRC_EXT_OSC
        bool "External 32kHz oscillator at 32K_XN pin"
        select ESP_SYSTEM_RTC_EXT_OSC
    config RTC_CLK_SRC_INT_8MD256
        bool "Internal 8MHz oscillator, divided by 256 (~32kHz)"
endchoice

config RTC_CLK_CAL_CYCLES
    int "Number of cycles for RTC_SLOW_CLK calibration"
    default 3000 if RTC_CLK_SRC_EXT_CRYS || RTC_CLK_SRC_EXT_OSC || RTC_CLK_SRC_INT_8MD256
    default 576 if RTC_CLK_SRC_INT_RC
    range 0 8190 if RTC_CLK_SRC_EXT_CRYS || RTC_CLK_SRC_EXT_OSC || RTC_CLK_SRC_INT_8MD256
    range 0 32766 if RTC_CLK_SRC_INT_RC
    help
        When the startup code initializes RTC_SLOW_CLK, it can perform
        calibration by comparing the RTC_SLOW_CLK frequency with main XTAL
        frequency. This option sets the number of RTC_SLOW_CLK cycles measured
        by the calibration routine. Higher numbers increase calibration
        precision, which may be important for applications which spend a lot of
        time in deep sleep. Lower numbers reduce startup time.

        When this option is set to 0, clock calibration will not be performed at
        startup, and approximate clock frequencies will be assumed:

        - 90000 Hz if internal RC oscillator is used as clock source. For this use value 1024.
        - 32768 Hz if the 32k crystal oscillator is used. For this use value 3000 or more.
            In case more value will help improve the definition of the launch of the crystal.
            If the crystal could not start, it will be switched to internal RC.

config RTC_XTAL_CAL_RETRY
    int "Number of attempts to repeat 32k XTAL calibration"
    default 3
    depends on RTC_CLK_SRC_EXT_CRYS
    help
        Number of attempts to repeat 32k XTAL calibration
        before giving up and switching to the internal RC.
        Increase this option if the 32k crystal oscillator
        does not start and switches to internal RC.
```

## components/esp_hw_support/port/esp32s31/Kconfig.ldo
```kconfig
menu "LDO Regulator Configurations"
    depends on SOC_GP_LDO_SUPPORTED

    config ESP_LDO_RESERVE_PSRAM
        bool "Reserve one LDO regulator channel for PSRAM (READ HELP)"
        default y
        help
            The LDO channel can be used to power the PSRAM chip.
            If the PSRAM chip is not powered by ESP internal LDO, you can disable this option.
            Then you will free up one LDO channel for other general purpose.

    config ESP_LDO_CHAN_PSRAM_DOMAIN
        int "LDO regulator channel that used to power PSRAM and MPLL (READ HELP)"
        depends on ESP_LDO_RESERVE_PSRAM
        default 1
        range 1 1
        help
            Select which LDO channel to connect to the PSRAM chip.

    choice ESP_LDO_VOLTAGE_PSRAM_DOMAIN
        prompt "PSRAM power domain voltage"
        depends on ESP_LDO_RESERVE_PSRAM
        default ESP_LDO_VOLTAGE_PSRAM_1800_MV
        help
            Select the voltage used by the PSRAM power domain.

        config ESP_LDO_VOLTAGE_PSRAM_1800_MV
            bool "1.8V"
    endchoice

    config ESP_LDO_VOLTAGE_PSRAM_DOMAIN
        int
        default 1800 if ESP_LDO_VOLTAGE_PSRAM_1800_MV
endmenu
```
