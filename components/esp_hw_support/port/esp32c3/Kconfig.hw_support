## components/esp_hw_support/port/esp32s31/Kconfig.mac
```kconfig
choice ESP32S31_UNIVERSAL_MAC_ADDRESSES
    bool "Number of universally administered (by IEEE) MAC address"
    default ESP32S31_UNIVERSAL_MAC_ADDRESSES_TWO
    help
        Configure the number of universally administered (by IEEE) MAC addresses.
        During initialization, MAC addresses for each network interface are generated or derived from a
        single base MAC address.
        If the number of universal MAC addresses is four, all four interfaces (WiFi station, WiFi softap,
        Bluetooth and Ethernet) receive a universally administered MAC address. These are generated
        sequentially by adding 0, 1, 2 and 3 (respectively) to the final octet of the base MAC address.
        If the number of universal MAC addresses is two, only two interfaces (WiFi station and Bluetooth)
        receive a universally administered MAC address. These are generated sequentially by adding 0
        and 1 (respectively) to the base MAC address. The remaining two interfaces (WiFi softap and Ethernet)
        receive local MAC addresses. These are derived from the universal WiFi station and Bluetooth MAC
        addresses, respectively.
        ESP32-S31 only provides two universally administered MAC addresses in eFuse, so "Two" is the
        recommended and default setting. "Four" is only intended for use with a custom base MAC range
        where four universally administered MAC addresses are allocated per device.

    config ESP32S31_UNIVERSAL_MAC_ADDRESSES_TWO
        bool "Two"
        select ESP_MAC_UNIVERSAL_MAC_ADDRESSES_TWO
        select ESP_MAC_ADDR_UNIVERSE_WIFI_STA
        select ESP_MAC_ADDR_UNIVERSE_BT

    config ESP32S31_UNIVERSAL_MAC_ADDRESSES_FOUR
        bool "Four"
        select ESP_MAC_UNIVERSAL_MAC_ADDRESSES_FOUR
        select ESP_MAC_ADDR_UNIVERSE_WIFI_STA
        select ESP_MAC_ADDR_UNIVERSE_WIFI_AP
        select ESP_MAC_ADDR_UNIVERSE_BT
        select ESP_MAC_ADDR_UNIVERSE_ETH
endchoice

config ESP32S31_UNIVERSAL_MAC_ADDRESSES
    int
    default 2 if ESP32S31_UNIVERSAL_MAC_ADDRESSES_TWO
    default 4 if ESP32S31_UNIVERSAL_MAC_ADDRESSES_FOUR
```

## components/esp_hw_support/port/linux/Kconfig.hw_support
```kconfig
config ESP_REV_MIN_FULL
    int
    default 0

config ESP_REV_MAX_FULL
    int
    default 999

config ESP_EFUSE_BLOCK_REV_MIN_FULL
    int
    default 0

config ESP_EFUSE_BLOCK_REV_MAX_FULL
    int
    default 999
```

## components/esp_hw_support/power_supply/port/esp32/Kconfig.power
```kconfig
menu "Power Supplier"

    menu "Brownout Detector"

        config ESP_BROWNOUT_DET
            bool "Hardware brownout detect & reset"
            depends on !IDF_ENV_FPGA
            default y
            help
                The ESP has a built-in brownout detector which can detect if the voltage is lower than
                a specific value. If this happens, it will reset the chip in order to prevent unintended
                behaviour.

        choice ESP_BROWNOUT_DET_LVL_SEL
            prompt "Brownout voltage level"
            depends on ESP_BROWNOUT_DET
            default ESP_BROWNOUT_DET_LVL_SEL_0
            help
                The brownout detector will reset the chip when the supply voltage is approximately
                below this level. Note that there may be some variation of brownout voltage level
                between each ESP chip.

                #The voltage levels here are estimates, more work needs to be done to figure out the exact voltages
                #of the brownout threshold levels.
            config ESP_BROWNOUT_DET_LVL_SEL_0
                bool "2.43V +/- 0.05"
            config ESP_BROWNOUT_DET_LVL_SEL_1
                bool "2.48V +/- 0.05"
            config ESP_BROWNOUT_DET_LVL_SEL_2
                bool "2.58V +/- 0.05"
            config ESP_BROWNOUT_DET_LVL_SEL_3
                bool "2.62V +/- 0.05"
            config ESP_BROWNOUT_DET_LVL_SEL_4
                bool "2.67V +/- 0.05"
            config ESP_BROWNOUT_DET_LVL_SEL_5
                bool "2.70V +/- 0.05"
            config ESP_BROWNOUT_DET_LVL_SEL_6
                bool "2.77V +/- 0.05"
            config ESP_BROWNOUT_DET_LVL_SEL_7
                bool "2.80V +/- 0.05"
        endchoice

        config ESP_BROWNOUT_DET_LVL
            int
            default 0 if ESP_BROWNOUT_DET_LVL_SEL_0
            default 1 if ESP_BROWNOUT_DET_LVL_SEL_1
            default 2 if ESP_BROWNOUT_DET_LVL_SEL_2
            default 3 if ESP_BROWNOUT_DET_LVL_SEL_3
            default 4 if ESP_BROWNOUT_DET_LVL_SEL_4
            default 5 if ESP_BROWNOUT_DET_LVL_SEL_5
            default 6 if ESP_BROWNOUT_DET_LVL_SEL_6
            default 7 if ESP_BROWNOUT_DET_LVL_SEL_7

        config ESP_BROWNOUT_USE_INTR
            bool
            default n
            help
                This config allows to trigger an interrupt when brownout detected. Software restart will be done
                at the end of the default callback.
                Two occasions need to restart the chip with interrupt so far.
                (1). For ESP32 version 1, brown-out reset function doesn't work (see ESP32 errata 3.4).
                    So that we must restart from interrupt.
                (2). For special workflow, the chip needs do more things instead of restarting directly. This part
                    needs to be done in callback function of interrupt.

    endmenu

endmenu
```

## components/esp_hw_support/power_supply/port/esp32p4/Kconfig.power
```kconfig
menu "Power Supplier"

    menu "Brownout Detector"

        config ESP_BROWNOUT_DET
            bool "Hardware brownout detect & reset"
            depends on !IDF_ENV_FPGA
            default y
            help
                The ESP32-P4 has a built-in brownout detector which can detect if the voltage is lower than
                a specific value. If this happens, it will reset the chip in order to prevent unintended
                behaviour.

        choice ESP_BROWNOUT_DET_LVL_SEL
            prompt "Brownout voltage level"
            default ESP_BROWNOUT_DET_LVL_SEL_7
            depends on ESP_BROWNOUT_DET
            help
                The brownout detector will reset the chip when the supply voltage is approximately
                below this level. Note that there may be some variation of brownout voltage level
                between each chip.

                Please note that this config is only valid when P4 SOC version is above v1.0. When you are using a
                earlier P4 SOC version (v0.x), the brownout value should be fixed around 2.52V and not configurable.

                #The voltage levels here are estimates, more work needs to be done to figure out the exact voltages
                #of the brownout threshold levels.

            config ESP_BROWNOUT_DET_LVL_SEL_7
                bool "2.6V"
            config ESP_BROWNOUT_DET_LVL_SEL_6
                bool "2.52V"
            config ESP_BROWNOUT_DET_LVL_SEL_5
                bool "2.42V"
        endchoice

        config ESP_BROWNOUT_DET_LVL
            int
            default 5 if ESP_BROWNOUT_DET_LVL_SEL_5
            default 6 if ESP_BROWNOUT_DET_LVL_SEL_6
            default 7 if ESP_BROWNOUT_DET_LVL_SEL_7

        config ESP_BROWNOUT_USE_INTR
            bool
            default n
            help
                This config allows to trigger an interrupt when brownout detected. Software restart will be done
                at the end of the default callback.
                This is because for some special workflow, the chip needs do more things when brownout happens
                before restart instead of restarting directly. This part needs to be done in callback function
                of interrupt.

    endmenu

    menu "RTC Backup Battery"

        config ESP_VBAT_INIT_AUTO
            bool "Enable VBAT power supply for RTC battery"
            default n
            depends on SOC_VBAT_SUPPORTED
            help
                Enable this option to allow the use of a button cell battery to power the RTC (Real-Time Clock) domain.
                When this option is enabled, the hardware will configure VBAT as the power supply source for the RTC.

                - Ensure a compatible battery (2.5V ~ 3.6V) is connected to the VBAT pin.
                - The VBAT battery provides power to retain RTC state and keep low-power peripherals active
                    during deep sleep.
                - When this option is disabled, the RTC battery input (VBAT) must not be left floating.

        config ESP_VBAT_ISR_CACHE_SAFE
            bool "VBAT ISR IRAM-Safe"
            default y
            depends on SOC_VBAT_SUPPORTED && ESP_VBAT_INIT_AUTO
            help
                Ensure the VBAT interrupt is IRAM-Safe by allowing the interrupt handler to be
                executable when the cache is disabled (e.g. SPI Flash write).

        config ESP_VBAT_USE_RECHARGEABLE_BATTERY
            bool "The battery for RTC battery is a rechargeable battery"
            default n
            depends on ESP_VBAT_INIT_AUTO
            help
                Select this option if the RTC backup battery used in your design is a rechargeable battery.

                When enabled, the system will configure the RTC battery management circuitry to operate
                in a mode suitable for charging a rechargeable battery. This includes enabling
                charging current regulation via resistor and voltage monitoring to ensure safe and efficient charging.

                Use this option carefully to avoid damage to non-rechargeable batteries.

        choice ESP_VBAT_DET_LVL_LOW_SEL
            prompt "VBAT start charging voltage level (P4 revision < v3.0)"
            default ESP_VBAT_DET_LVL_LOW_SEL_6
            depends on ESP_VBAT_USE_RECHARGEABLE_BATTERY && ESP32P4_SELECTS_REV_LESS_V3
            help
                The brownout detector will start charging when the supply voltage drops below the selected threshold.
                This ensures that the power supply is maintained at a stable level.

            config ESP_VBAT_DET_LVL_LOW_SEL_7
                bool "2.6V"
            config ESP_VBAT_DET_LVL_LOW_SEL_6
                bool "2.52V"
            config ESP_VBAT_DET_LVL_LOW_SEL_5
                bool "2.42V"
        endchoice

        choice ESP_VBAT_DET_LVL_LOW_SEL_V3
            prompt "VBAT start charging voltage level (P4 revision >= v3.0)"
            default ESP_VBAT_DET_LVL_LOW_SEL_6_V3
            depends on ESP_VBAT_USE_RECHARGEABLE_BATTERY && !ESP32P4_SELECTS_REV_LESS_V3
            help
                The brownout detector will start charging when the supply voltage drops below the selected threshold.
                This ensures that the power supply is maintained at a stable level.

            config ESP_VBAT_DET_LVL_LOW_SEL_7_V3
                bool "2.84V"
            config ESP_VBAT_DET_LVL_LOW_SEL_6_V3
                bool "2.74V"
            config ESP_VBAT_DET_LVL_LOW_SEL_5_V3
                bool "2.64V"
        endchoice

        choice ESP_VBAT_DET_LVL_HIGH_SEL
            prompt "VBAT stop charging voltage level (P4 revision < v3.0)"
            default ESP_VBAT_DET_LVL_HIGH_SEL_7
            depends on ESP_VBAT_USE_RECHARGEABLE_BATTERY && ESP32P4_SELECTS_REV_LESS_V3
            help
                The brownout detector will stop charging when the supply voltage arrives the selected threshold.

            config ESP_VBAT_DET_LVL_HIGH_SEL_7
                bool "2.6V"
            config ESP_VBAT_DET_LVL_HIGH_SEL_6
                bool "2.52V"
            config ESP_VBAT_DET_LVL_HIGH_SEL_5
                bool "2.42V"
        endchoice

        choice ESP_VBAT_DET_LVL_HIGH_SEL_V3
            prompt "VBAT stop charging voltage level (P4 revision >= v3.0)"
            default ESP_VBAT_DET_LVL_HIGH_SEL_7_V3
            depends on ESP_VBAT_USE_RECHARGEABLE_BATTERY && !ESP32P4_SELECTS_REV_LESS_V3
            help
                The brownout detector will stop charging when the supply voltage arrives the selected threshold.

            config ESP_VBAT_DET_LVL_HIGH_SEL_7_V3
                bool "2.84V"
            config ESP_VBAT_DET_LVL_HIGH_SEL_6_V3
                bool "2.74V"
            config ESP_VBAT_DET_LVL_HIGH_SEL_5_V3
                bool "2.64V"
        endchoice

        choice ESP_VBAT_BROWNOUT_DET_LVL_SEL
            prompt "VBAT brownout voltage level"
            default ESP_VBAT_BROWNOUT_DET_LVL_SEL_5
            depends on ESP_VBAT_INIT_AUTO
            help
                The brownout detector will git a brownout signal when vbat brownout detected.

            config ESP_VBAT_BROWNOUT_DET_LVL_SEL_7
                bool "2.6V"
            config ESP_VBAT_BROWNOUT_DET_LVL_SEL_6
                bool "2.52V"
            config ESP_VBAT_BROWNOUT_DET_LVL_SEL_5
                bool "2.42V"
        endchoice

        config ESP_VBAT_WAKEUP_CHIP_ON_VBAT_BROWNOUT
            bool "Wake up chip in deepsleep if VBAT brownout"
            depends on !ESP_VBAT_USE_RECHARGEABLE_BATTERY
            default n
            help
                Wake up the chip if the vbat voltage drops below the brownout voltage during deepsleep.

        config ESP_VBAT_DET_LVL_LOW
            int
            depends on ESP_VBAT_USE_RECHARGEABLE_BATTERY
            default 5 if ESP_VBAT_DET_LVL_LOW_SEL_5 || ESP_VBAT_DET_LVL_LOW_SEL_5_V3
            default 6 if ESP_VBAT_DET_LVL_LOW_SEL_6 || ESP_VBAT_DET_LVL_LOW_SEL_6_V3
            default 7 if ESP_VBAT_DET_LVL_LOW_SEL_7 || ESP_VBAT_DET_LVL_LOW_SEL_7_V3

        config ESP_VBAT_DET_LVL_HIGH
            int
            depends on ESP_VBAT_USE_RECHARGEABLE_BATTERY
            default 5 if ESP_VBAT_DET_LVL_HIGH_SEL_5 || ESP_VBAT_DET_LVL_HIGH_SEL_5_V3
            default 6 if ESP_VBAT_DET_LVL_HIGH_SEL_6 || ESP_VBAT_DET_LVL_HIGH_SEL_6_V3
            default 7 if ESP_VBAT_DET_LVL_HIGH_SEL_7 || ESP_VBAT_DET_LVL_HIGH_SEL_7_V3

        config ESP_VBAT_BROWNOUT_DET_LVL
            int
            default 5 if ESP_VBAT_BROWNOUT_DET_LVL_SEL_5
            default 6 if ESP_VBAT_BROWNOUT_DET_LVL_SEL_6
            default 7 if ESP_VBAT_BROWNOUT_DET_LVL_SEL_7

        config ESP_VBAT_CHARGER_CIRCUIT_RESISTOR_VAL
            int "vbat charger circuit resistor value (ohms), should be multiple of 500"
            depends on ESP_VBAT_USE_RECHARGEABLE_BATTERY
            range 1000 8500
            default 1000
            help
                The resistor value of charger circuit.

    endmenu

endmenu
```

## components/esp_hw_support/test_apps/cpu/sdkconfig.defaults
```kconfig
# SPDX-FileCopyrightText: 2026 Espressif Systems (Shanghai) CO LTD
# SPDX-License-Identifier: CC0-1.0

CONFIG_ESP_TASK_WDT_EN=n
```

## components/esp_hw_support/test_apps/esp_hw_support_unity_tests/sdkconfig.defaults
```kconfig
CONFIG_ESP_TASK_WDT_INIT=n
CONFIG_ESP_MAIN_TASK_STACK_SIZE=8192
# set compiler optimization level
CONFIG_COMPILER_OPTIMIZATION_SIZE=y
CONFIG_BOOTLOADER_COMPILER_OPTIMIZATION_SIZE=y

# we can silent the assertion to save the binary footprint
CONFIG_COMPILER_OPTIMIZATION_ASSERTIONS_SILENT=y
```
