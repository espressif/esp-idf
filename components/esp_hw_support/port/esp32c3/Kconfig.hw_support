## components/esp_hw_support/port/esp32c3/Kconfig.hw_support
```kconfig
choice ESP32C3_REV_MIN
    prompt "Minimum Supported ESP32-C3 Revision"
    default ESP32C3_REV_MIN_3
    help
        Required minimum chip revision. ESP-IDF will check for it and
        reject to boot if the chip revision fails the check.
        This ensures the chip used will have some modifications (features, or bugfixes).

        The complied binary will only support chips above this revision,
        this will also help to reduce binary size.

    config ESP32C3_REV_MIN_0
        bool "Rev v0.0 (ECO0)"
    config ESP32C3_REV_MIN_1
        bool "Rev v0.1 (ECO1)"
    config ESP32C3_REV_MIN_2
        bool "Rev v0.2 (ECO2)"
    config ESP32C3_REV_MIN_3
        bool "Rev v0.3 (ECO3)"
    config ESP32C3_REV_MIN_4
        bool "Rev v0.4 (ECO4)"
    config ESP32C3_REV_MIN_101
        bool "Rev v1.1"
endchoice

config ESP32C3_REV_MIN_FULL
    int
    default 0 if ESP32C3_REV_MIN_0
    default 1 if ESP32C3_REV_MIN_1
    default 2 if ESP32C3_REV_MIN_2
    default 3 if ESP32C3_REV_MIN_3
    default 4 if ESP32C3_REV_MIN_4
    default 101 if ESP32C3_REV_MIN_101

config ESP_REV_MIN_FULL
    int
    default ESP32C3_REV_MIN_FULL

    #
    # MAX Revision
    #

    comment "Maximum Supported ESP32-C3 Revision (Rev v1.99)"
    # Maximum revision that IDF supports.
    # It can not be changed by user.
    # Only Espressif can change it when a new version will be supported in IDF.
    # Supports all chips starting from ESP32C3_REV_MIN_FULL to ESP32C3_REV_MAX_FULL

config ESP32C3_REV_MAX_FULL
    int
    default 199
    # keep in sync the "Maximum Supported Revision" description with this value

config ESP_REV_MAX_FULL
    int
    default ESP32C3_REV_MAX_FULL
```

## components/esp_hw_support/port/esp32c5/Kconfig.rtc
```kconfig
choice RTC_CLK_SRC
    prompt "RTC clock source"
    default RTC_CLK_SRC_INT_RC
    help
        Choose which clock is used as RTC clock source.

    config RTC_CLK_SRC_INT_RC
        bool "Internal 136 kHz RC oscillator"
    config RTC_CLK_SRC_EXT_CRYS
        bool "External 32 kHz crystal"
        select ESP_SYSTEM_RTC_EXT_XTAL
    config RTC_CLK_SRC_EXT_OSC
        bool "External 32 kHz oscillator at 32K_XP pin"
        select ESP_SYSTEM_RTC_EXT_OSC
endchoice

config RTC_CLK_CAL_CYCLES
    int "Number of cycles for RTC_SLOW_CLK calibration"
    default 3000 if RTC_CLK_SRC_EXT_CRYS || RTC_CLK_SRC_EXT_OSC
    default 1024 if RTC_CLK_SRC_INT_RC
    range 0 8190 if RTC_CLK_SRC_EXT_CRYS || RTC_CLK_SRC_EXT_OSC
    range 0 32766 if RTC_CLK_SRC_INT_RC
    help
        When the startup code initializes RTC_SLOW_CLK, it can perform
        calibration by comparing the RTC_SLOW_CLK frequency with main XTAL
        frequency. This option sets the number of RTC_SLOW_CLK cycles measured
        by the calibration routine. Higher numbers increase calibration
        precision, which may be important for applications which spend a lot of
        time in deep sleep. Lower numbers reduce startup time.

        When this option is set to 0, clock calibration will not be performed at
        startup, and approximate clock frequencies will be assumed:

        - 136000 Hz if internal RC oscillator is used as clock source. For this use value 1024.
        - 32768 Hz if the 32k crystal oscillator is used. For this use value 3000 or more.
            In case more value will help improve the definition of the launch of the crystal.
            If the crystal could not start, it will be switched to internal RC.

choice RTC_FAST_CLK_SRC
    depends on SOC_CLK_LP_FAST_SUPPORT_XTAL
    prompt "RTC fast clock source"
    default RTC_FAST_CLK_SRC_RC_FAST
    help
        Choose which clock is used as RTC fast clock source.

        Choosing the faster 48 MHz external crystal clock (XTAL) can allow modules which depend on RTC_FAST
        to work at a higher clock frequency. With this the ULP LP-Core will run with a
        CPU frequency of 48 Mhz instead of the default 20 Mhz.

        The drawback is that the XTAL is usually powered down during sleep, as
        it draw a lot of power. Choosing this option will cause the XTAL to stay
        powered on, increasing sleep power consumption.

    config RTC_FAST_CLK_SRC_RC_FAST
        bool "20 Mhz RC Fast Clock"
    config RTC_FAST_CLK_SRC_XTAL
        bool "48 Mhz crystal (increased power consumption during sleep)"
endchoice
```

## components/esp_hw_support/port/esp32c5/Kconfig.xtal
```kconfig
choice XTAL_FREQ
    prompt "Main XTAL frequency"
    default XTAL_FREQ_AUTO
    help
        This option selects the operating frequency of the XTAL (crystal) clock used to drive the ESP target.
        The selected value MUST reflect the frequency of the given hardware.

        Note: ESP32C5 supports crystal frequencies of 40 MHz and 48 MHz. With XTAL_FREQ_AUTO option, boot
        mode together with MTMS pin, EFUSE_XTAL_48M_SEL, and EFUSE_XTAL_48M_SEL_MODE collectively control
        the crystal frequency, and record to PCR_CLK_XTAL_FREQ register field.

    config XTAL_FREQ_AUTO
        bool "Autodetect"
endchoice

# soc_xtal_freq_t enum in soc/clk_tree_defs.h lists the XTAL frequencies can be supported
# SOC_XTAL_SUPPORT_XXX in soc_caps.h lists the XTAL frequencies already supported
config XTAL_FREQ
    int
    default 0  if XTAL_FREQ_AUTO
```

## components/esp_hw_support/port/esp32c6/Kconfig.hw_support
```kconfig
choice ESP32C6_REV_MIN
    prompt "Minimum Supported ESP32-C6 Revision"
    default ESP32C6_REV_MIN_0
    help
        Required minimum chip revision. ESP-IDF will check for it and
        reject to boot if the chip revision fails the check.
        This ensures the chip used will have some modifications (features, or bugfixes).

        The complied binary will only support chips above this revision,
        this will also help to reduce binary size.

    config ESP32C6_REV_MIN_0
        bool "Rev v0.0"
    config ESP32C6_REV_MIN_1
        bool "Rev v0.1 (ECO1)"
endchoice

config ESP32C6_REV_MIN_FULL
    int
    default 0 if ESP32C6_REV_MIN_0
    default 1 if ESP32C6_REV_MIN_1

config ESP_REV_MIN_FULL
    int
    default ESP32C6_REV_MIN_FULL

    #
    # MAX Revision
    #

    comment "Maximum Supported ESP32-C6 Revision (Rev v0.99)"
    # Maximum revision that IDF supports.
    # It can not be changed by user.
    # Only Espressif can change it when a new version will be supported in IDF.
    # Supports all chips starting from ESP32C6_REV_MIN_FULL to ESP32C6_REV_MAX_FULL

config ESP32C6_REV_MAX_FULL
    int
    default 99
    # keep in sync the "Maximum Supported Revision" description with this value

config ESP_REV_MAX_FULL
    int
    default ESP32C6_REV_MAX_FULL
```

## components/esp_hw_support/port/esp32c6/Kconfig.rtc
```kconfig
choice RTC_CLK_SRC
    prompt "RTC clock source"
    default RTC_CLK_SRC_INT_RC
    help
        Choose which clock is used as RTC clock source.

    config RTC_CLK_SRC_INT_RC
        bool "Internal 136 kHz RC oscillator"
    config RTC_CLK_SRC_EXT_CRYS
        bool "External 32 kHz crystal"
        select ESP_SYSTEM_RTC_EXT_XTAL
    config RTC_CLK_SRC_EXT_OSC
        bool "External 32 kHz oscillator at 32K_XP pin"
        select ESP_SYSTEM_RTC_EXT_OSC
    config RTC_CLK_SRC_INT_RC32K
        bool "Internal 32 kHz RC oscillator (NOT RECOMMENDED TO USE, READ DOCS FIRST)"
        depends on RTC_CLK_SRC_USE_DANGEROUS_RC32K_ALLOWED
        help
            To be able to select this option, please select `RTC_CLK_SRC_USE_DANGEROUS_RC32K_ALLOWED` first.
            This option will be removed in IDF v6.0.
endchoice

config RTC_CLK_SRC_USE_DANGEROUS_RC32K_ALLOWED
    bool "Confirm to use the unrecommended 32 kHz RC oscillator (READ DOCS FIRST)"
    help
        Internal RC32K clock is unstable at extreme temperatures and is not recommended for use.

config RTC_CLK_CAL_CYCLES
    int "Number of cycles for RTC_SLOW_CLK calibration"
    default 3000 if RTC_CLK_SRC_EXT_CRYS || RTC_CLK_SRC_EXT_OSC || RTC_CLK_SRC_INT_RC32K
    default 1024 if RTC_CLK_SRC_INT_RC
    range 0 8190 if RTC_CLK_SRC_EXT_CRYS || RTC_CLK_SRC_EXT_OSC || RTC_CLK_SRC_INT_RC32K
    range 0 32766 if RTC_CLK_SRC_INT_RC
    help
        When the startup code initializes RTC_SLOW_CLK, it can perform
        calibration by comparing the RTC_SLOW_CLK frequency with main XTAL
        frequency. This option sets the number of RTC_SLOW_CLK cycles measured
        by the calibration routine. Higher numbers increase calibration
        precision, which may be important for applications which spend a lot of
        time in deep sleep. Lower numbers reduce startup time.

        When this option is set to 0, clock calibration will not be performed at
        startup, and approximate clock frequencies will be assumed:

        - 136000 Hz if internal RC oscillator is used as clock source. For this use value 1024.
        - 32768 Hz if the 32k crystal oscillator is used. For this use value 3000 or more.
            In case more value will help improve the definition of the launch of the crystal.
            If the crystal could not start, it will be switched to internal RC.
```

## components/esp_hw_support/port/esp32c61/Kconfig.hw_support
```kconfig
choice ESP32C61_REV_MIN
    prompt "Minimum Supported ESP32-C61 Revision"
    default ESP32C61_REV_MIN_100
    help
        Required minimum chip revision. ESP-IDF will check for it and
        reject to boot if the chip revision fails the check.
        This ensures the chip used will have some modifications (features, or bugfixes).

        The complied binary will only support chips above this revision,
        this will also help to reduce binary size.

    config ESP32C61_REV_MIN_100
        bool "Rev v1.0"
endchoice

config ESP32C61_REV_MIN_FULL
    int
    default 100 if ESP32C61_REV_MIN_100

config ESP_REV_MIN_FULL
    int
    default ESP32C61_REV_MIN_FULL

    #
    # MAX Revision
    #

    comment "Maximum Supported ESP32-C61 Revision (Rev v1.99)"
    # Maximum revision that IDF supports.
    # It can not be changed by user.
    # Only Espressif can change it when a new version will be supported in IDF.
    # Supports all chips starting from ESP32C61_REV_MIN_FULL to ESP32C61_REV_MAX_FULL

config ESP32C61_REV_MAX_FULL
    int
    default 199
    # keep in sync the "Maximum Supported Revision" description with this value

config ESP_REV_MAX_FULL
    int
    default ESP32C61_REV_MAX_FULL

config ESP_EFUSE_BLOCK_REV_MIN_FULL
    int "Minimum Supported ESP32-C61 eFuse Block Revision"
    default 0
    help
        Required minimum eFuse Block revision. ESP-IDF will check it at the 2nd bootloader stage
        whether the current image can work correctly for this eFuse Block revision.
        So that to avoid running an incompatible image on a SoC that contains breaking change in the eFuse Block.
        If you want to update this value to run the image that not compatible with the current eFuse Block revision,
        please contact to Espressif's business team for details:
        https://www.espressif.com.cn/en/contact-us/sales-questions

config ESP_EFUSE_BLOCK_REV_MAX_FULL
    int
    default 199
    comment "Maximum Supported ESP32-C61 eFuse Block Revision (eFuse Block Rev v0.99)"
    # The revision in the comment must correspond to the default value of ESP_EFUSE_BLOCK_REV_MAX_FULL
```

## components/esp_hw_support/port/esp32h2/Kconfig.hw_support
```kconfig
choice ESP32H2_REV_MIN
    prompt "Minimum Supported ESP32-H2 Revision"
    default ESP32H2_REV_MIN_0
    help
        Required minimum chip revision. ESP-IDF will check for it and
        reject to boot if the chip revision fails the check.
        This ensures the chip used will have some modifications (features, or bugfixes).

        The complied binary will only support chips above this revision,
        this will also help to reduce binary size.

    config ESP32H2_REV_MIN_0
        bool "Rev v0.0"
    config ESP32H2_REV_MIN_1
        bool "Rev v0.1 (ECO1)"
    config ESP32H2_REV_MIN_2
        bool "Rev v0.2 (ECO2)"
endchoice

config ESP32H2_REV_MIN_FULL
    int
    default 0 if ESP32H2_REV_MIN_0
    default 1 if ESP32H2_REV_MIN_1
    default 2 if ESP32H2_REV_MIN_2

config ESP_REV_MIN_FULL
    int
    default ESP32H2_REV_MIN_FULL

    #
    # MAX Revision
    #

    comment "Maximum Supported ESP32-H2 Revision (Rev v0.99)"
    # Maximum revision that IDF supports.
    # It can not be changed by user.
    # Only Espressif can change it when a new version will be supported in IDF.
    # Supports all chips starting from ESP32H2_REV_MIN_FULL to ESP32H2_REV_MAX_FULL

config ESP32H2_REV_MAX_FULL
    int
    default 99
    # keep in sync the "Maximum Supported Revision" description with this value

config ESP_REV_MAX_FULL
    int
    default ESP32H2_REV_MAX_FULL
```

## components/esp_hw_support/port/esp32h2/Kconfig.mac
```kconfig
choice ESP32H2_UNIVERSAL_MAC_ADDRESSES
    bool "Number of universally administered (by IEEE) MAC address"
    default ESP32H2_UNIVERSAL_MAC_ADDRESSES_ONE
    help
        Configure the number of universally administered (by IEEE) MAC addresses.
        During initialization, MAC addresses for each network interface are generated or derived from a
        single base MAC address.

        ESP32-H2 provides a single universally administered MAC address in eFuse
        (MAC_FACTORY, 6 bytes) plus the MAC_EXT field used to build the IEEE 802.154
        EUI-64. Only one universal MAC address is consumed:
          - IEEE 802.154 EUI-64 is derived from the base MAC and MAC_EXT
            (base_mac[0:3] || MAC_EXT || base_mac[3:6], MAC_EXT defaults to ff:fe);
          - Bluetooth reuses the base MAC as-is. The BT offset is not applied because
            ESP32-H2 has no Wi-Fi, so no second universal MAC slot is required.

    config ESP32H2_UNIVERSAL_MAC_ADDRESSES_ONE
        bool "One"
        select ESP_MAC_UNIVERSAL_MAC_ADDRESSES_ONE
        select ESP_MAC_ADDR_UNIVERSE_IEEE802154
        select ESP_MAC_ADDR_UNIVERSE_BT
endchoice

config ESP32H2_UNIVERSAL_MAC_ADDRESSES
    int
    default 1 if ESP32H2_UNIVERSAL_MAC_ADDRESSES_ONE
```

## components/esp_hw_support/port/esp32h4/Kconfig.mac
```kconfig
choice ESP32H4_UNIVERSAL_MAC_ADDRESSES
    bool "Number of universally administered (by IEEE) MAC address"
    default ESP32H4_UNIVERSAL_MAC_ADDRESSES_ONE
    help
        Configure the number of universally administered (by IEEE) MAC addresses.
        During initialization, MAC addresses for each network interface are generated or derived from a
        single base MAC address.

    config ESP32H4_UNIVERSAL_MAC_ADDRESSES_ONE
        bool "One"
        select ESP_MAC_UNIVERSAL_MAC_ADDRESSES_ONE
        select ESP_MAC_ADDR_UNIVERSE_IEEE802154
        select ESP_MAC_ADDR_UNIVERSE_BT
endchoice

config ESP32H4_UNIVERSAL_MAC_ADDRESSES
    int
    default 1 if ESP32H4_UNIVERSAL_MAC_ADDRESSES_ONE
```

## components/esp_hw_support/port/esp32h4/Kconfig.xtal
```kconfig
choice XTAL_FREQ
    prompt "Main XTAL frequency"
    default XTAL_FREQ_32
    help
        This option selects the operating frequency of the XTAL (crystal) clock used to drive the ESP target.
        The selected value MUST reflect the frequency of the given hardware.

    config XTAL_FREQ_32
        bool "32 MHz"
endchoice

# soc_xtal_freq_t enum in soc/clk_tree_defs.h lists the XTAL frequencies can be supported
# SOC_XTAL_SUPPORT_XXX in soc_caps.h lists the XTAL frequencies already supported
config XTAL_FREQ
    int
    default 32 if XTAL_FREQ_32
```
