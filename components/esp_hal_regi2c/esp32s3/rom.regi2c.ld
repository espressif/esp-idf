/*
 * SPDX-FileCopyrightText: 2026 Espressif Systems (Shanghai) CO LTD
 *
 * SPDX-License-Identifier: Apache-2.0
 */
PROVIDE ( _regi2c_impl_read = 0x40005d48 );
PROVIDE ( _regi2c_impl_read_mask = 0x40005d54 );
PROVIDE ( _regi2c_impl_write = 0x40005d60 );
PROVIDE ( _regi2c_impl_write_mask = 0x40005d6c );
