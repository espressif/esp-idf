/*
 * SPDX-FileCopyrightText: 2026 Espressif Systems (Shanghai) CO LTD
 *
 * SPDX-License-Identifier: Apache-2.0
 */
PROVIDE ( _regi2c_impl_read = 0x40001954 );
PROVIDE ( _regi2c_impl_read_mask = 0x40001958 );
PROVIDE ( _regi2c_impl_write = 0x4000195c );
PROVIDE ( _regi2c_impl_write_mask = 0x40001960 );
