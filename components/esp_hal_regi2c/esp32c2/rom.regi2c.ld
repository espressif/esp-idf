/*
 * SPDX-FileCopyrightText: 2026 Espressif Systems (Shanghai) CO LTD
 *
 * SPDX-License-Identifier: Apache-2.0
 */
PROVIDE ( _regi2c_impl_read = 0x400022ec );
PROVIDE ( _regi2c_impl_read_mask = 0x400022f8 );
PROVIDE ( _regi2c_impl_write = 0x400022f4 );
PROVIDE ( _regi2c_impl_write_mask = 0x400022fc );
