/*
 * SPDX-FileCopyrightText: 2026 Espressif Systems (Shanghai) CO LTD
 *
 * SPDX-License-Identifier: Apache-2.0
 */
PROVIDE ( _regi2c_impl_read = 0x40004148 );
PROVIDE ( _regi2c_impl_read_mask = 0x400041c0 );
PROVIDE ( _regi2c_impl_write = 0x400041a4 );
PROVIDE ( _regi2c_impl_write_mask = 0x400041fc );
