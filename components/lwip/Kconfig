## components/lwip/test_apps/sdkconfig.defaults
```kconfig
CONFIG_UNITY_ENABLE_FIXTURE=y
CONFIG_UNITY_ENABLE_IDF_TEST_RUNNER=n

# Added to enable compilation of DHCP last IP restore feature
CONFIG_LWIP_DHCP_RESTORE_LAST_IP=y
```

## components/mbedtls/test_apps/mbedtls_ut/main/Kconfig.projbuild
```kconfig
menu "MbedTLS Test Configuration"

    config MBEDTLS_TEST_HMAC_OPAQUE_EFUSE_KEY
        bool "Enable HMAC opaque driver test with eFuse key"
        default n
        depends on SOC_HMAC_SUPPORTED
        help
            Enable test cases for the PSA HMAC opaque driver using an HMAC key
            burned in eFuse. Requires the test runner to have an HMAC_UP key
            provisioned in the configured eFuse block.

    config MBEDTLS_TEST_HMAC_OPAQUE_EFUSE_KEY_ID
        int "eFuse key block ID for HMAC opaque test"
        depends on MBEDTLS_TEST_HMAC_OPAQUE_EFUSE_KEY
        range -1 5
        default -1
        help
            The eFuse key block index (offset from EFUSE_BLK_KEY0) that contains
            the HMAC_UP key for opaque driver testing.

endmenu
```

## components/mbedtls/test_apps/persistent_storage_format/sdkconfig.defaults
```kconfig
CONFIG_PARTITION_TABLE_CUSTOM=y
CONFIG_PARTITION_TABLE_CUSTOM_FILENAME="partitions.csv"
CONFIG_PARTITION_TABLE_OFFSET=0x9000

# NVS encryption disabled — fixture images are committed as plaintext NVS
# bytes so they're portable across devices. With CONFIG_NVS_ENCRYPTION=y the
# bootloader auto-routes through nvs_sec_provider which requires an eFuse
# HMAC key; that's outside the scope of these format-stability tests.
CONFIG_NVS_ENCRYPTION=n

# Common build sanity options (mirrored from mbedtls_ut)
CONFIG_HEAP_POISONING_COMPREHENSIVE=y
CONFIG_COMPILER_WARN_WRITE_STRINGS=y
CONFIG_BOOTLOADER_LOG_LEVEL_WARN=y
CONFIG_FREERTOS_WATCHPOINT_END_OF_STACK=y
CONFIG_COMPILER_STACK_CHECK_MODE_STRONG=y
CONFIG_COMPILER_STACK_CHECK=y
CONFIG_ESP_TASK_WDT_EN=y
CONFIG_ESP_TASK_WDT_INIT=n
```

## components/mbedtls/test_apps/sdkconfig.defaults.esp32
```kconfig
CONFIG_ESP_DEFAULT_CPU_FREQ_MHZ_240=y
CONFIG_XTAL_FREQ_AUTO=y
CONFIG_SPI_FLASH_SHARE_SPI1_BUS=y
CONFIG_COMPILER_OPTIMIZATION_SIZE=y
```

## components/mdns/Kconfig
```kconfig
menu "mDNS"

    config MDNS_MAX_INTERFACES
        int "Max number of interfaces"
        range 1 9
        default 3
        help
            Number of network interfaces to be served by the mdns library.
            Lowering this number helps to reduce some static RAM usage.

    config MDNS_MAX_SERVICES
        int "Max number of services"
        range 1 64
        default 10
        help
            Services take up a certain amount of memory, and allowing fewer
            services to be open at the same time conserves memory. Specify
            the maximum amount of services here. The valid value is from 1
            to 64.

    config MDNS_TASK_PRIORITY
        int "mDNS task priority"
        range 1 255
        default 1
        help
            Allows setting mDNS task priority. Please do not set the task priority
            higher than priorities of system tasks. Compile time warning/error
            would be emitted if the chosen task priority were too high.

    config MDNS_TASK_STACK_SIZE
        int "mDNS task stack size"
        default 4096
        help
            Allows setting mDNS task stacksize.

    choice MDNS_TASK_AFFINITY
        prompt "mDNS task affinity"
        default MDNS_TASK_AFFINITY_CPU0
        help
            Allows setting mDNS tasks affinity, i.e. whether the task is pinned to
            CPU0, pinned to CPU1, or allowed to run on any CPU.

        config MDNS_TASK_AFFINITY_NO_AFFINITY
            bool "No affinity"
        config MDNS_TASK_AFFINITY_CPU0
            bool "CPU0"
        config MDNS_TASK_AFFINITY_CPU1
            bool "CPU1"
            depends on !FREERTOS_UNICORE

    endchoice

    config MDNS_TASK_AFFINITY
        hex
        default FREERTOS_NO_AFFINITY if MDNS_TASK_AFFINITY_NO_AFFINITY
        default 0x0 if MDNS_TASK_AFFINITY_CPU0
        default 0x1 if MDNS_TASK_AFFINITY_CPU1

    config MDNS_SERVICE_ADD_TIMEOUT_MS
        int "mDNS adding service timeout (ms)"
        range 10 30000
        default 2000
        help
            Configures timeout for adding a new mDNS service. Adding a service
            fails if could not be completed within this time.

    config MDNS_STRICT_MODE
        bool "mDNS strict mode"
        default "n"
        help
            Configures strict mode. Set this to 1 for the mDNS library to strictly follow the RFC6762:
            Currently the only strict feature: Do not repeat original questions in response packets
            (defined in RFC6762 sec. 6).
            Default configuration is 0, i.e. non-strict mode, since some implementations,
            such as lwIP mdns resolver (used by standard POSIX API like getaddrinfo, gethostbyname)
            could not correctly resolve advertised names.

    config MDNS_TIMER_PERIOD_MS
        int "mDNS timer period (ms)"
        range 10 10000
        default 100
        help
            Configures period of mDNS timer, which periodically transmits packets
            and schedules mDNS searches.

    config MDNS_NETWORKING_SOCKET
        bool "Use BSD sockets for mdns networking"
        default n
        help
            Enables optional mdns networking implementation using BSD sockets
            in UDP multicast mode.
            This option creates a new thread to serve receiving packets (TODO).
            This option uses additional N sockets, where N is number of interfaces.

    config MDNS_MULTIPLE_INSTANCE
        bool "Multiple instances under the same service type"
        default y
        help
            Enables adding multiple service instances under the same service type.

    menu "MDNS Predefined interfaces"

        config MDNS_PREDEF_NETIF_STA
            bool "Use predefined interface for WiFi Station"
            default y
            help
                Set up mdns for the default WiFi station.
                Disable this option if you do not need mDNS on default WiFi STA.

        config MDNS_PREDEF_NETIF_AP
            bool "Use predefined interface for WiFi Access Point"
            default y
            help
                Set up mdns for the default WiFi Access Point.
                Disable this option if you do not need mDNS on default WiFi AP.

        config MDNS_PREDEF_NETIF_ETH
            bool "Use predefined interface for Ethernet"
            default y
            help
                Set up mdns for the default Ethernet interface.
                Disable this option if you do not need mDNS on default Ethernet.

    endmenu # MDNS Predefined interfaces

endmenu
```

## components/mdns/host_test/components/esp_netif_linux/Kconfig
```kconfig
menu "LWIP-MOCK-CONFIG"

    config LWIP_IPV6
        bool "Enable IPv6"
        default y
        help
            Enable/disable IPv6

endmenu
```

## components/mdns/host_test/components/freertos_linux/Kconfig
```kconfig
menu "FreeRTOS"

    config FREERTOS_NO_AFFINITY
        hex
        default 0x7FFFFFFF

endmenu
```

## components/mqtt/Kconfig
```kconfig
menu "ESP-MQTT Configurations"

    config MQTT_PROTOCOL_311
        bool "Enable MQTT protocol 3.1.1"
        default y
        help
            If not, this library will use MQTT protocol 3.1

    config MQTT_PROTOCOL_5
        bool "Enable MQTT protocol 5.0"
        default n
        help
            If not, this library will not support MQTT 5.0

    config MQTT_TRANSPORT_SSL
        bool "Enable MQTT over SSL"
        default y
        help
            Enable MQTT transport over SSL with mbedtls

    config MQTT_TRANSPORT_WEBSOCKET
        bool "Enable MQTT over Websocket"
        default y
        depends on WS_TRANSPORT
        help
            Enable MQTT transport over Websocket.

    config MQTT_TRANSPORT_WEBSOCKET_SECURE
        bool "Enable MQTT over Websocket Secure"
        default y
        depends on MQTT_TRANSPORT_WEBSOCKET
        depends on MQTT_TRANSPORT_SSL
        help
            Enable MQTT transport over Websocket Secure.

    config MQTT_MSG_ID_INCREMENTAL
        bool "Use Incremental Message Id"
        default n
        help
            Set this to true for the message id (2.3.1 Packet Identifier) to be generated
            as an incremental number rather then a random value (used by default)

    config MQTT_SKIP_PUBLISH_IF_DISCONNECTED
        bool "Skip publish if disconnected"
        default n
        help
            Set this to true to avoid publishing (enqueueing messages) if the client is disconnected.
            The MQTT client tries to publish all messages by default, even in the disconnected state
            (where the qos1 and qos2 packets are stored in the internal outbox to be published later)
            The MQTT_SKIP_PUBLISH_IF_DISCONNECTED option allows applications to override this behaviour
            and not enqueue publish packets in the disconnected state.

    config MQTT_REPORT_DELETED_MESSAGES
        bool "Report deleted messages"
        default n
        help
            Set this to true to post events for all messages which were deleted from the outbox
            before being correctly sent and confirmed.

    config MQTT_USE_CUSTOM_CONFIG
        bool "MQTT Using custom configurations"
        default n
        help
            Custom MQTT configurations.

    config MQTT_TCP_DEFAULT_PORT
        int "Default MQTT over TCP port"
        default 1883
        depends on MQTT_USE_CUSTOM_CONFIG
        help
            Default MQTT over TCP port

    config MQTT_SSL_DEFAULT_PORT
        int "Default MQTT over SSL port"
        default 8883
        depends on MQTT_USE_CUSTOM_CONFIG
        depends on MQTT_TRANSPORT_SSL
        help
            Default MQTT over SSL port

    config MQTT_WS_DEFAULT_PORT
        int "Default MQTT over Websocket port"
        default 80
        depends on MQTT_USE_CUSTOM_CONFIG
        depends on MQTT_TRANSPORT_WEBSOCKET
        help
            Default MQTT over Websocket port

    config MQTT_WSS_DEFAULT_PORT
        int "Default MQTT over Websocket Secure port"
        default 443
        depends on MQTT_USE_CUSTOM_CONFIG
        depends on MQTT_TRANSPORT_WEBSOCKET
        depends on MQTT_TRANSPORT_WEBSOCKET_SECURE
        help
            Default MQTT over Websocket Secure port

    config MQTT_BUFFER_SIZE
        int "Default MQTT Buffer Size"
        default 1024
        depends on MQTT_USE_CUSTOM_CONFIG
        help
            This buffer size using for both transmit and receive

    config MQTT_TASK_STACK_SIZE
        int "MQTT task stack size"
        default 6144
        depends on MQTT_USE_CUSTOM_CONFIG
        help
            MQTT task stack size

    config MQTT_DISABLE_API_LOCKS
        bool "Disable API locks"
        default n
        depends on MQTT_USE_CUSTOM_CONFIG
        help
            Default config employs API locks to protect internal structures. It is possible to disable
            these locks if the user code doesn't access MQTT API from multiple concurrent tasks

    config MQTT_TASK_PRIORITY
        int "MQTT task priority"
        default 5
        depends on MQTT_USE_CUSTOM_CONFIG
        help
            MQTT task priority. Higher number denotes higher priority.

    config MQTT_TASK_CORE_SELECTION_ENABLED
        bool "Enable MQTT task core selection"
        help
            This will enable core selection

    choice MQTT_TASK_CORE_SELECTION
        depends on MQTT_TASK_CORE_SELECTION_ENABLED
        prompt "Core to use ?"
        config MQTT_USE_CORE_0
            bool "Core 0"
        config MQTT_USE_CORE_1
            bool "Core 1"
    endchoice

    config MQTT_CUSTOM_OUTBOX
        bool "Enable custom outbox implementation"
        default n
        help
            Set to true if a specific implementation of message outbox is needed (e.g. persistent outbox in NVM or
            similar).
            Note: Implementation of the custom outbox must be added to the mqtt component. These CMake commands
            could be used to append the custom implementation to lib-mqtt sources:
            idf_component_get_property(mqtt mqtt COMPONENT_LIB)
            set_property(TARGET ${mqtt} PROPERTY SOURCES ${PROJECT_DIR}/custom_outbox.c APPEND)

    config MQTT_OUTBOX_EXPIRED_TIMEOUT_MS
        int "Outbox message expired timeout[ms]"
        default 30000
        depends on MQTT_USE_CUSTOM_CONFIG
        help
            Messages which stays in the outbox longer than this value before being published will be discarded.

endmenu
```

## components/mqtt/host_test/sdkconfig.defaults
```kconfig
CONFIG_IDF_TARGET="linux"
CONFIG_COMPILER_CXX_EXCEPTIONS=y
CONFIG_COMPILER_CXX_RTTI=y
CONFIG_COMPILER_CXX_EXCEPTIONS_EMG_POOL_SIZE=0
CONFIG_COMPILER_STACK_CHECK_NONE=y
CONFIG_UNITY_ENABLE_IDF_TEST_RUNNER=n
```

## components/mqtt/test/Kconfig
```kconfig
menu "ESP-MQTT Unit Test Config"

    config MQTT_TEST_BROKER_URI
        string "URI of the test broker"
        default "mqtt://mqtt.eclipseprojects.io"
        help
            URL of an mqtt broker which this test connects to.

    config MQTT5_TEST_BROKER_URI
        string "URI of the test broker"
        default "mqtt://mqtt.eclipseprojects.io"
        help
            URL of an mqtt broker which this test connects to.
endmenu
```

## components/mqtt/test_apps/test_mqtt/sdkconfig.defaults
```kconfig
# General options for additional checks
CONFIG_ESP_TASK_WDT_EN=n
CONFIG_UNITY_ENABLE_FIXTURE=y
```

## components/mqtt/test_apps/test_mqtt5/sdkconfig.defaults
```kconfig
# General options for additional checks
CONFIG_ESP_TASK_WDT_EN=n
CONFIG_MQTT_PROTOCOL_5=y
CONFIG_UNITY_ENABLE_FIXTURE=y
```
