## components/esp32h2/Kconfig
```kconfig
menu "ESP32H2-Specific"
    visible if IDF_TARGET_ESP32H2

    choice ESP32H2_DEFAULT_CPU_FREQ_MHZ
        prompt "CPU frequency"
        default ESP32H2_DEFAULT_CPU_FREQ_64 if IDF_ENV_FPGA
        default ESP32H2_DEFAULT_CPU_FREQ_96 if !IDF_ENV_FPGA
        help
            CPU frequency to be set on application startup.

        config ESP32H2_DEFAULT_CPU_FREQ_16
            bool "16 MHz"
            depends on IDF_ENV_FPGA     #ESP32H2-TODO: IDF-3786
        config ESP32H2_DEFAULT_CPU_FREQ_32
            bool "32 MHz"
            depends on IDF_ENV_FPGA     #ESP32H2-TODO: IDF-3786
        config ESP32H2_DEFAULT_CPU_FREQ_64
            bool "64 MHz"
            depends on IDF_ENV_FPGA     #ESP32H2-TODO: IDF-3786
        config ESP32H2_DEFAULT_CPU_FREQ_96
            bool "96 MHz"
            depends on !IDF_ENV_FPGA
    endchoice

    config ESP32H2_DEFAULT_CPU_FREQ_MHZ
        int
        default 16 if ESP32H2_DEFAULT_CPU_FREQ_16
        default 32 if ESP32H2_DEFAULT_CPU_FREQ_32
        default 64 if ESP32H2_DEFAULT_CPU_FREQ_64
        default 96 if ESP32H2_DEFAULT_CPU_FREQ_96

    choice ESP32H2_REV_MIN
        prompt "Minimum Supported ESP32-H2 Revision"
        default ESP32H2_REV_MIN_0
        help
            Minimum revision that ESP-IDF would support.

            Only supporting higher chip revisions can reduce binary size.

        config ESP32H2_REV_MIN_0
            bool "Rev 0"
    endchoice

    config ESP32H2_REV_MIN
        int
        default 0 if ESP32H2_REV_MIN_0

    choice ESP32H2_TIME_SYSCALL
        prompt "Timers used for gettimeofday function"
        default ESP32H2_TIME_SYSCALL_USE_RTC_SYSTIMER
        help
            This setting defines which hardware timers are used to
            implement 'gettimeofday' and 'time' functions in C library.

            - If both high-resolution (systimer) and RTC timers are used, timekeeping will
              continue in deep sleep. Time will be reported at 1 microsecond
              resolution. This is the default, and the recommended option.
            - If only high-resolution timer (systimer) is used, gettimeofday will
              provide time at microsecond resolution.
              Time will not be preserved when going into deep sleep mode.
            - If only RTC timer is used, timekeeping will continue in
              deep sleep, but time will be measured at 6.(6) microsecond
              resolution. Also the gettimeofday function itself may take
              longer to run.
            - If no timers are used, gettimeofday and time functions
              return -1 and set errno to ENOSYS.
            - When RTC is used for timekeeping, two RTC_STORE registers are
              used to keep time in deep sleep mode.

        config ESP32H2_TIME_SYSCALL_USE_RTC_SYSTIMER
            bool "RTC and high-resolution timer"
            select ESP_TIME_FUNCS_USE_RTC_TIMER
            select ESP_TIME_FUNCS_USE_ESP_TIMER
        config ESP32H2_TIME_SYSCALL_USE_RTC
            bool "RTC"
            select ESP_TIME_FUNCS_USE_RTC_TIMER
        config ESP32H2_TIME_SYSCALL_USE_SYSTIMER
            bool "High-resolution timer"
            select ESP_TIME_FUNCS_USE_ESP_TIMER
        config ESP32H2_TIME_SYSCALL_USE_NONE
            bool "None"
            select ESP_TIME_FUNCS_USE_NONE
    endchoice

    choice ESP32H2_RTC_CLK_SRC
        prompt "RTC clock source"
        default ESP32H2_RTC_CLK_SRC_INT_RC
        help
            Choose which clock is used as RTC clock source.

        config ESP32H2_RTC_CLK_SRC_INT_RC
            bool "Internal 150kHz RC oscillator"
        config ESP32H2_RTC_CLK_SRC_EXT_CRYS
            bool "External 32.768kHz crystal"
            select ESP_SYSTEM_RTC_EXT_XTAL
        config ESP32H2_RTC_CLK_SRC_EXT_OSC
            bool "External 32kHz oscillator at 32K_XP pin"
            select ESP_SYSTEM_RTC_EXT_OSC
        config ESP32H2_RTC_CLK_SRC_INT_8MD256
            bool "Internal 8MHz oscillator, divided by 256 (~32kHz)"
    endchoice

    config ESP32H2_RTC_CLK_CAL_CYCLES
        int "Number of cycles for RTC_SLOW_CLK calibration"
        default 3000 if ESP32H2_RTC_CLK_SRC_EXT_CRYS || ESP32H2_RTC_CLK_SRC_EXT_OSC || ESP32H2_RTC_CLK_SRC_INT_8MD256
        default 576 if ESP32H2_RTC_CLK_SRC_INT_RC
        range 0 125000
        help
            When the startup code initializes RTC_SLOW_CLK, it can perform
            calibration by comparing the RTC_SLOW_CLK frequency with main XTAL
            frequency. This option sets the number of RTC_SLOW_CLK cycles measured
            by the calibration routine. Higher numbers increase calibration
            precision, which may be important for applications which spend a lot of
            time in deep sleep. Lower numbers reduce startup time.

            When this option is set to 0, clock calibration will not be performed at
            startup, and approximate clock frequencies will be assumed:

            - 150000 Hz if internal RC oscillator is used as clock source. For this use value 1024.
            - 32768 Hz if the 32k crystal oscillator is used. For this use value 3000 or more.
              In case more value will help improve the definition of the launch of the crystal.
              If the crystal could not start, it will be switched to internal RC.

    config ESP32H2_LIGHTSLEEP_GPIO_RESET_WORKAROUND
        bool "light sleep GPIO reset workaround"
        default y
        select PM_SLP_DISABLE_GPIO if FREERTOS_USE_TICKLESS_IDLE
        help
            ESP32H2 will reset at wake-up if GPIO is received a small electrostatic pulse during
            light sleep, with specific condition

            - GPIO needs to be configured as input-mode only
            - The pin receives a small electrostatic pulse, and reset occurs when the pulse
              voltage is higher than 6 V

            For GPIO set to input mode only, it is not a good practice to leave it open/floating,
            The hardware design needs to controlled it with determined supply or ground voltage
            is necessary.

            This option provides a software workaround for this issue. Configure to isolate all
            GPIO pins in sleep state.

endmenu  # ESP32H2-Specific
```
