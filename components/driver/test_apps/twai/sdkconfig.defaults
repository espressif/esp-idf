## components/driver/test_apps/twai/sdkconfig.defaults
```kconfig
CONFIG_FREERTOS_HZ=1000
CONFIG_ESP_TASK_WDT=n
# primitives for checking sleep internal state
CONFIG_ESP_SLEEP_DEBUG=y
```

## components/driver/twai/Kconfig.twai
```kconfig
menu "Legacy TWAI Driver Configurations"
    depends on SOC_TWAI_SUPPORTED

    config TWAI_ISR_IN_IRAM_LEGACY
        bool "Place TWAI ISR function in IRAM"
        default n
        help
            Place the TWAI ISR in to IRAM to reduce latency and increase performance

    config TWAI_SUPPRESS_DEPRECATE_WARN
        bool "Suppress legacy driver deprecated warning"
        default n
        help
            whether to suppress the deprecation warnings when using legacy twai driver
            (driver/twai.h). If you want to continue using the legacy driver,
            and don't want to see related deprecation warnings, you can enable this option.

    config TWAI_SKIP_LEGACY_CONFLICT_CHECK
        bool "Skip legacy driver conflict check"
        default n
        help
            This configuration option used to bypass the conflict check mechanism with legacy code.

endmenu # TWAI Configuration
```

## components/driver/uart/Kconfig.uart
```kconfig
menu "UART Configuration"

    config UART_ISR_IN_IRAM
        bool "Place UART ISR function into IRAM"
        depends on !RINGBUF_PLACE_ISR_FUNCTIONS_INTO_FLASH
        select VFS_SELECT_IN_RAM if VFS_SUPPORT_SELECT
        default n
        help
            If this option is not selected, UART interrupt will be disabled for a long time and
            may cause data lost when doing spi flash operation.

endmenu # UART Configuration
```

## components/efuse/Kconfig
```kconfig
menu "eFuse Bit Manager"

    config EFUSE_CUSTOM_TABLE
        bool "Use custom eFuse table"
        default n
        help
            Allows to generate a structure for eFuse from the CSV file.

    config EFUSE_CUSTOM_TABLE_FILENAME
        string "Custom eFuse CSV file"
        depends on EFUSE_CUSTOM_TABLE
        default "main/esp_efuse_custom_table.csv"
        help
            Name of the custom eFuse CSV filename. This path is evaluated
            relative to the project root directory.

    config EFUSE_VIRTUAL
        bool "Simulate eFuse operations in RAM"
        default n
        help
            If "n" - No virtual mode. All eFuse operations are real and use eFuse registers.
            If "y" - The virtual mode is enabled and all eFuse operations (read and write) are redirected
            to RAM instead of eFuse registers, all permanent changes (via eFuse) are disabled.
            Log output will state changes that would be applied, but they will not be.

            If it is "y", then SECURE_FLASH_ENCRYPTION_MODE_RELEASE cannot be used.
            Because the EFUSE VIRT mode is for testing only.

            During startup, the eFuses are copied into RAM. This mode is useful for fast tests.

    config EFUSE_VIRTUAL_KEEP_IN_FLASH
        bool "Keep eFuses in flash"
        depends on EFUSE_VIRTUAL
        help
            In addition to the "Simulate eFuse operations in RAM" option, this option just adds
            a feature to keep eFuses after reboots in flash memory. To use this mode the partition_table
            should have the `efuse` partition. partition.csv: "efuse_em, data, efuse,   ,   0x2000,"

            During startup, the eFuses are copied from flash or,
            in case if flash is empty, from real eFuse to RAM and then update flash.
            This mode is useful when need to keep changes after reboot
            (testing secure_boot and flash_encryption).

    config EFUSE_VIRTUAL_LOG_ALL_WRITES
        bool "Log all virtual writes"
        depends on EFUSE_VIRTUAL
        help
            If enabled, log efuse burns. This shows changes that would be made.

    choice EFUSE_CODE_SCHEME_SELECTOR
        prompt "Coding Scheme Compatibility"
        default EFUSE_CODE_SCHEME_COMPAT_3_4
        depends on IDF_TARGET_ESP32
        help
            Selector eFuse code scheme.

        config EFUSE_CODE_SCHEME_COMPAT_NONE
            bool "None Only"
        config EFUSE_CODE_SCHEME_COMPAT_3_4
            bool "3/4 and None"
        config EFUSE_CODE_SCHEME_COMPAT_REPEAT
            bool "Repeat, 3/4 and None (common table does not support it)"
    endchoice

    config EFUSE_MAX_BLK_LEN
        int
        default 256 if EFUSE_CODE_SCHEME_COMPAT_NONE
        default 192 if EFUSE_CODE_SCHEME_COMPAT_3_4
        default 128 if EFUSE_CODE_SCHEME_COMPAT_REPEAT
        default 256 if !IDF_TARGET_ESP32

endmenu
```

## components/efuse/test_apps/main/Kconfig.projbuild
```kconfig
menu "eFuse Tests"
    visible if IDF_ENV_FPGA

    config EFUSE_FPGA_TEST
        bool "Enable eFuse tests for FPGA (developers only, will PERMANENTLY burn efuses)"
        default n
        help
            This includes eFuse tests for FPGA. These tests expect actual eFuse burning.
            Disable EFUSE_VIRTUAL to use real eFuse burning.

endmenu
```

## components/esp-idf-bmx280/Kconfig
```kconfig
menu "BMX280 Options"
    choice BMX280_EXPECT_DEVICE
        prompt "Installed Sensor Model"
        help
            Set to the model of the sensor you are using (if you know it).
        default BMX280_EXPECT_DETECT
        config BMX280_EXPECT_DETECT
            bool "Auto"
        config BMX280_EXPECT_BME280
            bool "BME280"
        config BMX280_EXPECT_BMP280
            bool "BMP280"
    endchoice

    choice BMX280_ADDRESS
        prompt "I2C Slave Address"
        help
            Set the slave address of the sensor if you know it. The driver can
            automatically detect it if you don't know.
        default BMX280_ADDRESS_DETECT
        config BMX280_ADDRESS_DETECT
            bool "Auto"
        config BMX280_ADDERSS_LO
            bool "0x76 (SDO LOW)"
        config BMX280_ADDERSS_HI
            bool "0x77 (SDO HIGH)"
    endchoice

    config BMX280_TIMEOUT
        int "Read/Write Timeout"
        default 5
        help
            Number of ticks to wait for I2C read/write operations.

    menu "Default Configuration"
        choice BMX280_DEFAULT_TEMPERATURE_OVERSAMPLING
            prompt "Temperature Oversampling"
            default BMX280_DEFAULT_TEMPERATURE_OVERSAMPLING_X2
            help
                Refer to BMP280/BME280 Datasheet for more information.
            config BMX280_DEFAULT_TEMPERATURE_OVERSAMPLING_NONE
                bool "None"
            config BMX280_DEFAULT_TEMPERATURE_OVERSAMPLING_X1
                bool "x1"
            config BMX280_DEFAULT_TEMPERATURE_OVERSAMPLING_X2
                bool "x2"
            config BMX280_DEFAULT_TEMPERATURE_OVERSAMPLING_X4
                bool "x4"
            config BMX280_DEFAULT_TEMPERATURE_OVERSAMPLING_X8
                bool "x8"
            config BMX280_DEFAULT_TEMPERATURE_OVERSAMPLING_X16
                bool "x16"
        endchoice

        choice BMX280_DEFAULT_PRESSURE_OVERSAMPLING
            prompt "Pressure Oversampling"
            default BMX280_DEFAULT_PRESSURE_OVERSAMPLING_X16
            help
                Refer to BMP280/BME280 Datasheet for more information.
            config BMX280_DEFAULT_PRESSURE_OVERSAMPLING_NONE
                bool "None"
            config BMX280_DEFAULT_PRESSURE_OVERSAMPLING_X1
                bool "x1"
            config BMX280_DEFAULT_PRESSURE_OVERSAMPLING_X2
                bool "x2"
            config BMX280_DEFAULT_PRESSURE_OVERSAMPLING_X4
                bool "x4"
            config BMX280_DEFAULT_PRESSURE_OVERSAMPLING_X8
                bool "x8"
            config BMX280_DEFAULT_PRESSURE_OVERSAMPLING_X16
                bool "x16"
        endchoice

        choice BMX280_DEFAULT_STANDBY
            prompt "Cyclic Measurement Standby Time"
            default BMX280_DEFAULT_STANDBY_0M5
            help
                Refer to BMP280/BME280 Datasheet for more information.
            config BMX280_DEFAULT_STANDBY_0M5
                bool "0.5ms"
            config BMX280_DEFAULT_STANDBY_62M5
                bool "62.5ms"
            config BMX280_DEFAULT_STANDBY_125M
                bool "125ms"
            config BMX280_DEFAULT_STANDBY_250M
                bool "250ms"
            config BMX280_DEFAULT_STANDBY_500M
                bool "500ms"
            config BMX280_DEFAULT_STANDBY_1000M
                bool "1000ms"
            config BMX280_DEFAULT_STANDBY_10M
                bool "BMP280: 2000ms // BME280: 10ms"
            config BMX280_DEFAULT_STANDBY_20M
                bool "BMP280: 4000ms // BME280: 20ms"
        endchoice

        choice BMX280_DEFAULT_IIR
            prompt "IIR Filter Sensitivity"
            default BMX280_DEFAULT_IIR_X16
            help
                Refer to BMP280/BME280 Datasheet for more information.
            config BMX280_DEFAULT_IIR_NONE
                bool "Filter Off"
            config BMX280_DEFAULT_IIR_X2
                bool "x2"
            config BMX280_DEFAULT_IIR_X4
                bool "x4"
            config BMX280_DEFAULT_IIR_X8
                bool "x8"
            config BMX280_DEFAULT_IIR_X16
                bool "x16"
        endchoice

        menu "BME280 Specific Options"
            depends on !(BMX280_EXPECT_BMP280)

            choice BMX280_DEFAULT_HUMIDITY_OVERSAMPLING
                prompt "Humidity Oversampling"
                default BMX280_DEFAULT_HUMIDITY_OVERSAMPLING_X1
                help
                    Refer to BME280 Datasheet for more information.
                config BMX280_DEFAULT_HUMIDITY_OVERSAMPLING_NONE
                    bool "None"
                config BMX280_DEFAULT_HUMIDITY_OVERSAMPLING_X1
                    bool "x1"
                config BMX280_DEFAULT_HUMIDITY_OVERSAMPLING_X2
                    bool "x2"
                config BMX280_DEFAULT_HUMIDITY_OVERSAMPLING_X4
                    bool "x4"
                config BMX280_DEFAULT_HUMIDITY_OVERSAMPLING_X8
                    bool "x8"
                config BMX280_DEFAULT_HUMIDITY_OVERSAMPLING_X16
                    bool "x16"
            endchoice
        endmenu
    endmenu
endmenu
```
