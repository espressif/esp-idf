## components/soc/esp32s31/Kconfig.mmu
```kconfig
# This Config is used for configure the MMU.
# Be configured based on flash size selection.
# Invisible to users.

config MMU_PAGE_SIZE_16KB
    bool
    default y if ESPTOOLPY_FLASHSIZE_1MB
    default n

config MMU_PAGE_SIZE_32KB
    bool
    default y if ESPTOOLPY_FLASHSIZE_2MB
    default n

config MMU_PAGE_SIZE_64KB
    bool
    default y if !MMU_PAGE_SIZE_32KB && !MMU_PAGE_SIZE_16KB
    default n

config MMU_PAGE_SIZE_128KB
    bool "128KB page size"
    default n

config MMU_PAGE_SIZE_256KB
    bool "256KB page size"
    default n
```
