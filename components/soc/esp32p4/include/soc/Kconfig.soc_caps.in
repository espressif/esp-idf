## components/spi_flash/esp32/Kconfig.flash_freq
```kconfig
choice ESPTOOLPY_FLASHFREQ
    prompt "Flash SPI speed"
    default ESPTOOLPY_FLASHFREQ_40M
    config ESPTOOLPY_FLASHFREQ_80M
        bool "80 MHz"
    config ESPTOOLPY_FLASHFREQ_40M
        bool "40 MHz"
    config ESPTOOLPY_FLASHFREQ_26M
        bool "26 MHz"
    config ESPTOOLPY_FLASHFREQ_20M
        bool "20 MHz"
endchoice
```

## components/spi_flash/esp32c2/Kconfig.flash_freq
```kconfig
choice ESPTOOLPY_FLASHFREQ
    prompt "Flash SPI speed"
    default ESPTOOLPY_FLASHFREQ_60M
    config ESPTOOLPY_FLASHFREQ_60M
        bool "60 MHz"
    config ESPTOOLPY_FLASHFREQ_30M
        bool "30 MHz"
    config ESPTOOLPY_FLASHFREQ_20M
        bool "20 MHz"
    config ESPTOOLPY_FLASHFREQ_15M
        bool "15 MHz"
endchoice
```

## components/spi_flash/esp32c5/Kconfig.flash_freq
```kconfig
choice ESPTOOLPY_FLASHFREQ
    prompt "Flash SPI speed"
    default ESPTOOLPY_FLASHFREQ_80M
    config ESPTOOLPY_FLASHFREQ_120M
        bool "120 MHz"
    config ESPTOOLPY_FLASHFREQ_80M
        bool "80 MHz"
    config ESPTOOLPY_FLASHFREQ_40M
        bool "40 MHz"
    config ESPTOOLPY_FLASHFREQ_20M
        bool "20 MHz"
endchoice
```

## components/spi_flash/esp32h2/Kconfig.flash_freq
```kconfig
choice ESPTOOLPY_FLASHFREQ
    prompt "Flash SPI speed"
    default ESPTOOLPY_FLASHFREQ_64M
    config ESPTOOLPY_FLASHFREQ_64M
        bool "64 MHz"
    config ESPTOOLPY_FLASHFREQ_32M
        bool "32 MHz"
    config ESPTOOLPY_FLASHFREQ_16M
        bool "16 MHz"
endchoice
```

## components/spi_flash/esp32h21/Kconfig.flash_freq
```kconfig
choice ESPTOOLPY_FLASHFREQ
    prompt "Flash SPI speed"
    default ESPTOOLPY_FLASHFREQ_32M if IDF_ENV_FPGA
    default ESPTOOLPY_FLASHFREQ_48M
    config ESPTOOLPY_FLASHFREQ_48M
        bool "48 MHz"
    config ESPTOOLPY_FLASHFREQ_32M
        bool "32 MHz"
        depends on IDF_ENV_FPGA
    config ESPTOOLPY_FLASHFREQ_24M
        bool "24 MHz"
endchoice
```

## components/spi_flash/esp32h4/Kconfig.flash_freq
```kconfig
choice ESPTOOLPY_FLASHFREQ
    prompt "Flash SPI speed"
    default ESPTOOLPY_FLASHFREQ_32M if IDF_ENV_FPGA
    default ESPTOOLPY_FLASHFREQ_64M
    config ESPTOOLPY_FLASHFREQ_64M
        bool "64 MHz"
    config ESPTOOLPY_FLASHFREQ_32M
        bool "32 MHz"
endchoice
```

## components/spi_flash/esp32p4/Kconfig.flash_freq
```kconfig
choice ESPTOOLPY_FLASHFREQ
    prompt "Flash SPI speed"
    default ESPTOOLPY_FLASHFREQ_40M if ESP32P4_REV_MIN_0
    default ESPTOOLPY_FLASHFREQ_80M
    config ESPTOOLPY_FLASHFREQ_80M
        bool "80 MHz"
        depends on !ESP32P4_REV_MIN_0
    config ESPTOOLPY_FLASHFREQ_40M
        bool "40 MHz"
    config ESPTOOLPY_FLASHFREQ_20M
        bool "20 MHz"
endchoice

config ESPTOOLPY_FLASHFREQ_VAL
    int
    default 20 if ESPTOOLPY_FLASHFREQ_20M
    default 40 if ESPTOOLPY_FLASHFREQ_40M
    default 80 if ESPTOOLPY_FLASHFREQ_80M
    default 120 if ESPTOOLPY_FLASHFREQ_120M
```

## components/spi_flash/esp32s3/Kconfig.flash_freq
```kconfig
choice ESPTOOLPY_FLASHFREQ
    prompt "Flash SPI speed"
    default ESPTOOLPY_FLASHFREQ_80M
    config ESPTOOLPY_FLASHFREQ_120M
        bool "120 MHz (READ DOCS FIRST)"
        depends on (SPI_FLASH_HPM_ON || ESPTOOLPY_OCT_FLASH) && \
            (ESPTOOLPY_FLASH_SAMPLE_MODE_STR || IDF_EXPERIMENTAL_FEATURES)
        help
            - Optional feature for QSPI Flash. Read docs and enable `CONFIG_SPI_FLASH_HPM_ENA` first!
            - Flash 120 MHz SDR mode is stable.
            - Flash 120 MHz DDR mode is an experimental feature, it works when
              the temperature is stable.

              Risks:
              If your chip powers on at a certain temperature, then after the temperature
              increases or decreases by approximately 20 Celsius degrees (depending on the
              chip), the program will crash randomly.
    config ESPTOOLPY_FLASHFREQ_80M
        bool "80 MHz"
    config ESPTOOLPY_FLASHFREQ_40M
        bool "40 MHz"
    config ESPTOOLPY_FLASHFREQ_20M
        bool "20 MHz"
endchoice
```

## components/spi_flash/host_test/partition_api_test/sdkconfig.defaults
```kconfig
# Defaults for generating a new "sdkconfig" file (project settings).
# https://docs.espressif.com/projects/esp-idf/en/latest/esp32/api-guides/build-system.html#custom-sdkconfig-defaults
#
# NOTE - if this file changes, to get new defaults, you must erase any existing
# "sdkconfig" file (this will undo manual settings from "idf.py menuconfig").

CONFIG_IDF_TARGET="linux"
CONFIG_COMPILER_CXX_EXCEPTIONS=y
CONFIG_UNITY_ENABLE_IDF_TEST_RUNNER=n
CONFIG_PARTITION_TABLE_CUSTOM=y
CONFIG_PARTITION_TABLE_CUSTOM_FILENAME="partition_table.csv"
CONFIG_ESPTOOLPY_FLASHSIZE="4MB"
CONFIG_ESPTOOLPY_FLASHSIZE_4MB=y
```

## components/spi_flash/test_apps/esp_flash_stress/sdkconfig.defaults
```kconfig
CONFIG_ESP_TASK_WDT_EN=n
CONFIG_PARTITION_TABLE_CUSTOM=y
CONFIG_PARTITION_TABLE_CUSTOM_FILENAME="partitions.csv"
CONFIG_PARTITION_TABLE_FILENAME="partitions.csv"
```

## components/spi_flash/test_apps/flash_encryption/sdkconfig.defaults
```kconfig
CONFIG_ESP_TASK_WDT_EN=n
CONFIG_PARTITION_TABLE_CUSTOM=y
CONFIG_PARTITION_TABLE_CUSTOM_FILENAME="partitions.csv"
CONFIG_SECURE_FLASH_ENC_ENABLED=y
CONFIG_SECURE_FLASH_ENCRYPTION_MODE_DEVELOPMENT=y
CONFIG_SECURE_BOOT_ALLOW_ROM_BASIC=y
CONFIG_SECURE_BOOT_ALLOW_JTAG=y
CONFIG_SECURE_FLASH_UART_BOOTLOADER_ALLOW_ENC=y
CONFIG_SECURE_FLASH_UART_BOOTLOADER_ALLOW_DEC=y
CONFIG_SECURE_FLASH_UART_BOOTLOADER_ALLOW_CACHE=y
CONFIG_SECURE_FLASH_REQUIRE_ALREADY_ENABLED=y
```

## components/spi_flash/test_apps/flash_suspend/sdkconfig.defaults
```kconfig
CONFIG_ESP_TASK_WDT_EN=n
CONFIG_SPI_FLASH_AUTO_SUSPEND=y
CONFIG_PARTITION_TABLE_CUSTOM=y
CONFIG_PARTITION_TABLE_CUSTOM_FILENAME="partitions.csv"
# Now the runners are massively using xmc-c chips, to be removed when xmc-d goes massive production.
CONFIG_SPI_FLASH_FORCE_ENABLE_XMC_C_SUSPEND=y
```

## components/spi_flash/test_apps/mspi_test/sdkconfig.defaults
```kconfig
CONFIG_ESP_TASK_WDT_EN=n
CONFIG_PARTITION_TABLE_CUSTOM=y
CONFIG_PARTITION_TABLE_CUSTOM_FILENAME="partitions.csv"
CONFIG_ESP_SYSTEM_MEMPROT_FEATURE=n
```

## components/spi_nand_flash/Kconfig
```kconfig
menu "SPI Nand Flash driver"

    config SPI_FLASH_NAND_ENABLED
        bool "Enable the Nand Flash driver"
        default y
        help
            If this option is enabled, the NAND driver is included

endmenu
```
