## components/bt/common/ble_log/test_apps/ble_log_usb_test/sdkconfig.defaults
```kconfig
CONFIG_BT_ENABLED=y
CONFIG_BLE_LOG_ENABLED=y
CONFIG_BLE_LOG_PRPH_USB=y
CONFIG_BLE_LOG_USB_DISPATCH_TEST_HOOKS=y
```

## components/bt/common/ble_log/test_apps/ble_log_usj_test/sdkconfig.defaults
```kconfig
CONFIG_BT_ENABLED=y
CONFIG_BLE_LOG_ENABLED=y
CONFIG_BLE_LOG_PRPH_USB_SERIAL_JTAG=y
```

## examples/bluetooth/nimble/ble_chan_sound_reflector/main/Kconfig.projbuild
```kconfig
menu "Example Configuration"


    config EXAMPLE_EXTENDED_ADV
        bool
        depends on SOC_BLE_50_SUPPORTED && BT_NIMBLE_50_FEATURE_SUPPORT
        default y
        select BT_NIMBLE_EXT_ADV
        prompt "Enable Extended Adv"
        help
            Use the extended advertising API in the example. The example
            still transmits legacy ADV_IND PDUs so the connection is created
            on the 1M PHY. If this option is disabled, ensure config
            BT_NIMBLE_EXT_ADV is also disabled from Nimble stack menuconfig

    config EXAMPLE_BONDING
        bool "Enable Bonding"
        default y
        help
            Store pairing keys so a previously bonded initiator can reconnect
            and re-encrypt without pairing again. Channel Sounding itself only
            requires an encrypted LE Secure Connections link, not bonding.

    config EXAMPLE_MITM
        bool "Enable MITM Protection"
        default n
        help
            Request Man-In-The-Middle protection during pairing. The example
            uses BLE_SM_IO_CAP_NO_IO, which cannot produce an authenticated
            link, so change the I/O capability in the source before enabling
            this.

    config EXAMPLE_RESOLVE_PEER_ADDR
        bool "Enable Peer Address Resolution"
        default y
        depends on EXAMPLE_BONDING
        help
            Distribute IRK keys so that resolvable private addresses from
            the peer can be resolved after bonding.
endmenu
```

## examples/openthread/ot_br/sdkconfig.defaults.esp32c5
```kconfig
#
# PSRAM
#
CONFIG_SPIRAM=y
CONFIG_SPIRAM_USE_MALLOC=y
CONFIG_SPIRAM_ALLOW_BSS_SEG_EXTERNAL_MEMORY=y

#
# OpenThread
#
CONFIG_OPENTHREAD_PLATFORM_MALLOC_CAP_SPIRAM=y
CONFIG_OPENTHREAD_PLATFORM_MSGPOOL_MANAGEMENT=y

#
# mDNS
#
CONFIG_MDNS_MEMORY_ALLOC_SPIRAM=y
```

## examples/openthread/ot_br/sdkconfig.defaults.esp32s2
```kconfig
#
# PSRAM
#
CONFIG_SPIRAM=y
CONFIG_SPIRAM_USE_MALLOC=y
CONFIG_SPIRAM_ALLOW_BSS_SEG_EXTERNAL_MEMORY=y

#
# OpenThread
#
CONFIG_OPENTHREAD_PLATFORM_MALLOC_CAP_SPIRAM=y
CONFIG_OPENTHREAD_PLATFORM_MSGPOOL_MANAGEMENT=y
CONFIG_OPENTHREAD_SPINEL_RX_FRAME_BUFFER_SIZE=2048
CONFIG_OPENTHREAD_SPINEL_UART_DRIVER_BUFFER_SIZE=2048

#
# mDNS
#
CONFIG_MDNS_MEMORY_ALLOC_SPIRAM=y
```

## examples/wifi/roaming/roaming_app/main/Kconfig.projbuild
```kconfig
menu "Example Configuration"

    config ESP_WIFI_SSID
        string "WiFi SSID"
        default "myssid"
        help
            SSID (network name) for the example to connect to.

    config ESP_WIFI_PASSWORD
        string "WiFi Password"
        default "mypassword"
        help
            WiFi password (WPA or WPA2) for the example to use.

    config ESP_EXAMPLE_RESTART_INTERVAL
        int "Restart this long after each boot's IP address (s)"
        range 0 3600
        default 0
        help
            Restart this many seconds after the boot's first IP address, so that boot to IP can be
            measured over many boots, with fast connect's remembered AP. 0 never restarts.
endmenu
```
