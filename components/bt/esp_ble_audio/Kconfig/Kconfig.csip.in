## components/bt/porting_btdm/controller/bredr/Kconfig.in
```kconfig
config BT_CTRL_BR_EDR_MAX_ACL_CONN
    int "BR/EDR Max ACL Connections"
    default 2
    range 1 7
    help
        BR/EDR ACL maximum connections of bluetooth controller.

config BT_CTRL_BR_EDR_ACL_LINK_ENABLE
    bool
    default y

if BT_CTRL_BR_EDR_ACL_LINK_ENABLE
    menu "ACL Tx/Rx buffer number configurations"
        config BT_CTRL_BR_EDR_ACLU_TX_BUF_NB
            int "Total BR/EDR ACL-U TX buffer number"
            depends on BT_CTRL_BREDR_ENABLE && (BT_CTRL_BR_EDR_MAX_ACL_CONN != 0)
            default 4
            range 3 10
            help
                Total BR/EDR ACL-U TX buffer number of bluetooth controller.

        config BT_CTRL_BR_EDR_DYNAMIC_ACLU_TX_BUF_NB
            int "Dynamic BR/EDR ACL-U TX buffer number"
            depends on BT_CTRL_BREDR_ENABLE && (BT_CTRL_BR_EDR_MAX_ACL_CONN != 0)
            default 0
            range 0 BT_CTRL_BR_EDR_ACLU_TX_BUF_NB
            help
                BR/EDR dynamic ACL-U TX buffer number of bluetooth controller.

        config BT_CTRL_BR_EDR_ACLU_RX_BUF_NB
            int "BR/EDR ACL-U RX buffer number"
            depends on BT_CTRL_BREDR_ENABLE && (BT_CTRL_BR_EDR_MAX_ACL_CONN != 0)
            default 6
            range 4 8
            help
                BR/EDR ACL-U RX buffer number of bluetooth controller.
    endmenu
endif

config BT_CTRL_BR_EDR_MAX_SYNC_CONN
    int "BR/EDR Max Synchronous(SCO/eSCO) Connections"
    default 0
    range 0 3
    help
        BR/EDR Synchronize maximum connections of bluetooth controller.

if BT_CTRL_BR_EDR_MAX_SYNC_CONN != 0

    menu "Supported eSCO packet types"
        config BT_CTRL_BR_EDR_ESCO_EV4_SUPP
            bool "BR/EDR eSCO support EV4 packet type"
            default n
            help
                This will affect the LM features of bluetooth controller.

        config BT_CTRL_BR_EDR_ESCO_EV5_SUPP
            bool "BR/EDR eSCO support EV5 packet type"
            default n
            help
                This will affect the LM features of bluetooth controller.

        config BT_CTRL_BR_EDR_ESCO_EV3_2_SUPP
            bool "BR/EDR eSCO support 2-EV3 packet type"
            default y
            help
                This will affect the LM features of bluetooth controller.

        config BT_CTRL_BR_EDR_ESCO_EV3_3_SUPP
            bool "BR/EDR eSCO support 3-EV3 packet type"
            default n
            help
                This will affect the LM features of bluetooth controller.

        config BT_CTRL_BR_EDR_ESCO_3_SLOTS_SUPP
            bool "BR/EDR eSCO support 3-slot packet types"
            default n
            help
                This will affect the LM features of bluetooth controller.
    endmenu

    menu "Synchronous Tx/Rx buffer numbers"
        config BT_CTRL_BR_EDR_SYNC_TX_BUF_NB
            int "BR/EDR Sync(SCO/eSCO) TX buffer number"
            default 4 if BT_CTRL_BR_EDR_MAX_SYNC_CONN = 1
            default 6 if BT_CTRL_BR_EDR_MAX_SYNC_CONN = 2
            default 8 if BT_CTRL_BR_EDR_MAX_SYNC_CONN = 3
            range 2 4 if BT_CTRL_BR_EDR_MAX_SYNC_CONN = 1
            range 4 8 if BT_CTRL_BR_EDR_MAX_SYNC_CONN = 2
            range 6 12 if BT_CTRL_BR_EDR_MAX_SYNC_CONN = 3
            help
                BR/EDR Synchronize TX buffer number of bluetooth controller.

        config BT_CTRL_BR_EDR_SYNC_RX_BUF_NB
            int "BR/EDR Sync(SCO/eSCO) RX buffer number"
            default 4 if BT_CTRL_BR_EDR_MAX_SYNC_CONN = 1
            default 8 if BT_CTRL_BR_EDR_MAX_SYNC_CONN = 2
            default 12 if BT_CTRL_BR_EDR_MAX_SYNC_CONN = 3
            range 3 4 if BT_CTRL_BR_EDR_MAX_SYNC_CONN = 1
            range 6 8 if BT_CTRL_BR_EDR_MAX_SYNC_CONN = 2
            range 9 12 if BT_CTRL_BR_EDR_MAX_SYNC_CONN = 3
            help
                BR/EDR Synchronize RX buffer number of bluetooth controller.
    endmenu

    choice BT_CTRL_BR_EDR_SCO_DATA_PATH
        prompt "BR/EDR Sync(SCO/eSCO) default data path"
        default BT_CTRL_BR_EDR_SCO_DATA_PATH_HCI
        help
            SCO/eSCO data path, i.e. HCI or PCM.
            SCO data can be sent/received through HCI synchronous packets, or the data
            can be routed to on-chip I2S module. The latter option is not yet supported.

        config BT_CTRL_BR_EDR_SCO_DATA_PATH_HCI
            bool "HCI"
        # config BT_CTRL_BR_EDR_SCO_DATA_PATH_PCM
            # bool "PCM"
    endchoice

endif

config BT_CTRL_BR_EDR_TEST_MODE_EN
    bool "Enable BR/EDR test mode"
    default n
    help
        Enable BR/EDR test mode

config BT_CTRL_BR_EDR_APB_EN
    bool "Enable BR/EDR Active Peripheral Broadcast"
    default n
    help
        Enable BR/EDR Active Peripheral Broadcast

config BT_CTRL_BR_EDR_APB_EXT_EN
    bool "Enable BR/EDR Broadcast Encryption or Piconet Clock Adjustment"
    select BT_CTRL_BR_EDR_APB_EN
    default n
    help
        Enable BR/EDR Broadcast Encryption or Piconet Clock Adjustment

choice BT_CTRL_BR_EDR_APB_EXT
    prompt "Choice BR/EDR Broadcast Encryption or Piconet Clock Adjustment"
    depends on BT_CTRL_BR_EDR_APB_EXT_EN
    default BT_CTRL_BR_EDR_APB_EXT_PCA_EN
    help
        Enable BR/EDR Broadcast Encryption or Piconet Clock Adjustment

    config BT_CTRL_BR_EDR_APB_EXT_BCST_ENC_EN
        bool "Broadcast Encryption"
        help
            Enable BR/EDR Broadcast Encryption

    config BT_CTRL_BR_EDR_APB_EXT_PCA_EN
        bool "Piconet Clock Adjustment"
        help
            Enable BR/EDR Piconet Clock Adjustment
endchoice

config BT_CTRL_BR_EDR_CPB_TX_EN
    bool "Enable BR/EDR Connectionless Peripheral Broadcast Transimit"
    default n
    help
        Enable BR/EDR Connectionless Peripheral Broadcast Transimit

config BT_CTRL_BR_EDR_CPB_RX_EN
    bool "Enable BR/EDR Connectionless Peripheral Broadcast Receive"
    default n
    help
        Enable BR/EDR Connectionless Peripheral Broadcast Receive

config BT_CTRL_BR_EDR_HOLD_EN
    bool "Enable BR/EDR Hold Mode"
    default n
    help
        Enable BR/EDR Hold Mode

config BT_CTRL_BR_EDR_LK_STORE_EN
    bool "Enable BR/EDR controller link key storage"
    default n
    help
        Enable BR/EDR controller link key storage, only support store link key in RAM for now.

config BT_CTRL_BR_EDR_DTM_EN
    bool "Enable BR/EDR controller direct test mode"
    default n
    help
        Enable BR/EDR controller direct test mode

config BT_CTRL_BR_EDR_TX_CCA_ENABLED
    bool "Enable BR/EDR TX CCA feature"
    default n
    help
        Enable CCA feature to cancel sending the packet if the signal power is stronger than CCA threshold.

config BT_CTRL_BR_EDR_CCA_RSSI_THRESH
    int "CCA RSSI threshold value"
    depends on BT_CTRL_BR_EDR_TX_CCA_ENABLED
    range 20 100
    default 20
    help
        Power threshold of CCA in unit of -1 dBm.

menu "TX Power Level settings"
    config BT_CTRL_BR_EDR_TX_PWR_ACL_MIN
        int "Default minimum TX power level for ACL"
        default -13
        range -24 12
        help
            Minimum BR/EDR transmission power level for ACL.

    config BT_CTRL_BR_EDR_TX_PWR_ACL_MAX
        int "Default maximum TX power level for ACL"
        default 4
        range -24 12
        help
            Maximum BR/EDR transmission power level for ACL.

    config BT_CTRL_BR_EDR_TX_PWR_APB
        int "Default TX power level for APB"
        depends on BT_CTRL_BR_EDR_APB_EN
        default 4
        range -24 12
        help
            BR/EDR transmission power level for APB.

    config BT_CTRL_BR_EDR_TX_PWR_PAGE
        int "Default TX power level for Page"
        default 4
        range -24 12
        help
            BR/EDR transmission power level for Page.

    config BT_CTRL_BR_EDR_TX_PWR_PSCAN
        int "Default TX power level for Page Scan"
        default 4
        range -24 12
        help
            BR/EDR transmission power level for Page Scan.

    config BT_CTRL_BR_EDR_TX_PWR_ISCAN
        int "Default TX power level for Inquiry Scan"
        default 4
        range -24 12
        help
            BR/EDR transmission power level for Inquiry Scan.

    config BT_CTRL_BR_EDR_TX_PWR_CPB
        int "Default TX power level for CPB"
        depends on BT_CTRL_BR_EDR_CPB_TX_EN
        default 4
        range -24 12
        help
            BR/EDR transmission power level for CPB.

    config BT_CTRL_BR_EDR_TX_PWR_STRAIN
        int "Default TX power level for Synchronization Train"
        depends on BT_CTRL_BR_EDR_CPB_TX_EN
        default 4
        range -24 12
        help
            BR/EDR transmission power level for Synchronization Train.
endmenu

menu "BR/EDR Vendor Specific HCI Commands and Events"
    config BT_CTRL_BR_EDR_LEGACY_AUTH_VENDOR_EVT
        bool "Legacy Authentication Vendor Specific Event Enable"
        default y
        help
            To protect from BIAS attack during Legacy authentication,
            Legacy authentication Vendor specific event should be enabled

endmenu
```

## components/bt/porting_btdm/controller/btdm_common/Kconfig.in
```kconfig
choice BTDM_CTRL_MODE
    prompt "Bluetooth Controller Mode (BLE/BREDR/DualMode)"
    help
        Specify the bluetooth controller mode (BR/EDR, BLE or dual mode).

    config BTDM_CTRL_MODE_BLE_ONLY
        bool "BLE Only"
        depends on SOC_BLE_SUPPORTED

    config BTDM_CTRL_MODE_BR_EDR_ONLY
        bool "BR/EDR Only"
        depends on SOC_BT_CLASSIC_SUPPORTED

    config BTDM_CTRL_MODE_BTDM
        bool "Bluetooth Dual Mode"
        depends on SOC_BLE_SUPPORTED && SOC_BT_CLASSIC_SUPPORTED
endchoice
```

## components/bt/porting_btdm/transport/Kconfig.in
```kconfig
menu "Bluetooth controller HCI"
    config BT_CTRL_HCI_CMD_NUM
        int "HCI CMD buffer number"
        range 1 255
        default 5

    choice BT_CTRL_HCI_INTERFACE
        prompt "HCI mode"
        default BT_CTRL_HCI_INTERFACE_USE_RAM

        config BT_CTRL_HCI_INTERFACE_USE_RAM
            bool "VHCI"
            help
                Use RAM as HCI interface
        config BT_CTRL_HCI_INTERFACE_USE_UART
            bool "UART(H4)"
            help
                Use UART as HCI interface
    endchoice

    choice BT_CTRL_UART_HCI_MODE_CHOICE
        prompt "UART HCI mode"
        depends on BT_CTRL_HCI_INTERFACE_USE_UART
        default BT_CTRL_UART_HCI_NO_DMA_MODE
        help
            Specify UART HCI mode: DMA or No DMA

        config BT_CTRL_UART_HCI_DMA_MODE
            bool "UHCI(UART with DMA)(EXPERIMENTAL)"
            help
                UART HCI Mode with DMA functionality.

        config BT_CTRL_UART_HCI_NO_DMA_MODE
            bool "UART(NO DMA)"
            help
                UART HCI Mode without DMA functionality.
    endchoice

    config BT_CTRL_HCI_UART_PORT
        int "HCI UART port"
        depends on BT_CTRL_HCI_INTERFACE_USE_UART
        default 1
        help
            Set the port number of HCI UART

    config BT_CTRL_HCI_UART_FLOWCTRL
        bool "HCI uart Hardware Flow ctrl"
        depends on BT_CTRL_HCI_INTERFACE_USE_UART
        default n

    config BT_CTRL_HCI_UART_TX_PIN
        int "HCI uart Tx gpio"
        depends on BT_CTRL_HCI_INTERFACE_USE_UART
        default 19

    config BT_CTRL_HCI_UART_RX_PIN
        int "HCI uart Rx gpio"
        depends on BT_CTRL_HCI_INTERFACE_USE_UART
        default 10

    config BT_CTRL_HCI_UART_RTS_PIN
        int "HCI uart RTS gpio"
        depends on BT_CTRL_HCI_UART_FLOWCTRL
        default 4

    config BT_CTRL_HCI_UART_CTS_PIN
        int "HCI uart CTS gpio"
        depends on BT_CTRL_HCI_UART_FLOWCTRL
        default 5

    config BT_CTRL_HCI_UART_BAUD
        int "HCI uart baudrate"
        depends on BT_CTRL_HCI_INTERFACE_USE_UART
        default 921600
        help
            HCI uart baud rate 115200 ~ 1000000

    choice BT_CTRL_HCI_UART_PARITY
        prompt "select uart parity"
        depends on BT_CTRL_HCI_INTERFACE_USE_UART
        default BT_CTRL_HCI_UART_UART_PARITY_DISABLE

        config BT_CTRL_HCI_UART_UART_PARITY_DISABLE
            bool "PARITY_DISABLE"
            help
                UART_PARITY_DISABLE
        config BT_CTRL_HCI_UART_UART_PARITY_EVEN
            bool "PARITY_EVEN"
            help
                UART_PARITY_EVEN
        config BT_CTRL_HCI_UART_UART_PARITY_ODD
            bool "PARITY_ODD"
            help
                UART_PARITY_ODD
    endchoice

    config BT_CTRL_HCI_UART_RX_BUFFER_SIZE
        int "The size of rx ring buffer memory"
        depends on BT_CTRL_UART_HCI_NO_DMA_MODE
        default 512
        help
            The size of rx ring buffer memory

    config BT_CTRL_HCI_UART_TX_BUFFER_SIZE
        int "The size of tx ring buffer memory"
        depends on BT_CTRL_UART_HCI_NO_DMA_MODE
        default 256
        help
            The size of tx ring buffer memory

    config BT_CTRL_HCI_TRANS_TASK_STACK_SIZE
        int "HCI transport task stack size"
        depends on !BT_CTRL_HCI_INTERFACE_USE_RAM
        default 1024
        help
            This configures stack size of hci transport task

    config BT_CTRL_HCI_TRANS_RX_MEM_NUM
        int "The amount of rx memory received at the same time"
        depends on BT_CTRL_UART_HCI_DMA_MODE
        default 3
        help
            The amount of rx memory received at the same time

    config BT_CTRL_HCI_LLDESCS_POOL_NUM
        int "The amount of lldecs memory for driver dma mode"
        depends on BT_CTRL_UART_HCI_DMA_MODE
        default 20
        help
            The amount of lldecs memory for driver dma mode
endmenu
```

## components/bt/test_apps/memory_release/sdkconfig.defaults
```kconfig
CONFIG_HEAP_POISONING_COMPREHENSIVE=y

CONFIG_BT_ENABLED=y
CONFIG_BT_NIMBLE_ENABLED=y
```

## components/bt/test_apps/sdkconfig.defaults
```kconfig
CONFIG_BT_ENABLED=y
CONFIG_UNITY_FREERTOS_STACK_SIZE=12288
CONFIG_ESP_TASK_WDT_CHECK_IDLE_TASK_CPU0=n
```
