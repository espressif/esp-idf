## components/bt/esp_ble_audio/host/services/ots/Kconfig.ots.in
```kconfig
# Bluetooth Object Transfer service

# SPDX-FileCopyrightText: 2020-2022 Nordic Semiconductor ASA
# SPDX-FileContributor: 2026 Espressif Systems (Shanghai) CO LTD
# SPDX-License-Identifier: Apache-2.0

config BT_OTS
    bool "Object Transfer Service (OTS) [EXPERIMENTAL]"
    select BT_OTS_SECONDARY_SVC
    help
        Enable Object Transfer Service.

if BT_OTS

    config BT_OTS_DIR_LIST_OBJ
        bool "The Directory Listing Object"
        help
            Enables the Directory Listing Object, which is an object that contains all the metadata
            from all other objects, for easy exposure to a client. Enabling this will use one of the
            objects given by BT_OTS_MAX_OBJ_CNT.

    config BT_OTS_DIR_LIST_OBJ_NAME
        string "The object name of the Directory Listing Object"
        default "Directory"
        depends on BT_OTS_DIR_LIST_OBJ
        help
            The name of the Directory Listing Object when it is read by a client.

    config BT_OTS_MAX_INST_CNT
        int "Maximum number of available OTS instances"
        default 1
        range 1 1 if !BT_OTS_SECONDARY_SVC

    config BT_OTS_SECONDARY_SVC
        bool "Register OTS as Secondary Service"

    config BT_OTS_OACP_CREATE_SUPPORT
        bool "Support OACP Create Operation"
        depends on BT_OTS_OACP_WRITE_SUPPORT
        depends on BT_OTS_OBJ_NAME_WRITE_SUPPORT

    config BT_OTS_OACP_CHECKSUM_SUPPORT
        bool "Support OACP Calculate Checksum operation"

    config BT_OTS_OACP_DELETE_SUPPORT
        bool "Support OACP Delete Operation"

    config BT_OTS_OACP_READ_SUPPORT
        bool "Support OACP Read Operation"
        default y

    config BT_OTS_OACP_WRITE_SUPPORT
        bool "Support OACP Write Operation"

    config BT_OTS_OACP_PATCH_SUPPORT
        bool "Support patching of objects"
        depends on BT_OTS_OACP_WRITE_SUPPORT

    config BT_OTS_OLCP_GO_TO_SUPPORT
        bool "Support OLCP Go To Operation"
        default y

    config BT_OTS_OBJ_NAME_WRITE_SUPPORT
        bool "Support object name write"

endif # BT_OTS

#### Object Transfer Service Client ################################

config BT_OTS_CLIENT
    bool "Object Transfer Service Client [Experimental]"
    help
        This option enables support for the Object Transfer Service Client.

if BT_OTS || BT_OTS_CLIENT

    config BT_OTS_MAX_OBJ_CNT
        hex "Maximum number of objects that each service instance can store"
        default 0x05
        # Given the maximum size of a directory listing record (172) and the maximum size of an
        # object using the net_buf implementation is 2^16-1, the maximum number of objects is given
        # by 2^16-1 / 172 = 381 == 0x17D)
        range 0x02 0x17D if BT_OTS_DIR_LIST_OBJ
        # Max obj count is otherwise the non-RFU IDs available
        range 0x01 0xFFFFFFFFFFFFFEFF

    config BT_OTS_L2CAP_CHAN_TX_MTU
        int "Size of TX MTU for Object Transfer Channel"
        default 256
        range 21 65533

    config BT_OTS_L2CAP_CHAN_RX_MTU
        int "Size of RX MTU for Object Transfer Channel"
        # RX MTU will be truncated to account for the L2CAP PDU and SDU header.
        default 256
        range 21 65533    # TODO: check

    config BT_OTS_OBJ_MAX_NAME_LEN
        # int "Maximum object name length"
        int # Fixed value (i.e. max 120) for now
        # Max name length allowed by OTS spec is 120 octets
        # TODO: Set separate max name length for client, as other
        # servers may use the full 120 octets.
        default 120
        range 1 120

endif # BT_OTS || BT_OTS_CLIENT
```

## components/bt/esp_ble_iso/Kconfig.in
```kconfig
# SPDX-FileCopyrightText: 2016 Intel Corporation
# SPDX-FileCopyrightText: 2021 Nordic Semiconductor ASA
# SPDX-FileContributor: 2026 Espressif Systems (Shanghai) CO LTD
# SPDX-License-Identifier: Apache-2.0

config BT_ISO
    bool
    select BT_NIMBLE_ISO if BT_NIMBLE_ENABLED

config BT_ISO_TX
    bool

config BT_ISO_RX
    bool

config BT_ISO_UNICAST
    bool
    select BT_ISO
    select BT_ISO_TX
    select BT_ISO_RX
    help
        This option enables support for Bluetooth Unicast
        Isochronous channels.

config BT_ISO_PERIPHERAL
    bool "Bluetooth Isochronous Channel Unicast Peripheral Support"
    select BT_ISO_UNICAST
    help
        This option enables support for Bluetooth Unicast
        Isochronous channels for the peripheral role.

config BT_ISO_CENTRAL
    bool "Bluetooth Isochronous Channel Unicast Central Support"
    select BT_ISO_UNICAST
    help
        This option enables support for Bluetooth Broadcast
        Isochronous channels for the central role.

config BT_ISO_BROADCAST
    bool
    select BT_ISO

config BT_ISO_BROADCASTER
    bool "Bluetooth Isochronous Broadcaster Support"
    select BT_ISO_BROADCAST
    select BT_ISO_TX
    select BT_BROADCASTER
    help
        This option enables support for the Bluetooth Isochronous Broadcaster.

config BT_ISO_SYNC_RECEIVER
    bool "Bluetooth Isochronous Synchronized Receiver Support"
    select BT_ISO_BROADCAST
    select BT_ISO_RX
    help
        This option enables support for the Bluetooth Isochronous
        Synchronized Receiver.

if BT_ISO

    config BT_ISO_MAX_CHAN
        int "Maximum number of simultaneous ISO channels"
        default 1
        range 1 64
        help
            Maximum number of simultaneous Bluetooth isochronous channels
            supported.

    config BT_ISO_TEST_PARAMS
        bool "ISO test parameters support"
        default BT_NIMBLE_ISO_TEST if BT_NIMBLE_ENABLED
        help
            Enabling advanced ISO parameters will allow the use of the ISO test
            parameters for creating a CIG or a BIG. These test parameters were
            intended for testing, but can be used to allow the host to set more
            settings that are otherwise usually controlled by the controller.

    if BT_ISO_UNICAST

        config BT_ISO_MAX_CIG
            int "Maximum number of Connected Isochronous Groups (CIGs) to support"
            range 1 BT_NIMBLE_ISO_CIG
            help
                Maximum number of CIGs that are supported by the host. A CIG can be
                used for either transmitting or receiving.

    endif # BT_ISO_UNICAST

    if BT_ISO_BROADCAST

        config BT_ISO_MAX_BIG
            int "Maximum number of Broadcast Isochronous Groups (BIGs) to support"
            range 1 BT_NIMBLE_ISO_BIG
            help
                Maximum number of BIGs that are supported by the host. A BIG can be
                used for either transmitting or receiving, but not at the same time.

    endif # BT_ISO_BROADCAST

    config BT_ISO_NO_LOG
        bool "Disable ISO Debug Log"
        default n
        help
            Select this to save the ISO related rodata code size. Enabling
            this option will disable the output of ISO debug log.

    menu "ISO Debug Log Level"
        depends on !BT_ISO_NO_LOG

        choice BT_ISO_LOG_LEVEL
            prompt "ISO_LOG_LEVEL"
            default BT_ISO_LOG_LEVEL_WARNING
            depends on !BT_ISO_NO_LOG
            help
                Define ISO trace level.

            config BT_ISO_LOG_LEVEL_NONE
                bool "NONE"
            config BT_ISO_LOG_LEVEL_ERROR
                bool "ERROR"
            config BT_ISO_LOG_LEVEL_WARNING
                bool "WARNING"
            config BT_ISO_LOG_LEVEL_INFO
                bool "INFO"
            config BT_ISO_LOG_LEVEL_DEBUG
                bool "DEBUG"
            config BT_ISO_LOG_LEVEL_VERBOSE
                bool "VERBOSE"
        endchoice

        config BT_ISO_LOG_LEVEL
            int
            default 0 if BT_ISO_LOG_LEVEL_NONE
            default 1 if BT_ISO_LOG_LEVEL_ERROR
            default 2 if BT_ISO_LOG_LEVEL_WARNING
            default 3 if BT_ISO_LOG_LEVEL_INFO
            default 4 if BT_ISO_LOG_LEVEL_DEBUG
            default 5 if BT_ISO_LOG_LEVEL_VERBOSE
            default 2
    endmenu

    config BT_DEBUG_ISO_DATA
        bool # hidden
        depends on !BT_ISO_NO_LOG
        help
            Use this option to enable ISO channels data debug logs for the
            Bluetooth Audio functionality. This will enable debug logs for
            all ISO data received and sent.

endif # BT_ISO
```

## components/bt/porting_btdm/Kconfig.in
```kconfig
source "$IDF_PATH/components/bt/porting_btdm/controller/btdm_common/Kconfig.in"

choice BT_CTRL_PINNED_TO_CORE_CHOICE
    prompt "The cpu core which bluetooth controller run"
    depends on !FREERTOS_UNICORE
    help
        Specify the cpu core to run bluetooth controller.
        Can not specify no-affinity.

    config BT_CTRL_PINNED_TO_CORE_CHOICE_0
        bool "Core 0 (PRO CPU)"
    config BT_CTRL_PINNED_TO_CORE_CHOICE_1
        bool "Core 1 (APP CPU)"
        depends on !FREERTOS_UNICORE
endchoice

config BT_CTRL_PINNED_TO_CORE
    int
    default 0 if BT_CTRL_PINNED_TO_CORE_CHOICE_0
    default 1 if BT_CTRL_PINNED_TO_CORE_CHOICE_1
    default 0

config BT_CTRL_TASK_STACK_SIZE
    int "Controller task stack size"
    default 5120 if BLE_MESH
    default 4096
    help
        This configures stack size of NimBLE controller task

config BT_CTRL_SLEEP_ENABLE
    bool "Enable Bluetooth Controller sleep"
    default n
    help
        Enable Bluetooth Controller sleep

choice BT_CTRL_LP_CLK_SRC
    prompt "Bluetooth low power clock source"
    default BT_CTRL_LP_CLK_SRC_MAIN_XTAL
    depends on BT_CTRL_SLEEP_ENABLE
    config BT_CTRL_LP_CLK_SRC_MAIN_XTAL
        bool "Use main XTAL as RTC clock source"
        help
            User main XTAL as RTC clock source.
            This option is recommended if external 32.768k XTAL is not available.
            Using the external 32.768 kHz XTAL will have lower current consumption
            in light sleep compared to using the main XTAL.

    config BT_CTRL_LP_CLK_SRC_DEFAULT
        depends on (RTC_CLK_SRC_EXT_CRYS || !BT_CTRL_BREDR_ENABLE)
        bool "Use system RTC slow clock source"
        help
            Use the same slow clock source as system RTC
            Using any clock source other than external 32.768 kHz XTAL supports only
            legacy ADV and SCAN due to low clock accuracy.

endchoice

config BT_DUAL_MODE_ARCH
    bool
    default y

config BT_CTRL_BLE_ENABLE
    bool
    default (BTDM_CTRL_MODE_BLE_ONLY || BTDM_CTRL_MODE_BTDM)

config BT_CTRL_BREDR_ENABLE
    bool
    default (BTDM_CTRL_MODE_BR_EDR_ONLY || BTDM_CTRL_MODE_BTDM)

source "$IDF_PATH/components/bt/porting_btdm/transport/Kconfig.in"

menu "BLE Controller Options"
    depends on SOC_BLE_SUPPORTED && (BTDM_CTRL_MODE_BLE_ONLY || BTDM_CTRL_MODE_BTDM)
    source "$IDF_PATH/components/bt/porting_btdm/controller/ble/Kconfig.in"
endmenu

menu "BR/EDR Controller Options"
    depends on SOC_BT_CLASSIC_SUPPORTED && (BTDM_CTRL_MODE_BR_EDR_ONLY || BTDM_CTRL_MODE_BTDM)
    source "$IDF_PATH/components/bt/porting_btdm/controller/bredr/Kconfig.in"
endmenu
```
