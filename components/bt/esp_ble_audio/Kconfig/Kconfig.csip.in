## components/bt/esp_ble_audio/Kconfig/Kconfig.tbs.in
```kconfig
# Bluetooth Audio - Call control configuration options
#
# SPDX-FileCopyrightText: 2020 Bose Corporation
# SPDX-FileCopyrightText: 2024 Nordic Semiconductor ASA
#
# SPDX-License-Identifier: Apache-2.0
#

#####################  Telephone Bearer Service #####################

config BT_TBS
    bool "Telephone Bearer Service Support"
    select BT_AUDIO
    help
        This option enables support for Telephone Bearer Service. By default this only
        initializes the GTBS service. If specific TBS services are wanted, they need to be
        enabled by setting BT_TBS_BEARER_COUNT to a non-zero value.

if BT_TBS

    config BT_TBS_SUPPORTED_FEATURES
        int "Telephone Bearer Service Supported Features"
        default 1
        range 0 3
        help
            Bitfield to set supported features of the bearer.
            Bit 0: Local Hold and Retrieve
            Bit 1: Join calls within Telephone Bearer Service

    config BT_TBS_MAX_CALLS
        int "Telephone Bearer Service Maximum Number Of Calls Supported"
        default 3
        range 1 16
        help
            Sets the maximum number of calls the service supports per bearer.

    config BT_TBS_BEARER_COUNT
        int "How many bearer instances the device instantiates"
        default 0
        range 0 255
        help
            Sets the number of TBS instances that are instantiated

    config BT_TBS_MAX_SCHEME_LIST_LENGTH
        int "The maximum length of the URI scheme list"
        default 30
        range 0 512
        help
            Sets the maximum length of the URI scheme list.

endif # BT_TBS

##################### Call Control Client #####################

config BT_TBS_CLIENT_GTBS
    bool "Generic Telephone Bearer Service client support"
    help
        This option enables support for the GTBS-oriented Call Control client.

config BT_TBS_CLIENT_TBS
    bool "Telephone Bearer Service client support"
    help
        This option enables support for the TBS-oriented Call Control client.

config BT_TBS_CLIENT
    bool # hidden
    default y if BT_TBS_CLIENT_GTBS || BT_TBS_CLIENT_TBS
    select BT_AUDIO

if BT_TBS_CLIENT

    config BT_TBS_CLIENT_MAX_CALLS
        int "Maximum Number Of Calls Supported"
        default 1
        help
            Sets the maximum number of calls the client supports per TBS instance.

    config BT_TBS_CLIENT_MAX_TBS_INSTANCES
        int "Maximum number of TBS instances to setup"
        depends on BT_TBS_CLIENT_TBS
        default 1
        range 1 3
        help
            Sets the maximum number of Telephone Bearer Service (TBS)
            instances to setup and use.

    config BT_TBS_CLIENT_MINIMAL
        bool "Minimal TBS Client without optional procedures"
        default n
        help
            This option disables all optional procedures in the TBS Client.

    config BT_TBS_CLIENT_BEARER_PROVIDER_NAME
        bool "Support reading Bearer Provider Name"
        default y if !BT_TBS_CLIENT_MINIMAL
        help
            This option enables support for reading Bearer Provider Name.

    config BT_TBS_CLIENT_BEARER_UCI
        bool "Support reading Bearer UCI"
        default y if !BT_TBS_CLIENT_MINIMAL
        help
            This option enables support for reading Bearer UCI.

    config BT_TBS_CLIENT_BEARER_TECHNOLOGY
        bool "Support reading Bearer Technology"
        default y if !BT_TBS_CLIENT_MINIMAL
        help
            This option enables support for reading Bearer Technology.

    config BT_TBS_CLIENT_BEARER_URI_SCHEMES_SUPPORTED_LIST
        bool "Support reading Bearer URI Schemes Supported List"
        default y if !BT_TBS_CLIENT_MINIMAL
        help
            This option enables support for reading Bearer URI Schemes Supported
            List.

    config BT_TBS_CLIENT_BEARER_SIGNAL_STRENGTH
        bool "Support reading Bearer Signal Strength"
        default y if !BT_TBS_CLIENT_MINIMAL
        help
            This option enables support for reading Bearer Signal Strength.

    config BT_TBS_CLIENT_READ_BEARER_SIGNAL_INTERVAL
        bool "Support reading Bearer Signal Strength Reporting Interval"
        default y if !BT_TBS_CLIENT_MINIMAL
        help
            This option enables support for reading Bearer Signal Strength
            Reporting Interval.

    config BT_TBS_CLIENT_SET_BEARER_SIGNAL_INTERVAL
        bool "Support setting Bearer Signal Strength Reporting Interval"
        default y if !BT_TBS_CLIENT_MINIMAL
        help
            This option enables support for setting Bearer Signal Strength
            Reporting Interval.

    config BT_TBS_CLIENT_BEARER_LIST_CURRENT_CALLS
        bool "Support reading Bearer List Current Calls"
        default y if !BT_TBS_CLIENT_MINIMAL
        help
            This option enables support for reading Bearer List Current Calls.

    config BT_TBS_CLIENT_CCID
        bool "Support reading Content Control ID"
        default y if !BT_TBS_CLIENT_MINIMAL
        help
            This option enables support for reading Content Control ID.

    config BT_TBS_CLIENT_INCOMING_URI
        bool "Support reading Incoming Call Target Bearer URI"
        default y if !BT_TBS_CLIENT_MINIMAL
        help
            This option enables support for reading Incoming Call Target Bearer
            URI.

    config BT_TBS_CLIENT_STATUS_FLAGS
        bool "Support reading Status Flags"
        default y if !BT_TBS_CLIENT_MINIMAL
        help
            This option enables support for reading Status Flags.

    config BT_TBS_CLIENT_CP_PROCEDURES
        bool # hidden
        default y
        depends on (BT_TBS_CLIENT_ACCEPT_CALL || \
            BT_TBS_CLIENT_TERMINATE_CALL || \
            BT_TBS_CLIENT_HOLD_CALL || \
            BT_TBS_CLIENT_RETRIEVE_CALL || \
            BT_TBS_CLIENT_ORIGINATE_CALL || \
            BT_TBS_CLIENT_JOIN_CALLS)
        help
            This hidden option indicates that there are at least one control
            point procedure available.
            When this option is disabled it indicates that the control point can
            be optimized away.

    config BT_TBS_CLIENT_ACCEPT_CALL
        bool "Support Accept Call"
        default y if !BT_TBS_CLIENT_MINIMAL
        help
            This option enables support for answering an incoming call.

    config BT_TBS_CLIENT_TERMINATE_CALL
        bool "Support Terminate Call"
        default y if !BT_TBS_CLIENT_MINIMAL
        help
            This option enables support for terminating a call.

    config BT_TBS_CLIENT_HOLD_CALL
        bool "Support Hold Call"
        default y if !BT_TBS_CLIENT_MINIMAL
        help
            This option enables support for putting a call on hold.

    config BT_TBS_CLIENT_RETRIEVE_CALL
        bool "Support Retrieve Call"
        default y if !BT_TBS_CLIENT_MINIMAL
        help
            This option enables support for retrieving a call on hold.

    config BT_TBS_CLIENT_ORIGINATE_CALL
        bool "Support Originate Call"
        default y if !BT_TBS_CLIENT_MINIMAL
        help
            This option enables support for originating a call.

    config BT_TBS_CLIENT_JOIN_CALLS
        bool "Support Join Calls"
        depends on BT_TBS_CLIENT_MAX_CALLS > 1
        default y if !BT_TBS_CLIENT_MINIMAL
        help
            This option enables support for joining calls.

    config BT_TBS_CLIENT_OPTIONAL_OPCODES
        bool "Support reading Optional Opcodes"
        default y if !BT_TBS_CLIENT_MINIMAL
        help
            This option enables support for reading Optional Opcodes.

    config BT_TBS_CLIENT_INCOMING_CALL
        bool "Support reading Incoming Call"
        default y if !BT_TBS_CLIENT_MINIMAL
        help
            This option enables support for reading Incoming Call.

    config BT_TBS_CLIENT_CALL_FRIENDLY_NAME
        bool "Support reading Call Friendly Name"
        default y if !BT_TBS_CLIENT_MINIMAL
        help
            This option enables support for reading Call Friendly Name.

endif # BT_TBS_CLIENT

if BT_TBS || BT_TBS_CLIENT

    config BT_TBS_MAX_URI_LENGTH
        int "The maximum length of the call URI supported"
        default 30
        range 4 253
        help
            Sets the maximum length of the call URI supported. Note that if this
            value is lower than a call URI, the call request will be rejected.

    config BT_TBS_MAX_PROVIDER_NAME_LENGTH
        int "The maximum length of the bearer provider name"
        default 30
        range 1 512
        help
            Sets the maximum length of the bearer provider name.

endif # BT_TBS || BT_TBS_CLIENT
```

## components/bt/esp_ble_audio/Kconfig/Kconfig.tmap.in
```kconfig
# Bluetooth Audio - Telephony and Media Audio Profile (TMAP) options
#
# SPDX-FileCopyrightText: 2023 NXP
#
# SPDX-License-Identifier: Apache-2.0
#
config BT_TMAP_CG_SUPPORTED
    bool # hidden
    default y if (BT_CAP_INITIATOR && BT_CAP_COMMANDER && BT_BAP_UNICAST_CLIENT && \
        BT_BAP_UNICAST_CLIENT_ASE_SRC > 0 && BT_BAP_UNICAST_CLIENT_ASE_SNK > 0 && \
        BT_VCP_VOL_CTLR && BT_TBS)

config BT_TMAP_CT_SUPPORTED
    bool # hidden
    default y if BT_CAP_ACCEPTOR && (BT_ASCS_ASE_SNK > 0 || BT_ASCS_ASE_SRC > 0)

config BT_TMAP_UMS_SUPPORTED
    bool # hidden
    default y if (BT_CAP_INITIATOR && BT_CAP_COMMANDER && BT_BAP_UNICAST_CLIENT && \
        BT_BAP_UNICAST_CLIENT_ASE_SNK_COUNT > 0 && BT_VCP_VOL_CTLR && BT_MCS)

config BT_TMAP_UMR_SUPPORTED
    bool # hidden
    default y if BT_CAP_ACCEPTOR && BT_ASCS_ASE_SNK > 0 && BT_VCP_VOL_REND

config BT_TMAP_BMS_SUPPORTED
    bool # hidden
    default y if BT_CAP_INITIATOR && BT_BAP_BROADCAST_SOURCE

config BT_TMAP_BMR_SUPPORTED
    bool # hidden
    default y if BT_CAP_ACCEPTOR && BT_BAP_BROADCAST_SINK && BT_VCP_VOL_REND

config BT_TMAP
    bool "Telephony and Media Audio Profile"
    depends on BT_CAP_ACCEPTOR || BT_CAP_INITIATOR
    help
        Enabling this will enable TMAP.
```

## components/bt/esp_ble_audio/Kconfig/Kconfig.vcp.in
```kconfig
# Bluetooth Audio - Volume Control Profile configuration options
#
# SPDX-FileCopyrightText: 2020 Bose Corporation
# SPDX-FileCopyrightText: 2020-2022 Nordic Semiconductor ASA
#
# SPDX-License-Identifier: Apache-2.0
#

################### Volume Control Profile Volume Renderer ###################

config BT_VCP_VOL_REND
    bool "Volume Control Profile Volume Renderer Support"
    help
        This option enables support for Volume Control Profile Volume Renderer
        role and the Volume Control Service.

if BT_VCP_VOL_REND

    config BT_VCP_VOL_REND_VOCS_INSTANCE_COUNT
        int "Volume Offset Control Service instance count"
        default 0
        range 0 BT_VOCS_MAX_INSTANCE_COUNT
        help
            This option sets the number of instances of Volume Offset Control
            Services.

    config BT_VCP_VOL_REND_VOCS
        bool # Hidden
        default y if BT_VCP_VOL_REND_VOCS_INSTANCE_COUNT > 0
        help
            This hidden option makes it possible to easily check if VOCS is
            enabled for VCS.

    config BT_VCP_VOL_REND_AICS_INSTANCE_COUNT
        int "Audio Input Control Service instance count for VCS"
        default 0
        range 0 BT_AICS_MAX_INSTANCE_COUNT
        help
            This option sets the number of instances of Audio Input Control
            Services for VCS.

    config BT_VCP_VOL_REND_AICS
        bool # Hidden
        default y if BT_VCP_VOL_REND_AICS_INSTANCE_COUNT > 0
        help
            This hidden option makes it possible to easily check if AICS is
            enabled for VCS.

    config BT_VCP_VOL_REND_VOL_FLAGS_NOTIFIABLE
        bool "Volume Flags notifiable support"
        help
            This option enables support for clients to subscribe for notifications
            on the Volume Flags characteristic.

endif # BT_VCP_VOL_REND

################### Volume Control Profile Volume Controller ###################

config BT_VCP_VOL_CTLR
    bool "Volume Control Profile Volume Controller Support"
    help
        This option enables support for Volume Control Profile Volume
        Controller.

if BT_VCP_VOL_CTLR

    config BT_VCP_VOL_CTLR_MAX_VOCS_INST
        int "Maximum number of VOCS instances to setup"
        default 0
        range 0 BT_VOCS_CLIENT_MAX_INSTANCE_COUNT
        help
            Sets the maximum number of Volume Offset Control Service (VOCS)
            instances to setup and use.

    config BT_VCP_VOL_CTLR_VOCS
        bool # Hidden
        default y if BT_VCP_VOL_CTLR_MAX_VOCS_INST > 0
        help
            This hidden option makes it possible to easily check if VOCS is
            enabled for VCS client.

    config BT_VCP_VOL_CTLR_MAX_AICS_INST
        int "Maximum number of AICS instances to setup"
        default 0
        range 0 3
        help
            Sets the maximum number of Audio Input Control Service (AICS)
            instances to setup and use.

    config BT_VCP_VOL_CTLR_AICS
        bool # Hidden
        default y if BT_VCP_VOL_CTLR_MAX_AICS_INST > 0
        help
            This hidden option makes it possible to easily check if AICS is
            enabled for VCS client.

endif # BT_VCP_VOL_CTLR
```

## components/bt/esp_ble_audio/Kconfig/Kconfig.vocs.in
```kconfig
# Bluetooth Audio - Volume Offset Control Service options
#
# SPDX-FileCopyrightText: 2020 Bose Corporation
#
# SPDX-License-Identifier: Apache-2.0
#

##################### Volume Offset Control Service #####################

config BT_VOCS_MAX_INSTANCE_COUNT
    int "Volume Offset Control Service max instance count"
    default 0
    range 0 15
    help
        This option sets the maximum number of instances of Volume Offset
        Control Services.

config BT_VOCS
    bool # hidden
    default y if BT_VOCS_MAX_INSTANCE_COUNT > 0
    help
        This hidden option enables support for Volume Control Service.

if BT_VOCS

    config BT_VOCS_MAX_OUTPUT_DESCRIPTION_SIZE
        int "Volume Offset Control Service max output description size"
        default 32
        range 0 512
        help
            This option sets the maximum output description size in octets.

endif # BT_VOCS

##################### Volume Offset Control Service Client #####################

config BT_VOCS_CLIENT_MAX_INSTANCE_COUNT
    int "Volume Offset Control Service client max instance count"
    default 0
    range 0 15
    help
        This option sets the maximum number of instances of Volume Offset
        Control Service clients.

config BT_VOCS_CLIENT
    bool # hidden
    default y if BT_VOCS_CLIENT_MAX_INSTANCE_COUNT > 0
    help
        This hidden option enables support for Volume Offset Control Service.
```
