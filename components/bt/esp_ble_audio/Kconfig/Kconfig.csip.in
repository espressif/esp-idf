## components/bt/esp_ble_audio/Kconfig/Kconfig.csip.in
```kconfig
# Bluetooth Audio - Broadcast Assistant configuration options
#
# SPDX-FileCopyrightText: 2020 Bose Corporation
# SPDX-FileCopyrightText: 2021 Nordic Semiconductor ASA
#
# SPDX-License-Identifier: Apache-2.0
#

#################### Coordinated Set Identification Service ####################

config BT_CSIP_SET_MEMBER
    bool "Coordinated Set Identification Profile Set Member support"
    help
        This option enables support for Coordinated Set Identification
        Profile Set Member role and the Coordinated Set Identification
        Service.

if BT_CSIP_SET_MEMBER

    config BT_CSIP_SET_MEMBER_TEST_SAMPLE_DATA
        bool "Coordinated Set Identification Service Test Sample Data"
        help
            Enable the use of the sample data defined by the CSIS spec SIRK.
            This will use the sample SIRK, prand and LTK.

            WARNING: This option enables anyone to track and decrypt the SIRK
            (if encrypted) using public sample data.
            Should not be used for production builds.

    config BT_CSIP_SET_MEMBER_ENC_SIRK_SUPPORT
        bool "Support for encrypted SIRK"
        default y
        help
            Enables support encrypting the SIRK.

    config BT_CSIP_SET_MEMBER_MAX_INSTANCE_COUNT
        int "Coordinated Set Identification Profile max service instance count"
        default 1
        range 1 255
        help
            This option sets the maximum number of instances of Coordinated Set
            Identification Services. If the service is declared as primary service
            then only a single instance is possible.

            Enabling BT_CAP_ACCEPTOR_SET_MEMBER will take one of the allocated
            instances.

    config BT_CSIP_SET_MEMBER_SIRK_NOTIFIABLE
        bool "SIRK notifiable Support"
        help
            This option enables support for clients to be notified on SIRK changes.

    config BT_CSIP_SET_MEMBER_SIZE_NOTIFIABLE
        bool "Set Size notifiable support"
        help
            This option enables support for clients to be notified on Set Size changes.

endif # BT_CSIP_SET_MEMBER

#################### Coordinated Set Identification Client ####################

config BT_CSIP_SET_COORDINATOR
    bool "Coordinated Set Identification Profile Set Coordinator Support"
    help
        This option enables support for Coordinated Set Identification
        Profile Set Coordinator.

if BT_CSIP_SET_COORDINATOR

    config BT_CSIP_SET_COORDINATOR_TEST_SAMPLE_DATA
        bool "Coordinated Set Identification Service Test Sample Data"
        help
            Enable the use of the sample data defined by the CSIS spec.
            This will use the sample SIRK, prand and LTK.

            WARNING: This option enables the client to use the sample data
            to locate members and decrypt the SIRK, and thus won't work
            with set members that are not using the sample data.
            Should not be used for production builds.

    config BT_CSIP_SET_COORDINATOR_MAX_CSIS_INSTANCES
        int "Coordinated Set Identification Service Count"
        default 1
        range 1 3
        help
            Sets the number of service instances, which corresponds to the number
            of different sets the peer device may be in.

    config BT_CSIP_SET_COORDINATOR_ENC_SIRK_SUPPORT
        bool "Support for encrypted SIRK"
        default y
        help
            Enables support encrypting the SIRK.

endif # BT_CSIP_SET_COORDINATOR
```

## components/bt/esp_ble_audio/Kconfig/Kconfig.gmap.in
```kconfig
# Bluetooth Audio - Gaming Audio Profile (GMAP) options
#
# SPDX-FileCopyrightText: 2023 Nordic Semiconductor ASA
#
# SPDX-License-Identifier: Apache-2.0
#

config BT_GMAP_UGG_SUPPORTED
    bool # hidden
    default y if BT_CAP_INITIATOR && BT_BAP_UNICAST_CLIENT && BT_VCP_VOL_CTLR

config BT_GMAP_UGT_SUPPORTED
    bool # hidden
    default y if BT_CAP_ACCEPTOR && BT_BAP_UNICAST_SERVER

config BT_GMAP_BGS_SUPPORTED
    bool # hidden
    default y if BT_CAP_INITIATOR && BT_BAP_BROADCAST_SOURCE && BT_BAP_BROADCAST_ASSISTANT

config BT_GMAP_BGR_SUPPORTED
    bool # hidden
    default y if BT_CAP_ACCEPTOR && BT_BAP_BROADCAST_SINK && BT_VCP_VOL_REND

config BT_GMAP
    bool "Gaming Audio Profile"
    depends on BT_CAP_ACCEPTOR || BT_CAP_INITIATOR
    help
        Enabling this will enable GMAP.
```

## components/bt/esp_ble_audio/Kconfig/Kconfig.has.in
```kconfig
# Bluetooth Audio - Hearing Access Service options
#
# SPDX-FileCopyrightText: 2022 Codecoup
#
# SPDX-License-Identifier: Apache-2.0

menuconfig BT_HAS
    bool "Hearing Access Service support"
    depends on BT_BAP_UNICAST_SERVER
    help
        This option enables support for Hearing Access Service.

if BT_HAS

    config BT_HAS_FEATURES_NOTIFIABLE
        bool "Hearing Aid Features Notifiable Support"
        help
            This option enables support for clients to subscribe for notifications
            on the Hearing Aid Features characteristic.

    config BT_HAS_PRESET_COUNT
        int "Preset record list size"
        default 2
        range 0 255
        help
            This option sets the number of Hearing Access Service Presets
            that can be registered. Setting this value to 0 disables Presets support.

    config BT_HAS_PRESET_SUPPORT
        bool # hidden
        default y if BT_HAS_PRESET_COUNT > 0

    if BT_HAS_PRESET_SUPPORT

        config BT_HAS_PRESET_NAME_DYNAMIC
            bool "Allow to set preset name on runtime"
            help
                Enabling this option allows for runtime configuration of preset name.

        config BT_HAS_PRESET_CONTROL_POINT_NOTIFIABLE
            bool "Preset Control Point Notifiable support (depends on EATT)"
            help
                This option enables support for clients to subscribe for notifications
                on the Hearing Aid Preset Control Point characteristic.

        config BT_HAS_ACTIVE_PRESET_INDEX
            bool # hidden
            default y if BT_HAS_PRESET_SUPPORT
            help
                This option enables the Hearing Aid Active Preset Index characteristic.

    endif # BT_HAS_PRESET_SUPPORT

endif # BT_HAS

config BT_HAS_CLIENT
    bool "Hearing Access Service Client support"
    help
        This option enables support for Hearing Access Service Client.
```

## components/bt/esp_ble_audio/Kconfig/Kconfig.mcs.in
```kconfig
# Bluetooth Audio - Media control configuration options

#
# SPDX-FileCopyrightText: 2020-2022 Nordic Semiconductor
#
# SPDX-License-Identifier: Apache-2.0
#

#### Media Control Service ################################

config BT_MCS
    bool "Media Control Service Support"
    depends on BT_MCTL_LOCAL_PLAYER_REMOTE_CONTROL
    help
        This option enables support for the Media Control Service.

#### Media Control Client ################################

config BT_MCC
    bool "Media Control Client Support"
    help
        This option enables support for the Media Control Client.

if BT_MCC

    config BT_MCC_MEDIA_PLAYER_NAME_MAX
        int "Max length of media player name"
        default 20
        range 1 255
        help
            Sets the maximum number of bytes (including the null termination) of
            the name of the media player. If the name is longer, the media
            control client will truncate the name when reading it.

    config BT_MCC_ICON_URL_MAX
        int "Max length of media player icon URL"
        default 40
        range 1 255
        help
            Sets the maximum number of bytes (including the null termination) of
            the media player icon URL. If the URL is longer, the media control
            client will truncate the name when reading it.

    config BT_MCC_TRACK_TITLE_MAX
        int "Max length of the title of a track"
        default 40
        range 1 255
        help
            Sets the maximum number of bytes (including the null termination) of
            the title of any track in the media player. If the title is longer,
            the media control client will truncate the title when reading it.

    config BT_MCC_SEGMENT_NAME_MAX
        int "Max length of the name of a track segment"
        default 25
        range 1 255
        help
            Sets the maximum number of bytes (including the null termination)
            of the name of any track segment in the media player. If the name is
            longer, the media control client will truncate the name when reading
            it.

    config BT_MCC_OTS
        bool "Media Control Client support for Object Transfer Service"
        select BT_OTS_CLIENT
        help
            Use this option to configure support in the Media Control Client for
            an included Object Transfer Service in the Media Control Service.

    if BT_MCC_OTS

        config BT_MCC_OTC_OBJ_BUF_SIZE
            int "The size of the buffer used for OTC object in MCC"
            default 512
            range 1 65536
            help
                Sets the size (in octets) of the buffer used for receiving the content
                of objects.
                Should be set large enough to fit any expected object.

        config BT_MCC_TOTAL_OBJ_CONTENT_MEM
            int "Total memory size to use for storing the content of objects"
            default 1
            range 0 65536
            help
                Sets the total memory size (in octets) to use for storing the content
                of objects.
                This is used for the total memory pool buffer size from which memory
                is allocated when reading object content.

        config BT_MCC_TRACK_SEGS_MAX_CNT
            int "Maximum number of tracks segments in a track segment object"
            default 25
            range 0 500
            help
                Sets the maximum number of tracks segments in a track segment object.
                If the received object is bigger, the remaining data in the object
                will be ignored.

        config BT_MCC_GROUP_RECORDS_MAX
            int "Maximum number of records in a group object"
            default 25
            range 0 500
            help
                Sets the maximum number of records in a group object. If the received
                group object has more records than this, the remaining records in the
                object will be ignored.

    endif # BT_MCC_OTS

    config BT_MCC_SHELL
        bool "Media Control Client Shell Support"
        help
            This option enables shell support for the Media Control Client.

    config BT_MCC_MINIMAL
        bool "Minimal Media Control Client without optional procedures"
        help
            This option disables all optional procedures in the Media Control Client.

    config BT_MCC_READ_MEDIA_PLAYER_ICON_URL
        bool "Support reading Media Player Icon URL"
        default y if !BT_MCC_MINIMAL
        help
            This option enables support for Read Media Information procedure
            optionally read the Media Player Icon URL.

    config BT_MCC_READ_TRACK_TITLE
        bool "Support reading Track Title"
        default y if !BT_MCC_MINIMAL
        help
            This option enables support for reading Track Title.

    config BT_MCC_READ_TRACK_TITLE_ENABLE_SUBSCRIPTION
        bool "Support to enable or disable the subscription of Track Title"
        default y if !BT_MCC_MINIMAL
        help
            This option enables support for the subscription of Track Title.

    config BT_MCC_READ_TRACK_DURATION
        bool "Support reading Track Duration"
        default y if !BT_MCC_MINIMAL
        help
            This option enables support for reading Track Duration.

    config BT_MCC_READ_TRACK_POSITION
        bool "Support reading Track Position"
        default y if !BT_MCC_MINIMAL
        help
            This option enables support for reading Track Position.

    config BT_MCC_SET_TRACK_POSITION
        bool "Support setting Track Position"
        default y if !BT_MCC_MINIMAL
        help
            This option enables support for setting Track Position.

    config BT_MCC_READ_PLAYBACK_SPEED
        bool "Support reading Playback Speed"
        default y if !BT_MCC_MINIMAL
        help
            This option enables support for reading Playback Speed.

    config BT_MCC_SET_PLAYBACK_SPEED
        bool "Support setting Playback Speed"
        default y if !BT_MCC_MINIMAL
        help
            This option enables support for setting Playback Speed.

    config BT_MCC_READ_SEEKING_SPEED
        bool "Support reading Seeking Speed"
        default y if !BT_MCC_MINIMAL
        help
            This option enables support for reading Seeking Speed.

    config BT_MCC_READ_PLAYING_ORDER
        bool "Support reading Playing Order"
        default y if !BT_MCC_MINIMAL
        help
            This option enables support for reading Playing Order.

    config BT_MCC_SET_PLAYING_ORDER
        bool "Support setting Playing Order"
        default y if !BT_MCC_MINIMAL
        help
            This option enables support for setting Playing Order.

    config BT_MCC_READ_PLAYING_ORDER_SUPPORTED
        bool "Support reading Playing Order Supported"
        default y if !BT_MCC_MINIMAL
        help
            This option enables support for reading Playing Order Supported.

    config BT_MCC_READ_MEDIA_STATE
        bool "Support reading Media State"
        default y if !BT_MCC_MINIMAL
        help
            This option enables support for reading Media State.

    config BT_MCC_SET_MEDIA_CONTROL_POINT
        bool "Support setting Media Control Point"
        default y if !BT_MCC_MINIMAL
        help
            This option enables support for setting Media Control Point.

    config BT_MCC_READ_MEDIA_CONTROL_POINT_OPCODES_SUPPORTED
        bool "Support reading Media Control Point Opcodes Supported"
        default y if !BT_MCC_MINIMAL
        help
            This option enables support for reading Media Control Point Opcodes Supported.

    config BT_MCC_READ_CONTENT_CONTROL_ID
        bool "Support reading Content Control ID"
        default y if !BT_MCC_MINIMAL
        help
            This option enables support for reading Content Control ID.

endif # BT_MCC
```
