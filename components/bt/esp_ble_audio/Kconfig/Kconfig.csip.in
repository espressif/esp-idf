## components/bt/esp_ble_audio/Kconfig/Kconfig.mctl.in
```kconfig
# Bluetooth Audio - Media control configuration options

#
# SPDX-FileCopyrightText: 2022 Nordic Semiconductor
#
# SPDX-License-Identifier: Apache-2.0
#

# TODO: Decide, and add, top-level namespace prefix (currently none) to symbols.
# Dependent upon where the module will be placed.

config BT_MCTL
    bool "Support for media player control"
    help
        Enables support for control of local and remote media players
        To enable support for control of a local media player, support for
        local media player must be enabled

if BT_MCTL

    config BT_MCTL_LOCAL_PLAYER_CONTROL
        bool "Support for control of local media player"
        help
            This option enables support for control of a local media player

    config BT_MCTL_LOCAL_PLAYER_LOCAL_CONTROL
        bool "Support for local control of local media player"
        default y
        depends on BT_MCTL_LOCAL_PLAYER_CONTROL
        help
            This option enables support for local application control of local
            media players

    config BT_MCTL_LOCAL_PLAYER_REMOTE_CONTROL
        bool "Support for remote control of local media players"
        depends on BT_MCTL_LOCAL_PLAYER_CONTROL
        help
            This option enables support for remote control of local media
            players.

    config BT_MCTL_REMOTE_PLAYER_CONTROL
        bool "Support for control of remote media player"
        default y
    # TODO: Remove dependency on BT_MCC once MCC has been reworked
        depends on BT_MCC
        help
            This options enables support for control of a remote media player.

    config BT_MCTL_REMOTE_PLAYER_CONTROL_OBJECTS
        bool "Support for accessing objects on remote player"
        depends on BT_MCTL_REMOTE_PLAYER_CONTROL
        default y
    # TODO: Remove dependency on BT_MCC_OTS once MCC has been reworked
        depends on BT_MCC_OTS
        help
            This options enables support for accessing objects (tracks, groups,
            search results, ...) on a remote media player

endif # BT_MCTL
```

## components/bt/esp_ble_audio/Kconfig/Kconfig.micp.in
```kconfig
# Bluetooth Audio - Microphone Control Service options
#
# SPDX-FileCopyrightText: 2020 Bose Corporation
# SPDX-FileCopyrightText: 2020-2022 Nordic Semiconductor ASA
#
# SPDX-License-Identifier: Apache-2.0
#

########### Microphone Control Profile Microphone Device ###########

config BT_MICP_MIC_DEV
    bool "Microphone Control Profile Microphone Device Support"
    help
        This option enables support for Microphone Control Profile
        Microphone Device.

if BT_MICP_MIC_DEV

    config BT_MICP_MIC_DEV_AICS_INSTANCE_COUNT
        int "Audio Input Control Service instance count for \
            Microphone Control Service Microphone Device"
        default 0
        range 0 BT_AICS_MAX_INSTANCE_COUNT
        help
            This option sets the number of instances of Audio Input Control
            Services for Microphone Control Profile Microphone Device.

    config BT_MICP_MIC_DEV_AICS
        bool # Hidden
        default y if BT_MICP_MIC_DEV_AICS_INSTANCE_COUNT > 0
        help
            This hidden option makes it possible to easily check if AICS is
            enabled for Microphone Control Profile Microphone Device.

endif # BT_MICP_MIC_DEV

########### Microphone Control Profile Microphone Controller ###########

config BT_MICP_MIC_CTLR
    bool "Microphone Control Profile Microphone Controller Support"
    help
        This option enables support for the Microphone Control Profile
        Microphone Controller role

if BT_MICP_MIC_CTLR

    config BT_MICP_MIC_CTLR_MAX_AICS_INST
        int "Maximum number of Audio Input Control Service instances to setup"
        default 0
        range 0 BT_AICS_CLIENT_MAX_INSTANCE_COUNT
        help
            Sets the maximum number of Audio Input Control Service (AICS)
            instances to setup and use.

    config BT_MICP_MIC_CTLR_AICS
        bool # Hidden
        default y if BT_MICP_MIC_CTLR_MAX_AICS_INST > 0
        help
            This hidden option makes it possible to easily check if AICS is
            enabled for MICP client.

endif # BT_MICP_MIC_CTLR
```

## components/bt/esp_ble_audio/Kconfig/Kconfig.mpl.in
```kconfig
# Bluetooth Audio - Media player configuration options

#
# SPDX-FileCopyrightText: 2022 Nordic Semiconductor
#
# SPDX-License-Identifier: Apache-2.0
#

config BT_MPL
    bool "Support for media player"
    help
        Enables support for media player
        Note that the provided media player is a sample that only provides a
        mock-up with no actual media being played.
        For real media playback, the sample must be extended, hooked up to a
        real media player or replaced with a real media player.

if BT_MPL

    config BT_MPL_MEDIA_PLAYER_NAME
        string "Media Player Name"
        default "Player0"
        help
            Use this option to set the name of the media player.

    config BT_MPL_MEDIA_PLAYER_NAME_MAX
        int "Max length of media player name"
        default 20
        range 1 255
        help
            Sets the maximum number of bytes (including the null termination) of
            the name of the media player.

    config BT_MPL_ICON_URL
        string "Media player Icon URL"
        default "http://server.some.where/path/icon.png"
        help
            Use this option to set the URL of the Media Player Icon.

    config BT_MPL_ICON_URL_MAX
        int "Max length of media player icon URL"
        default 40
        range 1 255
        help
            Sets the maximum number of bytes (including the null termination) of
            the media player icon URL.

    config BT_MPL_TRACK_TITLE_MAX
        int "Max length of the title of a track"
        default 40
        range 1 255
        help
            Sets the maximum number of bytes (including the null termination) of
            the title of any track in the media player.

    config BT_MPL_SEGMENT_NAME_MAX
        int "Max length of the name of a track segment"
        default 25
        range 1 255
        help
            Sets the maximum number of bytes (including the null termination)
            of the name of any track segment in the media player.

    config BT_MPL_GROUP_TITLE_MAX
        int "Max length of the title of a group of tracks"
        default BT_MPL_TRACK_TITLE_MAX
        range 1 255
        help
            Sets the maximum number of bytes (including the null termination) of
            the title of any group in the media player.

    config BT_MPL_OBJECTS
        bool "Support for media player objects"
        select BT_OTS
    # TODO: Temporarily depends also on BT_MCS, to avoid issues with the
    # bt_mcs_get_ots() call. BT_MCS stays as `depends on` because it has
    # non-leaf prerequisites (BT_MCTL_LOCAL_PLAYER_REMOTE_CONTROL ...).
        depends on BT_MCS
    # OTS shall be instantiated as a Secondary Service and shall be
    # included in MCS or GMCS.
        help
            Enables support for objects in the media player
            Objects are used to give/get more information about e.g. media tracks.
            Requires the Object Transfer Service

    if BT_MPL_OBJECTS

        config BT_MPL_MAX_OBJ_SIZE
            int "Total memory size to use for storing the content of objects"
            default 127
            range 0 65536
            help
                Sets the total memory size (in octets) to use for storing the content of objects.
                This is used for the total memory pool buffer size from which memory
                is allocated when sending object content.

        config BT_MPL_ICON_BITMAP_SIZE
            int "Media player Icon bitmap object size"
            default 127
            help
                This option sets the maximum size (in octets) of the icon object.

        config BT_MPL_TRACK_MAX_SIZE
            int "Maximum size for a track object"
            default 127
            help
                This option sets the maximum size (in octets) of a track object.

    endif # BT_MPL_OBJECTS

endif # BT_MPL
```

## components/bt/esp_ble_audio/Kconfig/Kconfig.pacs.in
```kconfig
# Bluetooth Audio - Published Audio Capabilities configuration options
#
# SPDX-FileCopyrightText: 2022 Nordic Semiconductor ASA

# SPDX-License-Identifier: Apache-2.0
#

config BT_PAC_SNK
    bool "Sink PAC Characteristic Support"
    help
        This option enables support for Sink Published Audio Capabilities.

if BT_PAC_SNK

    config BT_PAC_SNK_NOTIFIABLE
        bool "Sink PAC Notifiable Support"
        help
            This option enables support for clients to be notified on the Sink
            PAC Characteristic changes.

    config BT_PAC_SNK_LOC
        bool "Sink PAC Location Support"
        default y
        help
            This option enables support for Sink PAC Location Characteristic.

    config BT_PAC_SNK_LOC_WRITEABLE
        bool "Sink PAC Location Writable Support"
        depends on BT_PAC_SNK_LOC
        help
            This option enables support for clients to write to the Sink PAC
            Location Characteristic.

    config BT_PAC_SNK_LOC_NOTIFIABLE
        bool "Sink Audio Location Notifiable Support"
        depends on BT_PAC_SNK_LOC
        help
            This option enables support for clients to be notified on the Sink
            Audio Location Characteristic changes.

endif # BT_PACS_SNK

config BT_PAC_SRC
    bool "Source PAC Characteristic Support"
    help
        This option enables support for Source Published Audio Capabilities.

if BT_PAC_SRC

    config BT_PAC_SRC_NOTIFIABLE
        bool "Source PAC Notifiable Support"
        help
            This option enables support for clients to be notified on the Source
            PAC Characteristic changes.

    config BT_PAC_SRC_LOC
        bool "Source PAC Location Support"
        default y
        help
            This option enables support for Source PAC Location Characteristic.

    config BT_PAC_SRC_LOC_WRITEABLE
        bool "Source PAC Location Writable Support"
        depends on BT_PAC_SRC_LOC
        help
            This option enables support for clients to write to the Source PAC
            Location Characteristic.

    config BT_PAC_SRC_LOC_NOTIFIABLE
        bool "Source Audio Location Notifiable Support"
        depends on BT_PAC_SRC_LOC
        help
            This option enables support for clients to be notified on the Source
            Audio Location Characteristic changes.

endif # BT_PAC_SRC

config BT_PACS
    bool # hidden
    default y if BT_PAC_SNK || BT_PAC_SRC

config BT_PACS_SUPPORTED_CONTEXT_NOTIFIABLE
    bool "Supported Audio Context Notifiable Support"
    depends on BT_PACS
    help
        This option enables support for clients to be notified on the
        Supported Audio Contexts Characteristic changes.
```

## components/bt/esp_ble_audio/Kconfig/Kconfig.pbp.in
```kconfig
# Bluetooth Audio - Public Broadcast Profile (PBP) options
#
# SPDX-FileCopyrightText: 2023 NXP
#
# SPDX-License-Identifier: Apache-2.0
#

config BT_PBP
    bool "Public Broadcast Profile"
    help
        Enabling this will enable PBP.
```
