## components/bt/common/ble_log/Kconfig.in
```kconfig
config BLE_LOG_ENABLED
    bool "Enable BT Log Async Output (Dev Only)"
    select BLE_COMPRESSED_LOG_ENABLE
    select BLE_HOST_COMPRESSED_LOG_ENABLE if BT_BLUEDROID_ENABLED || BT_NIMBLE_ENABLED
    select ESP_TIMER_IN_IRAM
    default n
    help
        Enable BT Log Async Output

if BLE_LOG_ENABLED
    config BLE_LOG_POOL_TRANS_CNT
        int "Number of transport buffers in the unified pool"
        range 2 32
        default 8
        help
            Total number of transports shared by ordinary, Link Layer, ISR,
            and critical-section log writers. Availability is represented by
            32-bit bitmaps, so the maximum is 32.

    config BLE_LOG_POOL_NON_YIELD_RESERVE_CNT
        int "Transport buffers reserved for non-yieldable contexts"
        range 1 31
        default 1
        help
            Buffers that ordinary task writers cannot consume. ISR and
            critical-section writers try the shared region first, then this
            reserve. The value must remain below BLE_LOG_POOL_TRANS_CNT.

    config BLE_LOG_POOL_TRANS_SIZE
        int "Per-transport buffer size (bytes)"
        range 640 10240
        default 640
        help
            Size of every unified-pool transport. One complete frame must fit
            in one transport. SPI builds require a multiple of four so they
            can append peripheral-only zero padding to each logical frame.

    config BLE_LOG_IS_ESP_CONTROLLER
        bool "Current BLE Controller is ESP BLE Controller"
        depends on BT_CONTROLLER_ENABLED
        depends on SOC_ESP_NIMBLE_CONTROLLER
        default y
        select BT_LE_CONTROLLER_LOG_ENABLED
        select BLE_LOG_LL_ENABLED
        help
            Current BLE Controller is ESP BLE Controller

    config BLE_LOG_IS_ESP_LEGACY_CONTROLLER
        bool "Current BLE Controller is ESP BLE Legacy Controller"
        depends on BT_CONTROLLER_ENABLED
        depends on !SOC_ESP_NIMBLE_CONTROLLER
        default y
        help
            Current BLE Controller is ESP BLE Legacy Controller

    config BLE_LOG_LL_ENABLED
        bool "Enable BLE Log for Link Layer"
        depends on BT_CONTROLLER_ENABLED
        default y if BLE_LOG_IS_ESP_LEGACY_CONTROLLER
        default n
        help
            Enable BLE Log for Link Layer

    config BLE_LOG_HOST_LOG
        bool "Enable BLE Log for Host"
        depends on BT_BLUEDROID_ENABLED || BT_NIMBLE_ENABLED
        default y
        help
            Enable BLE Log for the Host stack (Bluedroid or NimBLE).

            When enabled, host-side log statements are routed through the
            BLE Log async output transport instead of (or in addition to)
            the standard UART logging path. Disable this option to keep
            BLE Log enabled for the controller/link layer only.

    config BLE_LOG_HCI_LOG_ENABLED
        bool "Enable BLE HCI Logging"
        default y
        help
            Enable HCI packet logging. Bluedroid and legacy VHCI NimBLE
            capture on the Host side and suppress duplicate Controller
            HCI records. Other configurations, including non-legacy
            NimBLE, retain Controller HCI records through the LL callback
            and require BLE_LOG_LL_ENABLED. Disabling this option
            suppresses HCI records from both capture paths.

    config BLE_LOG_HOST_SIDE_HCI_LOG_ENABLED
        bool "Enable BLE Host side HCI Logging"
        default n
        select BLE_LOG_HCI_LOG_ENABLED
        help
            Deprecated. Renamed to BLE_LOG_HCI_LOG_ENABLED; kept so sdkconfig
            files pinning the old name keep Host side HCI logging enabled.

    config BLE_LOG_TS_SYNC_TOGGLE_IO_ENABLED
        bool "Toggle a GPIO on every BLE Log TS sync sample"
        default n
        help
            Every periodic Internal Snapshot samples the link-layer, ESP and
            OS clocks regardless of this option. Enable this option to build
            the GPIO toggle used by external logic analyzers. It starts
            disabled and low; ble_log_ts_sync_io_toggle_enable controls its
            edges without stopping periodic snapshots.

    if BLE_LOG_TS_SYNC_TOGGLE_IO_ENABLED
        config BLE_LOG_SYNC_IO_NUM
            int "GPIO number for Timestamp Synchronization (TS) toggle output"
            default 0
            help
                GPIO number for TS toggle output
    endif

    choice BLE_LOG_PRPH_CHOICE
        prompt "BLE Log peripheral choice"
        default BLE_LOG_PRPH_UART_DMA if SOC_UHCI_SUPPORTED
        default BLE_LOG_PRPH_DUMMY
        help
            Choose BLE Log peripheral

        config BLE_LOG_PRPH_DUMMY
            bool "Dummy transport"
            help
                Dummy transport (dump only)

        config BLE_LOG_PRPH_TEST
            bool "Test only transport"
            help
                Test transport that models DMA ownership and optional
                link-rate backpressure. Intended for the BLE Log test apps
                only: outside them nothing drains the transmitted buffers,
                so selecting this transport in a production build stalls
                log output. The BLE Log test apps select it through their
                sdkconfig.defaults.

        config BLE_LOG_PRPH_SPI_MASTER_DMA
            bool "Utilize SPI master DMA driver as transport"
            depends on SOC_GPSPI_SUPPORTED
            help
                Utilize SPI master DMA driver as transport

        config BLE_LOG_PRPH_SPI_MASTER_HD
            bool "Utilize SPI master HD DMA protocol as transport"
            depends on SOC_GPSPI_SUPPORTED && SOC_SPI_SUPPORT_SLAVE_HD_VER2
            help
                Utilize SPI master HD DMA protocol as transport

        config BLE_LOG_PRPH_UART_DMA
            bool "Utilize UART DMA driver as transport"
            depends on SOC_UHCI_SUPPORTED
            help
                Utilize UART DMA driver as transport
    endchoice

    if BLE_LOG_PRPH_SPI_MASTER_DMA || BLE_LOG_PRPH_SPI_MASTER_HD
        config BLE_LOG_PRPH_SPI_MASTER_DMA_MOSI_IO_NUM
            int "GPIO number of MOSI port for SPI master transport (-1: native SPI2 IOMUX)"
            default -1
            help
                GPIO number of MOSI port for SPI master transport. Set to -1
                to use the target's native SPI2 IOMUX pin.

        config BLE_LOG_PRPH_SPI_MASTER_DMA_SCLK_IO_NUM
            int "GPIO number of SCLK port for SPI master transport (-1: native SPI2 IOMUX)"
            default -1
            help
                GPIO number of SCLK port for SPI master transport. Set to -1
                to use the target's native SPI2 IOMUX pin.

        config BLE_LOG_PRPH_SPI_MASTER_DMA_CS_IO_NUM
            int "GPIO number of CS port for SPI master transport (-1: native SPI2 IOMUX)"
            default -1
            help
                GPIO number of CS port for SPI master transport. Set to -1 to
                use the target's native SPI2 IOMUX pin.
    endif

    if BLE_LOG_PRPH_UART_DMA
        config BLE_LOG_PRPH_UART_DMA_PORT
            int "UART port number for UART DMA transport"
            default 0
            help
                UART port number for UART DMA

        config BLE_LOG_PRPH_UART_DMA_BAUD_RATE
            int "Baud rate of UART port for UART DMA transport"
            default 3000000
            help
                Determine the baud rate of UART port

        config BLE_LOG_PRPH_UART_DMA_TX_IO_NUM
            int "GPIO number for UART TX"
            default 0
            help
                GPIO number for UART TX
    endif

    menu "Settings of BLE Log Compression"
        source "$IDF_PATH/components/bt/common/ble_log/extension/log_compression/Kconfig.in"
    endmenu

    # Deprecated options -- retained for backward sdkconfig compatibility.
    # These symbols have no prompt so they never appear in menuconfig.
    config BLE_LOG_LBM_TRANS_SIZE
        int
        default 512

    config BLE_LOG_LBM_TRANS_BUF_SIZE
        int
        default 2048

    config BLE_LOG_LBM_ATOMIC_LOCK_TASK_CNT
        int
        default 2

    config BLE_LOG_LBM_ATOMIC_LOCK_ISR_CNT
        int
        default 1

    config BLE_LOG_LBM_LL_TRANS_BUF_SIZE
        int
        default 2048

    config BLE_LOG_LL_HCI_LOG_PAYLOAD_LEN_LIMIT_ENABLED
        bool
        default n

    config BLE_LOG_LL_HCI_LOG_PAYLOAD_LEN_LIMIT
        int
        depends on BLE_LOG_LL_HCI_LOG_PAYLOAD_LEN_LIMIT_ENABLED
        default 32

    config BLE_LOG_LBM_AUTO_FLUSH
        bool
        default n

    config BLE_LOG_ENH_STAT_ENABLED
        bool
        default y

    config BLE_LOG_PAYLOAD_CHECKSUM_ENABLED
        bool
        default y

    config BLE_LOG_LBM_LL_TRANS_SIZE
        int
        default 512

    config BLE_LOG_TASK_STACK_SIZE
        int
        default 1024 if IDF_TARGET_ARCH_RISCV
        default 2048 if IDF_TARGET_ARCH_XTENSA
        default 1024

    config BLE_LOG_TS_TRIGGER_TIMEOUT_MS
        int
        default 1000

    config BLE_LOG_TS_TRIGGER_CHOICE
        bool
        default y

    config BLE_LOG_TS_TRIGGER_ESP_TIMER
        bool
        default y

    config BLE_LOG_TS_TRIGGER_TASK_EVENT
        bool
        default n

    config BLE_LOG_TS_TRIGGER_ESP_TIMER_ISR_DISPATCH_METHOD
        bool
        default n
endif

menu "Legacy SPI Log Output (Deprecated - use BT Log Async Output instead)"
    source "$IDF_PATH/components/bt/common/ble_log/deprecated/Kconfig.in"
endmenu
```

## components/bt/common/ble_log/test_apps/ble_log_lifecycle_test/sdkconfig.defaults
```kconfig
CONFIG_BT_ENABLED=y
CONFIG_BT_CONTROLLER_ONLY=y
CONFIG_BLE_LOG_ENABLED=y
CONFIG_BLE_LOG_PRPH_TEST=y
CONFIG_BLE_LOG_POOL_WAIT_TIMEOUT_MS=-1
CONFIG_BT_LE_CONTROLLER_LOG_MODE_BLE_LOG_V2=y
CONFIG_ESP_CONSOLE_UART_DEFAULT=y
CONFIG_ESP_TASK_WDT_CHECK_IDLE_TASK_CPU0=n
CONFIG_ESP_TASK_WDT_CHECK_IDLE_TASK_CPU1=n
```

## components/bt/common/ble_log/test_apps/ble_log_usb_test/main/Kconfig.projbuild
```kconfig
# SPDX-FileCopyrightText: 2026 Espressif Systems (Shanghai) CO LTD
#
# SPDX-License-Identifier: CC0-1.0

menu "BLE Log USB test app"
    config BLE_LOG_USB_TEST_PERF_MODE
        bool "Throughput test mode (back-to-back writes)"
        default n
        help
            Replace the 100 ms smoke writer with a CPU-bound write loop
            for throughput measurement. The host-side parser measures
            the delivered MB/s, frame checksums, and SN continuity.

    if BLE_LOG_USB_TEST_PERF_MODE
        config BLE_LOG_USB_TEST_PERF_PAYLOAD_LEN
            int "Perf payload length (bytes)"
            range 6 620
            default 128
            help
                Payload written per frame in perf mode. 6 bytes hold the
                host-side sequence and marker; BLE Log caps a single
                record at 640 transport bytes minus header, timestamp,
                and checksum.

        config BLE_LOG_USB_TEST_PERF_DURATION_S
            int "Perf run duration (seconds)"
            range 5 300
            default 30
    endif

    config BLE_LOG_USB_TEST_LIFECYCLE_MODE
        bool "Dispatcher teardown interleaving check"
        default n
        depends on !BLE_LOG_USB_TEST_PERF_MODE && !BLE_LOG_USB_TEST_RAW_PIPE_MODE
        help
            Deterministic regression for the USB dispatcher teardown. The
            pre-send test hook parks the dispatch task while it owns one
            transport and the queue is empty, then deinit runs from a second
            task. The check fails if deinit completes (tearing down the pool
            and the peripheral) while that dispatch call is still parked, or
            if the parked call never finishes. Prints TEST PASS, or TEST FAIL
            followed by an abort. No host and no USB traffic needed.

    config BLE_LOG_USB_TEST_RAW_PIPE_MODE
        bool "Raw USB pipe throughput mode (no BLE Log runtime)"
        default n
        depends on !BLE_LOG_USB_TEST_PERF_MODE
        help
            Install only the TinyUSB CDC device and stream fixed
            640-byte blocks from a dedicated task straight into the
            CDC TX FIFO. Isolates the USB path (no LBM pool, no
            ESP timer dispatch) so the host can attribute the gap
            between raw-pipe and BLE Log throughput.
endmenu
```

## components/bt/common/ble_log/test_apps/ble_log_usb_test/sdkconfig.defaults
```kconfig
CONFIG_BT_ENABLED=y
CONFIG_BLE_LOG_ENABLED=y
CONFIG_BLE_LOG_PRPH_USB=y
CONFIG_BLE_LOG_USB_CDC_TX_BUFSIZE=2048
CONFIG_BLE_LOG_USB_CDC_EP_BUFSIZE=512
CONFIG_TINYUSB_CDC_ENABLED=y
CONFIG_TINYUSB_CDC_COUNT=1
CONFIG_TINYUSB_CDC_RX_BUFSIZE=512
CONFIG_TINYUSB_CDC_TX_BUFSIZE=2048
CONFIG_TINYUSB_CDC_EP_BUFSIZE=512
```

## components/bt/common/ble_log/test_apps/ble_log_usj_test/main/Kconfig.projbuild
```kconfig
# SPDX-FileCopyrightText: 2026 Espressif Systems (Shanghai) CO LTD
#
# SPDX-License-Identifier: CC0-1.0

menu "BLE Log USJ test app"
    config BLE_LOG_USJ_TEST_PERF_MODE
        bool "Throughput test mode (back-to-back writes)"
        default n
        help
            Replace the 100 ms smoke writer with a CPU-bound write loop
            for throughput measurement. The host-side parser measures
            the delivered KiB/s, frame checksums, and SN continuity.

    if BLE_LOG_USJ_TEST_PERF_MODE
        config BLE_LOG_USJ_TEST_PERF_PAYLOAD_LEN
            int "Perf payload length (bytes)"
            range 6 620
            default 128
            help
                Payload written per frame in perf mode. 6 bytes hold the
                host-side sequence and marker; BLE Log caps a single
                record at 640 transport bytes minus header, timestamp,
                and checksum.

        config BLE_LOG_USJ_TEST_PERF_DURATION_S
            int "Perf run duration (seconds)"
            range 5 300
            default 30
    endif
endmenu
```

## components/bt/common/ble_log/test_apps/ble_log_usj_test/sdkconfig.defaults
```kconfig
CONFIG_BT_ENABLED=y
CONFIG_BLE_LOG_ENABLED=y
CONFIG_ESP_CONSOLE_UART_DEFAULT=y
CONFIG_ESP_CONSOLE_SECONDARY_NONE=y
CONFIG_BLE_LOG_PRPH_USB_SERIAL_JTAG=y
```

## components/bt/controller/esp32h4/Kconfig.in
```kconfig
source "$IDF_PATH/components/bt/porting_btdm/Kconfig.in"

config BT_CTRL_SUPPORT_ETM_WAKEUP
    bool
    default y
```

## components/bt/controller/esp32s31/Kconfig.in
```kconfig
source "$IDF_PATH/components/bt/porting_btdm/Kconfig.in"

config BT_CTRL_MULTI_LINK_ENABLED
    bool
    default y

config BT_CTRL_LE_SUPPORT_MEM_RES
    bool
    default y
```
