## components/bt/ble_profiles/common/Kconfig.in
```kconfig
config BT_PRF_TASK_ENABLED
    bool "Enable the shared BLE profile task (event queue worker)"
    depends on BT_ENABLED
    default n
    help
        Build the shared BLE profile task: a single process-wide event queue
        served by one dedicated FreeRTOS task, onto which BLE profiles post
        short, non-blocking handlers instead of each spawning its own task.

        Host-agnostic (depends only on the BT OSAL and FreeRTOS), so both the
        Bluedroid and NimBLE hosts can use it. A profile that relies on the
        shared task should "select BT_PRF_TASK_ENABLED" in its own Kconfig.

config BT_PRF_TASK_STACK_SIZE
    int "Shared BLE profile task stack size (bytes)"
    depends on BT_PRF_TASK_ENABLED
    range 2048 16384
    default 3072
    help
        Stack size, in bytes, of the shared BLE profile task. It must be large
        enough for the deepest profile handler posted to the queue; raise it if
        a handler needs more stack.

config BT_PRF_TASK_PRIORITY
    int "Shared BLE profile task priority"
    depends on BT_PRF_TASK_ENABLED
    range 1 24
    default 5
    help
        FreeRTOS priority of the shared BLE profile task. Keep it below the BLE
        host task so profile handling never starves the protocol stack.

config BT_PRF_TASK_CORE_ID
    int "Shared BLE profile task core affinity"
    depends on BT_PRF_TASK_ENABLED
    range -1 0 if FREERTOS_UNICORE
    range -1 1
    default 0
    help
        Core the shared BLE profile task is pinned to: 0 for CPU0, 1 for CPU1,
        or -1 to leave it unpinned so the scheduler may run it on either core.

        On a single-core target the only valid values are 0 and -1. Pinning the
        task to the core that does not run the BLE host can keep profile
        handlers from competing with the protocol stack for CPU time.
```

## components/bt/ble_profiles/nimble/ble_esl/Kconfig.in
```kconfig
menu "Electronic Shelf Label (ESL) (EXPERIMENTAL)"

    config BLE_ESL_ENABLED
        bool "Enable Electronic Shelf Label (ESL) (EXPERIMENTAL)"
        depends on BT_NIMBLE_ENABLED
        depends on IDF_EXPERIMENTAL_FEATURES
        default n
        help
            Build the Electronic Shelf Label profile core on top of the NimBLE
            host. The Tag and Access Point roles are selected separately below,
            so a device only pays for the role it actually implements.

            Both roles exchange commands over Periodic Advertising with
            Responses (PAwR). Display images are transferred over the Object
            Transfer Service, which is selected automatically when needed.

            Note: this profile is experimental. Its public API, Kconfig option
            names and event layout may change without notice in future releases,
            and it is not recommended for production use yet. Enable
            IDF_EXPERIMENTAL_FEATURES to make this option selectable.

    config BLE_ESL_TAG_ROLE
        bool "Enable ESL Tag role"
        depends on BLE_ESL_ENABLED
        default n
        help
            Enable the Electronic Shelf Label (ESL) Tag role.
            When enabled, the device can operate as an ESL tag that
            receives commands from an Access Point over PAwR.

    config BLE_ESL_AP_ROLE
        bool "Enable ESL Access Point role"
        depends on BLE_ESL_ENABLED
        default n
        select BLE_OTS_ENABLED
        select BLE_OTS_CLIENT_ENABLED
        help
            Enable the Electronic Shelf Label (ESL) Access Point role.
            When enabled, the device can operate as an AP that manages
            and synchronises ESL tags via PAwR. The AP always pulls in
            the OTS client, which it uses to push images to the tags.

    menu "Access Point Configuration"
        depends on BLE_ESL_AP_ROLE

        config BLE_ESL_AP_MAX_CONNECTIONS
            int "Maximum simultaneous ACL connections"
            default 8
            range 1 BT_NIMBLE_MAX_CONNECTIONS
            help
                Maximum number of simultaneous ACL connections to ESL
                devices. Increasing this value allows the AP to configure
                more tags in parallel but consumes additional memory and
                radio time. Must not exceed the NimBLE connection limit.

        config BLE_ESL_AP_MAX_ESLS
            int "Maximum number of tracked ESLs"
            default 100
            range 1 65535
            help
                Maximum number of ESL tags tracked across all states
                (unassociated, synchronising, synchronised, etc.).
                Increase this if the deployment manages a large number
                of tags. Each tracked ESL consumes a small amount of
                heap memory.

    endmenu

    menu "Tag Configuration"
        depends on BLE_ESL_TAG_ROLE

        config BLE_ESL_MAX_DISPLAYS
            int "Maximum number of displays"
            default 1
            range 0 255
            help
                Maximum number of display devices exposed by the ESL tag.
                Set this to match the actual number of e-ink or other
                displays attached to the hardware.

        config BLE_ESL_MAX_IMAGES
            int "Maximum number of stored images"
            default 4
            range 1 255
            help
                Maximum number of images that can be stored on the tag.
                This determines the number of OTS objects available for
                image transfer. Increasing this value requires more
                storage space (flash or RAM).

        config BLE_ESL_MAX_LEDS
            int "Maximum number of LEDs"
            default 1
            range 0 255
            help
                Maximum number of LEDs exposed by the ESL tag. Set this
                to match the actual number of controllable LEDs on the
                hardware.

        config BLE_ESL_MAX_SENSORS
            int "Maximum number of sensors"
            default 1
            range 0 255
            help
                Maximum number of sensors exposed by the ESL tag (e.g.
                temperature, battery voltage). Set this to match the
                actual number of sensors available on the hardware.

        config BLE_ESL_OTS_SUPPORT
            bool "Enable OTP Object Server for image storage"
            default y
            select BLE_OTS_ENABLED
            select BLE_OTS_SERVER_ENABLED
            help
                Enable the Object Transfer Protocol (OTP) server so the
                AP can push display images to this tag over GATT. Disable
                this only if the tag has no display or images are
                provisioned by other means.

        config BLE_ESL_MAX_IMAGE_SIZE
            int "Maximum image size (bytes)"
            depends on BLE_ESL_OTS_SUPPORT
            default 4096
            range 1 4194304
            help
                Maximum size in octets reserved for each stored image
                object (its OTS Allocated Size). An OACP Write is rejected
                with Invalid Parameter when Offset + Length exceeds this
                value, since the tag does not support the OACP Append
                feature. Set this to the largest image the display can
                hold. The underlying data buffer is still allocated on
                demand, so this value only sets the accepted write limit.

        config BLE_ESL_VENDOR_SPECIFIC
            bool "Enable vendor-specific opcode support"
            default n
            help
                Enable handling of vendor-specific ESL opcodes. When
                enabled, the tag advertises a PnP ID in the Device
                Information Service (DIS) and accepts vendor-defined
                commands. Enable this if custom, manufacturer-specific
                ESL operations are required.

    endmenu

endmenu
```

## components/bt/ble_profiles/nimble/ble_ots/Kconfig.in
```kconfig
menu "Object Transfer Service (OTS) (EXPERIMENTAL)"

    config BLE_OTS_ENABLED
        bool "Enable Object Transfer Service (OTS) (EXPERIMENTAL)"
        depends on BT_NIMBLE_ENABLED && (BT_NIMBLE_L2CAP_COC_MAX_NUM >= 1)
        depends on IDF_EXPERIMENTAL_FEATURES
        default n
        help
            Build the Object Transfer Service profile core on top of the NimBLE
            host. The client and server roles are selected separately below, so a
            device only pays for the role it actually implements.
            Object contents are transferred over an L2CAP connection oriented
            channel, so BT_NIMBLE_L2CAP_COC_MAX_NUM must be set to at least 1.

            Note: this profile is experimental. Its public API, Kconfig option
            names and event layout may change without notice in future releases,
            and it is not recommended for production use yet. Enable
            IDF_EXPERIMENTAL_FEATURES to make this option selectable.

    menu "OTS Client"

        config BLE_OTS_CLIENT_ENABLED
            bool "Enable OTS Client"
            default n
            depends on BLE_OTS_ENABLED
            help
                Enable the Object Transfer Service Client component.
                When disabled, no OTS client code is compiled in, saving
                flash and RAM on devices that act only as OTS servers.

        config BLE_OTS_CLIENT_OACP_TIMEOUT_MS
            int "OACP response timeout (ms)"
            default 30000
            depends on BLE_OTS_CLIENT_ENABLED
            range 1000 120000
            help
                Maximum time in milliseconds to wait for an OACP
                control-point response indication (T_OACP) before
                reporting a CP_TIMEOUT event. Increase this value on
                links with high latency or when the server performs
                slow storage operations.

        config BLE_OTS_CLIENT_OLCP_TIMEOUT_MS
            int "OLCP response timeout (ms)"
            default 30000
            depends on BLE_OTS_CLIENT_ENABLED
            range 1000 120000
            help
                Maximum time in milliseconds to wait for an OLCP
                control-point response indication (T_OLCP) before
                reporting a CP_TIMEOUT event. Increase this value if
                the server's object list is very large and sorting or
                filtering takes significant time.

        config BLE_OTS_CLIENT_TRANSFER_TIMEOUT_MS
            int "Transfer inactivity timeout (ms)"
            default 30000
            depends on BLE_OTS_CLIENT_ENABLED
            range 1000 120000
            help
                Inactivity timeout in milliseconds for the Object
                Transfer Channel. If no data is sent or received within
                this period a TRANSFER_TIMEOUT event is raised. Raise
                this value for very large objects over slow links.

        config BLE_OTS_CLIENT_MAX_NAME_LEN
            int "Maximum Object Name length (octets)"
            default 120
            depends on BLE_OTS_CLIENT_ENABLED
            range 1 512
            help
                Maximum length of an Object Name string in octets.
                This controls the size of internal buffers used when
                reading or writing the Object Name characteristic.
                The Bluetooth specification allows up to 120 octets;
                increase only if the server uses a vendor extension.

    endmenu

    menu "OTS Server"

        config BLE_OTS_SERVER_ENABLED
            bool "Enable OTS Server"
            default n
            depends on BLE_OTS_ENABLED
            help
                Enable the Object Transfer Service Server component.
                When disabled, no OTS server code is compiled in, saving
                flash and RAM on devices that act only as OTS clients.

        config BLE_OTS_SERVER_MAX_OBJECTS
            int "Maximum number of objects"
            default 10
            depends on BLE_OTS_SERVER_ENABLED
            range 1 255
            help
                Maximum number of objects the server can store in its
                internal database at the same time. Each object slot
                consumes RAM for metadata and content storage. Lower
                this value on memory-constrained devices.

        config BLE_OTS_SERVER_MAX_CONCURRENCY
            int "Maximum concurrent client connections"
            default 1
            depends on BLE_OTS_SERVER_ENABLED
            range 1 16
            help
                Maximum number of client connections that can perform
                object operations concurrently. Each concurrent slot
                allocates per-connection state (current object, filters,
                transfer context). Set this to the expected peak number
                of simultaneous BLE connections.

        config BLE_OTS_SERVER_TRANSFER_TIMEOUT_SEC
            int "Transfer inactivity timeout (seconds)"
            default 30
            depends on BLE_OTS_SERVER_ENABLED
            range 1 300
            help
                Inactivity timeout in seconds for object read and write
                transfers over the Object Transfer Channel. If no data
                is exchanged within this period the transfer is aborted
                and the object lock is released. Increase for very large
                objects or slow links.

    endmenu

endmenu
```
