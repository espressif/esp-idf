## components/bt/test_apps/basic_unit_test/sdkconfig.defaults
```kconfig
CONFIG_BT_ENABLED=y
CONFIG_BT_PRF_TASK_ENABLED=y
CONFIG_ESP_TASK_WDT_CHECK_IDLE_TASK_CPU0=n
```

## components/esp_common/test_apps/linux_check/sdkconfig.defaults
```kconfig
CONFIG_IDF_TARGET="linux"
CONFIG_COMPILER_OPTIMIZATION_CHECKS_ADDRESS_ONLY=y
CONFIG_COMPILER_OPTIMIZATION_SIZE=y
```
