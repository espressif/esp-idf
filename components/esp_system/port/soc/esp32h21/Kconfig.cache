## components/esp_system/port/soc/esp32h21/Kconfig.cache
```kconfig
menu "Cache config"

    config CACHE_L1_CACHE_SIZE
        hex
        default 0x4000

    config CACHE_L1_CACHE_LINE_SIZE
        int
        default 32

endmenu  # Cache config
```

## components/esp_system/port/soc/esp32h21/Kconfig.cpu
```kconfig
choice ESP_DEFAULT_CPU_FREQ_MHZ
    prompt "CPU frequency"
    default ESP_DEFAULT_CPU_FREQ_MHZ_32 if IDF_ENV_FPGA || ESP_BRINGUP_BYPASS_CPU_CLK_SETTING
    default ESP_DEFAULT_CPU_FREQ_MHZ_96
    help
        CPU frequency to be set on application startup.

    config ESP_DEFAULT_CPU_FREQ_MHZ_32
        bool "32 MHz"
        depends on IDF_ENV_FPGA || ESP_BRINGUP_BYPASS_CPU_CLK_SETTING
    config ESP_DEFAULT_CPU_FREQ_MHZ_48
        bool "48 MHz"
        depends on !IDF_ENV_FPGA
    config ESP_DEFAULT_CPU_FREQ_MHZ_64
        bool "64 MHz"
    config ESP_DEFAULT_CPU_FREQ_MHZ_96
        bool "96 MHz"
        depends on !IDF_ENV_FPGA
endchoice

config ESP_DEFAULT_CPU_FREQ_MHZ
    int
    default 32 if ESP_DEFAULT_CPU_FREQ_MHZ_32
    default 48 if ESP_DEFAULT_CPU_FREQ_MHZ_48
    default 64 if ESP_DEFAULT_CPU_FREQ_MHZ_64
    default 96 if ESP_DEFAULT_CPU_FREQ_MHZ_96
```

## components/esp_system/port/soc/esp32h4/Kconfig.cache
```kconfig
menu "Cache config"

    config CACHE_L1_ICACHE_SIZE
        hex
        default 0x4000

    config CACHE_L1_DCACHE_SIZE
        hex
        default 0x8000

    config CACHE_L1_ICACHE_LINE_SIZE
        int
        default 32

    config CACHE_L1_DCACHE_LINE_SIZE
        int
        default 32

endmenu  # Cache config
```

## components/esp_system/port/soc/esp32h4/Kconfig.cpu
```kconfig
choice ESP_DEFAULT_CPU_FREQ_MHZ
    prompt "CPU frequency"
    default ESP_DEFAULT_CPU_FREQ_MHZ_32 if IDF_ENV_FPGA
    help
        CPU frequency to be set on application startup.

    config ESP_DEFAULT_CPU_FREQ_MHZ_32
        bool "32 MHz"
        depends on IDF_ENV_FPGA
    config ESP_DEFAULT_CPU_FREQ_MHZ_64
        bool "64 MHz"
endchoice

config ESP_DEFAULT_CPU_FREQ_MHZ
    int
    default 32 if ESP_DEFAULT_CPU_FREQ_MHZ_32
    default 64 if ESP_DEFAULT_CPU_FREQ_MHZ_64
```

## components/esp_system/port/soc/esp32p4/Kconfig.cache
```kconfig
menu "Cache config"

    choice CACHE_L2_CACHE_SIZE
        prompt "L2 cache size"
        default CACHE_L2_CACHE_128KB
        help
            L2 cache size to be set on application startup.

        config CACHE_L2_CACHE_128KB
            bool "128KB"
        config CACHE_L2_CACHE_256KB
            bool "256KB"
        config CACHE_L2_CACHE_512KB
            bool "512KB"
    endchoice

    config CACHE_L2_CACHE_SIZE
        hex
        default 0x20000 if CACHE_L2_CACHE_128KB
        default 0x40000 if CACHE_L2_CACHE_256KB
        default 0x80000 if CACHE_L2_CACHE_512KB

    choice CACHE_L2_CACHE_LINE_SIZE
        prompt "L2 cache line size"
        default CACHE_L2_CACHE_LINE_64B if CACHE_L2_CACHE_128KB
        default CACHE_L2_CACHE_LINE_64B if CACHE_L2_CACHE_256KB
        default CACHE_L2_CACHE_LINE_128B if CACHE_L2_CACHE_512KB
        help
            L2 cache line size to be set on application startup.

        config CACHE_L2_CACHE_LINE_64B
            bool "64 Bytes"
            depends on CACHE_L2_CACHE_128KB || CACHE_L2_CACHE_256KB
        config CACHE_L2_CACHE_LINE_128B
            bool "128 Bytes"
    endchoice

    config CACHE_L2_CACHE_LINE_SIZE
        int
        default 64 if CACHE_L2_CACHE_LINE_64B
        default 128 if CACHE_L2_CACHE_LINE_128B

    config CACHE_L1_CACHE_LINE_SIZE
        int
        default 64

endmenu  # Cache config
```

## components/esp_system/port/soc/esp32p4/Kconfig.cpu
```kconfig
choice ESP_DEFAULT_CPU_FREQ_MHZ
    prompt "CPU frequency"
    default ESP_DEFAULT_CPU_FREQ_MHZ_40 if IDF_ENV_FPGA || ESP_BRINGUP_BYPASS_CPU_CLK_SETTING
    default ESP_DEFAULT_CPU_FREQ_MHZ_360 if ESP32P4_SELECTS_REV_LESS_V3
    default ESP_DEFAULT_CPU_FREQ_MHZ_400
    help
        CPU frequency to be set on application startup.

    config ESP_DEFAULT_CPU_FREQ_MHZ_40
        bool "40 MHz"
        depends on IDF_ENV_FPGA || ESP_BRINGUP_BYPASS_CPU_CLK_SETTING
    config ESP_DEFAULT_CPU_FREQ_MHZ_360
        bool "360 MHz"
        depends on ESP32P4_SELECTS_REV_LESS_V3
    config ESP_DEFAULT_CPU_FREQ_MHZ_400
        bool "400 MHz"
endchoice

config ESP_DEFAULT_CPU_FREQ_MHZ
    int
    default 40 if ESP_DEFAULT_CPU_FREQ_MHZ_40
    default 360 if ESP_DEFAULT_CPU_FREQ_MHZ_360
    default 400 if ESP_DEFAULT_CPU_FREQ_MHZ_400
```

## components/esp_system/port/soc/esp32p4/Kconfig.system
```kconfig
menu "Brownout Detector"
    config ESP_BROWNOUT_DET
        bool "Hardware brownout detect & reset"
        depends on !IDF_ENV_FPGA
        default y
        help
            The ESP32-P4 has a built-in brownout detector which can detect if the voltage is lower than
            a specific value. If this happens, it will reset the chip in order to prevent unintended
            behaviour.

    choice ESP_BROWNOUT_DET_LVL_SEL
        prompt "Brownout voltage level"
        default ESP_BROWNOUT_DET_LVL_SEL_7
        depends on ESP_BROWNOUT_DET
        help
            The brownout detector will reset the chip when the supply voltage is approximately
            below this level. Note that there may be some variation of brownout voltage level
            between each chip.

            Please note that this config is only valid when P4 SOC version is above v1.0. When you are using a
            earlier P4 SOC version (v0.x), the brownout value should be fixed around 2.52V and not configurable.

            #The voltage levels here are estimates, more work needs to be done to figure out the exact voltages
            #of the brownout threshold levels.
        config ESP_BROWNOUT_DET_LVL_SEL_7
            bool "2.6V"
        config ESP_BROWNOUT_DET_LVL_SEL_6
            bool "2.52V"
        config ESP_BROWNOUT_DET_LVL_SEL_5
            bool "2.42V"
    endchoice

    config ESP_BROWNOUT_DET_LVL
        int
        default 5 if ESP_BROWNOUT_DET_LVL_SEL_5
        default 6 if ESP_BROWNOUT_DET_LVL_SEL_6
        default 7 if ESP_BROWNOUT_DET_LVL_SEL_7

endmenu
```

## components/esp_system/port/soc/esp32s2/Kconfig.cache
```kconfig
menu "Cache config"

    choice ESP32S2_INSTRUCTION_CACHE_SIZE
        prompt "Instruction cache size"
        default ESP32S2_INSTRUCTION_CACHE_8KB
        help
            Instruction cache size to be set on application startup.
            If you use 8KB instruction cache rather than 16KB instruction cache,
            then the other 8KB will be added to the heap.

        config ESP32S2_INSTRUCTION_CACHE_8KB
            bool "8KB"
        config ESP32S2_INSTRUCTION_CACHE_16KB
            bool "16KB"
    endchoice

    config ESP32S2_INSTRUCTION_CACHE_SIZE
        hex
        default 0x2000 if ESP32S2_INSTRUCTION_CACHE_8KB
        default 0x4000 if ESP32S2_INSTRUCTION_CACHE_16KB

    choice ESP32S2_INSTRUCTION_CACHE_LINE_SIZE
        prompt "Instruction cache line size"
        default ESP32S2_INSTRUCTION_CACHE_LINE_32B
        help
            Instruction cache line size to be set on application startup.

        config ESP32S2_INSTRUCTION_CACHE_LINE_16B
            bool "16 Bytes"
        config ESP32S2_INSTRUCTION_CACHE_LINE_32B
            bool "32 Bytes"
    endchoice

    choice ESP32S2_DATA_CACHE_SIZE
        prompt "Data cache size"
        default ESP32S2_DATA_CACHE_8KB
        help
            Data cache size to be set on application startup.
            If you use 0KB data cache, the other 16KB will be added to the heap
            If you use 8KB data cache rather than 16KB data cache, the other 8KB will be added to the heap

        config ESP32S2_DATA_CACHE_0KB
            depends on !SPIRAM
            bool "0KB"
        config ESP32S2_DATA_CACHE_8KB
            bool "8KB"
        config ESP32S2_DATA_CACHE_16KB
            bool "16KB"
    endchoice

    config ESP32S2_DATA_CACHE_SIZE
        hex
        default 0 if ESP32S2_DATA_CACHE_0KB
        default 0x2000 if ESP32S2_DATA_CACHE_8KB
        default 0x4000 if ESP32S2_DATA_CACHE_16KB

    choice ESP32S2_DATA_CACHE_LINE_SIZE
        prompt "Data cache line size"
        default ESP32S2_DATA_CACHE_LINE_32B
        help
            Data cache line size to be set on application startup.

        config ESP32S2_DATA_CACHE_LINE_16B
            bool "16 Bytes"
        config ESP32S2_DATA_CACHE_LINE_32B
            bool "32 Bytes"
    endchoice

    config ESP32S2_INSTRUCTION_CACHE_WRAP
        bool "Enable instruction cache wrap"
        default "n"
        help
            If enabled, instruction cache will use wrap mode to read spi flash (maybe spiram).
            The wrap length equals to INSTRUCTION_CACHE_LINE_SIZE.
            However, it depends on complex conditions.

    config ESP32S2_DATA_CACHE_WRAP
        bool "Enable data cache wrap"
        default "n"
        help
            If enabled, data cache will use wrap mode to read spiram (maybe spi flash).
            The wrap length equals to DATA_CACHE_LINE_SIZE.
            However, it depends on complex conditions.

endmenu  # Cache config
```

## components/esp_system/port/soc/esp32s2/Kconfig.memory
```kconfig
menu "Memory"

    config ESP32S2_RTCDATA_IN_FAST_MEM
        bool "Place RTC_DATA_ATTR and RTC_RODATA_ATTR variables into RTC fast memory segment"
        default n
        help
            This option allows to place .rtc_data and .rtc_rodata sections into
            RTC fast memory segment to free the slow memory region for ULP programs.

    config ESP32S2_USE_FIXED_STATIC_RAM_SIZE
        bool "Use fixed static RAM size"
        default n
        help
            If this option is disabled, the DRAM part of the heap starts right after the .bss section,
            within the dram0_0 region. As a result, adding or removing some static variables
            will change the available heap size.

            If this option is enabled, the DRAM part of the heap starts right after the dram0_0 region,
            where its length is set with ESP32S2_FIXED_STATIC_RAM_SIZE

    config ESP32S2_FIXED_STATIC_RAM_SIZE
        hex "Fixed Static RAM size"
        default 0x10000
        range 0 0x34000 # Equal to I_D_SRAM_SIZE in linkerscript
        depends on ESP32S2_USE_FIXED_STATIC_RAM_SIZE
        help
            RAM size dedicated for static variables (.data & .bss sections).
            This value is less than the chips total memory, as not all of it can be used for this purpose.
            E.g. parts are used by the software bootloader, and will only be available
            as heap memory after app startup.

endmenu # Memory
```

## components/esp_system/port/soc/esp32s2/Kconfig.system
```kconfig
config ESP32S2_KEEP_USB_ALIVE
    bool "Keep USB peripheral enabled at start up" if !ESP_CONSOLE_USB_CDC
    default y if ESP_CONSOLE_USB_CDC
    help
        During the application initialization process, all the peripherals except UARTs and timers
        are reset. Enable this option to keep USB peripheral enabled.
        This option is automatically enabled if "USB CDC" console is selected.
```

## components/esp_system/port/soc/esp32s2/Kconfig.tracemem
```kconfig
menu "Trace memory"

    config ESP32S2_MEMMAP_TRACEMEM
        bool
        default "n"

    config ESP32S2_MEMMAP_TRACEMEM_TWOBANKS
        bool
        default "n"

    config ESP32S2_TRAX
        bool "Use TRAX tracing feature"
        default "n"
        select ESP32S2_MEMMAP_TRACEMEM
        help
            The ESP32S2 contains a feature which allows you to trace the execution path the processor
            has taken through the program. This is stored in a chunk of 32K (16K for single-processor)
            of memory that can't be used for general purposes anymore. Disable this if you do not know
            what this is.

    config ESP32S2_TRACEMEM_RESERVE_DRAM
        hex
        default 0x8000 if ESP32S2_MEMMAP_TRACEMEM && ESP32S2_MEMMAP_TRACEMEM_TWOBANKS
        default 0x4000 if ESP32S2_MEMMAP_TRACEMEM && !ESP32S2_MEMMAP_TRACEMEM_TWOBANKS
        default 0x0

endmenu  # Trace memory
```
