## components/esp_tee/test_apps/tee_cli_app/sdkconfig.defaults
```kconfig
# Enabling TEE
CONFIG_SECURE_ENABLE_TEE=y

# Enabling flash protection over SPI1
CONFIG_SECURE_TEE_EXT_FLASH_MEMPROT_SPI1=y

# Custom partition table
CONFIG_ESPTOOLPY_FLASHSIZE_4MB=y
CONFIG_PARTITION_TABLE_TWO_OTA_TEE=y

# TEE: Flash operations' limitation
CONFIG_FREERTOS_UNICORE=y

# TEE: OTA-related
CONFIG_MBEDTLS_CERTIFICATE_BUNDLE=y
CONFIG_EXAMPLE_SKIP_COMMON_NAME_CHECK=y
CONFIG_EXAMPLE_OTA_RECV_TIMEOUT=45000

# Custom certificates for testing
CONFIG_MBEDTLS_CERTIFICATE_BUNDLE_DEFAULT_CMN=y
CONFIG_MBEDTLS_CUSTOM_CERTIFICATE_BUNDLE=y
CONFIG_MBEDTLS_CUSTOM_CERTIFICATE_BUNDLE_PATH="test_certs/server_cert.pem"
```

## components/esp_tee/test_apps/tee_test_fw/sdkconfig.defaults
```kconfig
# Test-app related
CONFIG_FREERTOS_HZ=1000
CONFIG_ESP_TASK_WDT_INIT=n
CONFIG_HEAP_POISONING_COMPREHENSIVE=y

# Enabling TEE
CONFIG_SECURE_ENABLE_TEE=y
CONFIG_SECURE_TEE_DEBUG_MODE=y
CONFIG_SECURE_TEE_TEST_MODE=y

# Setting partition table
CONFIG_PARTITION_TABLE_SINGLE_APP_TEE=y
CONFIG_PARTITION_TABLE_OFFSET=0xF000
```

## components/esp_timer/Kconfig
```kconfig
menu "High resolution timer (esp_timer)"

    config ESP_TIMER_PROFILING
        bool "Enable esp_timer profiling features"
        default n
        help
            If enabled, esp_timer_dump will dump information such as number of times the timer was started,
            number of times the timer has triggered, and the total time it took for the callback to run.
            This option has some effect on timer performance and the amount of memory used for timer
            storage, and should only be used for debugging/testing purposes.

    config ESP_TIME_FUNCS_USE_RTC_TIMER  # [refactor-todo] remove when timekeeping and persistence are separate
        bool

    config ESP_TIME_FUNCS_USE_ESP_TIMER  # [refactor-todo] remove when timekeeping and persistence are separate
        bool

    config ESP_TIME_FUNCS_USE_NONE  # [refactor-todo] remove when timekeeping and persistence are separate
        bool

    config ESP_TIMER_TASK_STACK_SIZE
        int "High-resolution timer task stack size"
        default 3584
        range 2048 65536
        help
            Configure the stack size of "timer_task" task. This task is used
            to dispatch callbacks of timers created using ets_timer and esp_timer
            APIs. If you are seing stack overflow errors in timer task, increase
            this value.

            Note that this is not the same as FreeRTOS timer task. To configure
            FreeRTOS timer task size, see "FreeRTOS timer task stack size" option
            in "FreeRTOS".

    config ESP_TIMER_INTERRUPT_LEVEL
        int "Interrupt level"
        default 1
        range 1 3 if IDF_TARGET_ESP32
        range 1 1 if !IDF_TARGET_ESP32
        help
            It sets the interrupt level for esp_timer ISR in range 1..3.
            A higher level (3) helps to decrease the ISR esp_timer latency.

    config ESP_TIMER_SHOW_EXPERIMENTAL
        bool "show esp_timer's experimental features"
        help
            This shows some hidden features of esp_timer.
            Note that they may break other features, use them with care.

    config ESP_TIMER_TASK_AFFINITY
        hex
        default 0x0 if ESP_TIMER_TASK_AFFINITY_CPU0
        default 0x1 if ESP_TIMER_TASK_AFFINITY_CPU1
        default FREERTOS_NO_AFFINITY if ESP_TIMER_TASK_AFFINITY_NO_AFFINITY

    choice ESP_TIMER_TASK_AFFINITY
        prompt "esp_timer task core affinity"
        default ESP_TIMER_TASK_AFFINITY_CPU0
        help
            The default settings: timer TASK on CPU0 and timer ISR on CPU0.
            Other settings may help in certain cases, but note that they may break
            other features, use them with care.
            - "CPU0": (default) esp_timer task is processed by CPU0.
            - "CPU1": esp_timer task is processed by CPU1.
            - "No affinity": esp_timer task can be processed by any CPU.

        config ESP_TIMER_TASK_AFFINITY_CPU0
            bool "CPU0"
        config ESP_TIMER_TASK_AFFINITY_CPU1
            bool "CPU1"
            depends on !FREERTOS_UNICORE && ESP_TIMER_SHOW_EXPERIMENTAL
        config ESP_TIMER_TASK_AFFINITY_NO_AFFINITY
            bool "No affinity"
            depends on !FREERTOS_UNICORE && ESP_TIMER_SHOW_EXPERIMENTAL
    endchoice

    config ESP_TIMER_ISR_AFFINITY
        hex
        default 0x1 if ESP_TIMER_ISR_AFFINITY_CPU0
        default 0x2 if ESP_TIMER_ISR_AFFINITY_CPU1
        default FREERTOS_NO_AFFINITY if ESP_TIMER_ISR_AFFINITY_NO_AFFINITY

    choice ESP_TIMER_ISR_AFFINITY
        prompt "timer interrupt core affinity"
        default ESP_TIMER_ISR_AFFINITY_CPU0
        help
            The default settings: timer TASK on CPU0 and timer ISR on CPU0.
            Other settings may help in certain cases, but note that they may break
            other features, use them with care.
            - "CPU0": (default) timer interrupt is processed by CPU0.
            - "CPU1": timer interrupt is processed by CPU1.
            - "No affinity": timer interrupt can be processed by any CPU. It helps
            to reduce latency but there is a disadvantage it leads to the timer ISR
            running on every core. It increases the CPU time usage for timer ISRs
            by N on an N-core system.

        config ESP_TIMER_ISR_AFFINITY_CPU0
            bool "CPU0"
        config ESP_TIMER_ISR_AFFINITY_CPU1
            bool "CPU1"
            depends on !FREERTOS_UNICORE && ESP_TIMER_SHOW_EXPERIMENTAL
        config ESP_TIMER_ISR_AFFINITY_NO_AFFINITY
            bool "No affinity"
            depends on !FREERTOS_UNICORE && ESP_TIMER_SHOW_EXPERIMENTAL
    endchoice

    config ESP_TIMER_SUPPORTS_ISR_DISPATCH_METHOD
        bool "Support ISR dispatch method"
        default n
        help
            Allows using ESP_TIMER_ISR dispatch method (ESP_TIMER_TASK dispatch method is also avalible).
            - ESP_TIMER_TASK - Timer callbacks are dispatched from a high-priority esp_timer task.
            - ESP_TIMER_ISR - Timer callbacks are dispatched directly from the timer interrupt handler.
            The ISR dispatch can be used, in some cases, when a callback is very simple
            or need a lower-latency.

    config ESP_TIMER_IMPL_TG0_LAC
        bool
        default y
        depends on IDF_TARGET_ESP32

    config ESP_TIMER_IMPL_SYSTIMER
        bool
        default y
        depends on !IDF_TARGET_ESP32

endmenu # esp_timer
```

## components/esp_timer/test_apps/sdkconfig.defaults
```kconfig
# General options for additional checks
CONFIG_HEAP_POISONING_COMPREHENSIVE=y
CONFIG_COMPILER_WARN_WRITE_STRINGS=y
CONFIG_BOOTLOADER_LOG_LEVEL_WARN=y
CONFIG_FREERTOS_WATCHPOINT_END_OF_STACK=y
CONFIG_COMPILER_STACK_CHECK_MODE_STRONG=y
CONFIG_COMPILER_STACK_CHECK=y

CONFIG_ESP_TASK_WDT_INIT=n

CONFIG_FREERTOS_HZ=1000
CONFIG_ESP_MAIN_TASK_STACK_SIZE=8192

CONFIG_ESP_TIMER_PROFILING=y
```
