## components/bt/common/Kconfig.in
```kconfig
config BT_ALARM_MAX_NUM
    int "Maximum number of Bluetooth alarms"
    default 50
    depends on (BT_BLUEDROID_ENABLED || BT_NIMBLE_ENABLED)
    help
        This option decides the maximum number of alarms which
        could be used by Bluetooth host.

choice BT_SMP_CRYPTO_STACK
    prompt "SMP cryptographic stack"
    depends on (BT_BLE_SMP_ENABLE || BT_SMP_ENABLE || BT_NIMBLE_SECURITY_ENABLE || BT_LE_SECURITY_ENABLE)
    default BT_SMP_CRYPTO_STACK_TINYCRYPT
    help
        Select the cryptographic library to use for SMP operations (AES, AES-CMAC, ECDH P-256).

    config BT_SMP_CRYPTO_STACK_TINYCRYPT
        bool "TinyCrypt"
        help
            Use TinyCrypt library for cryptographic operations.
            TinyCrypt is a lightweight cryptographic library designed for constrained devices.
            This can reduce code size compared to the native implementation.
            This is the default option.

    config BT_SMP_CRYPTO_STACK_MBEDTLS
        bool "mbedTLS"
        select MBEDTLS_AES_C
        select MBEDTLS_CMAC_C
        select MBEDTLS_ECDH_C
        select MBEDTLS_ECP_C
        select MBEDTLS_ECP_DP_SECP256R1_ENABLED
        help
            Use mbedTLS library for cryptographic operations.
            This can provide hardware acceleration on supported platforms and reduce code size
            by sharing crypto implementations with other components.

endchoice

menu "BT Logs"
    menu "Log Sources"
        menuconfig BT_LE_CONTROLLER_LOG_ENABLED
            depends on SOC_ESP_NIMBLE_CONTROLLER
            bool "Enable Controller logs"
            default n

        choice BT_LE_CONTROLLER_LOG_OUTPUT_MODE
            depends on BT_LE_CONTROLLER_LOG_ENABLED
            prompt "Controller log output mode"
            default BT_LE_CONTROLLER_LOG_MODE_BLE_LOG_V2 if BLE_LOG_ENABLED
            default BT_LE_CTRL_LEGACY_LOG_MODE_ENABLED

            config BT_LE_CONTROLLER_LOG_MODE_BLE_LOG_V2
                depends on BLE_LOG_ENABLED
                bool "BLE Log v2 mode"
                help
                    Utilize BLE Log v2 for controller log

            config BT_LE_CTRL_LEGACY_LOG_MODE_ENABLED
                depends on !BLE_LOG_ENABLED
                bool "Legacy log mode (Deprecated)"
        endchoice

        if BT_LE_CONTROLLER_LOG_ENABLED && BT_LE_CTRL_LEGACY_LOG_MODE_ENABLED
            config BT_LE_CONTROLLER_LOG_CTRL_ENABLED
                bool "Enable controller link layer logs"
                default y

            config BT_LE_CONTROLLER_LOG_HCI_ENABLED
                bool "Enable controller HCI logs"
                default y

            config BT_LE_CONTROLLER_LOG_DUMP_ONLY
                bool "Controller log dump mode only"
                default y
                help
                    Only operate in dump mode. Logs are cached internally only,
                    not output asynchronously.

            config BT_LE_CONTROLLER_LOG_SPI_OUT_ENABLED
                bool "Output controller logs to SPI bus (Experimental)"
                depends on !BT_LE_CONTROLLER_LOG_DUMP_ONLY
                select BT_BLE_LOG_SPI_OUT_ENABLED
                default n
                help
                    Output ble controller logs to SPI bus

            config BT_LE_CONTROLLER_LOG_STORAGE_ENABLE
                bool "Store controller logs to flash (Experimental)"
                depends on !BT_LE_CONTROLLER_LOG_DUMP_ONLY
                default n
                help
                    Store ble controller logs to flash memory.

            config BT_LE_CONTROLLER_LOG_PARTITION_SIZE
                int "Controller log partition size (multiples of 4K)"
                depends on BT_LE_CONTROLLER_LOG_STORAGE_ENABLE
                default 65536
                help
                    The size of ble controller log partition shall be a multiples of 4K.
                    The name of log partition shall be "bt_ctrl_log".
                    The partition type shall be ESP_PARTITION_TYPE_DATA.
                    The partition sub_type shall be ESP_PARTITION_SUBTYPE_ANY.

            config BT_LE_LOG_CTRL_BUF1_SIZE
                int "First controller log buffer size"
                default 4096
                help
                    Configure the size of the first BLE controller LOG buffer.

            config BT_LE_LOG_CTRL_BUF2_SIZE
                int "Second controller log buffer size"
                default 1024
                help
                    Configure the size of the second BLE controller LOG buffer.

            config BT_LE_LOG_HCI_BUF_SIZE
                int "HCI log buffer size"
                default 4096
                help
                    Configure the size of the BLE HCI LOG buffer.
        endif

        config BT_LE_CONTROLLER_LOG_OUTPUT_LEVEL
            int "Controller log output level"
            depends on BT_LE_CONTROLLER_LOG_ENABLED
            range 0 5
            default 2 if BT_LOG_CRITICAL_ONLY_CTRL
            default 1
            help
                The output level of controller log.

        config BT_LE_CONTROLLER_LOG_MOD_OUTPUT_SWITCH
            hex "Controller log module output switch"
            depends on BT_LE_CONTROLLER_LOG_ENABLED
            range 0 0xFFFFFFFF
            default 0xFFFFFFFF
            help
                Bitmask to enable/disable logging for individual controller
                modules. 0xFFFFFFFF enables all modules.

        config BT_LE_CONTROLLER_LOG_WRAP_PANIC_HANDLER_ENABLE
            bool "Enable wrap panic handler"
            depends on BT_LE_CONTROLLER_LOG_ENABLED
            default n
            help
                Wrap esp_panic_handler to get controller logs when PC pointer exception crashes.

        config BT_LE_CONTROLLER_LOG_TASK_WDT_USER_HANDLER_ENABLE
            bool "Enable esp_task_wdt_isr_user_handler implementation"
            depends on BT_LE_CONTROLLER_LOG_ENABLED
            default n
            help
                Implement esp_task_wdt_isr_user_handler to get controller logs when task wdt issue is triggered.
    endmenu

    menuconfig BT_LOG_CRITICAL_ONLY
        bool "Enable bandwidth-optimized log mode (critical logs only)"
        default n
        depends on !BT_STACK_NO_LOG
        select BLE_LOG_ENABLED
        select BLE_COMPRESSED_LOG_ENABLE
        help
            Enable bandwidth-optimized logging for the BLE Log Async Output
            system. When enabled, only high-severity logs are captured and
            log encoding is applied to reduce UART/SPI DMA bandwidth usage.

            Each stack component below can be independently enabled.
            Requires a DMA-backed output peripheral — configure in:
            BLE Log Module → BLE Log peripheral choice.

    if BT_LOG_CRITICAL_ONLY
        config BT_LOG_CRITICAL_ONLY_CTRL
            bool "Controller: bandwidth-optimized logging"
            depends on SOC_ESP_NIMBLE_CONTROLLER || BT_CTRL_RUN_IN_FLASH_ONLY
            select BT_LE_CONTROLLER_LOG_ENABLED if SOC_ESP_NIMBLE_CONTROLLER
            select BT_CTRL_LE_LOG_EN if !SOC_ESP_NIMBLE_CONTROLLER
            default y
            help
                Enable controller log output via the async transport with
                a reduced output level for bandwidth optimization.
                The controller log level defaults to 2 when active.

        config BT_LOG_CRITICAL_ONLY_HOST
            bool "Host: bandwidth-optimized logging"
            select BLE_HOST_COMPRESSED_LOG_ENABLE if BT_BLUEDROID_ENABLED
            default y
            help
                Enable host stack log encoding via the async transport.
                For Bluedroid, the per-level compression options control
                which severity levels are encoded — configure in:
                Settings of BLE Log Compression → BLE Host log compression.

        config BT_LOG_CRITICAL_ONLY_MESH
            bool "Mesh: bandwidth-optimized logging"
            depends on SOC_BLE_MESH_SUPPORTED && BLE_MESH
            select BLE_MESH_COMPRESSED_LOG_ENABLE
            default y
            help
                Enable mesh log encoding via the async transport.
                The per-level compression options are configured in:
                Settings of BLE Log Compression → BLE Mesh log compression.
    endif # BT_LOG_CRITICAL_ONLY

    source "$IDF_PATH/components/bt/common/ble_log/Kconfig.in"
endmenu

config BT_LE_USED_MEM_STATISTICS_ENABLED
    bool "Enable used memory statistics"
    default n
    help
        Used in internal tests only. Enable used memory statistics.
```

## components/bt/common/ble_log/extension/log_compression/Kconfig.in
```kconfig
config BLE_COMPRESSED_LOG_ENABLE
    bool "Enable BLE log compression(Preview, Please read help information)"
    default n
    help
        Compress BLE logs during application build to reduce flash usage
        and improve output speed. When enabled, log data from Bluetooth
        Low Energy components will be compressed before storage,
        optimizing both memory footprint and transmission efficiency.

        Note: This library depends on additional Python packages. It will
        function correctly only after these dependencies are installed;
        refer to:
        "components/bt/common/ble_log/log_compression/README.en.md"
        for installation instructions.

if BLE_COMPRESSED_LOG_ENABLE
    source "$IDF_PATH/components/bt/common/ble_log/extension/log_compression/profile/mesh/Kconfig.mesh.in"
    source "$IDF_PATH/components/bt/common/ble_log/extension/log_compression/iso/audio/Kconfig.iso.in"
    source "$IDF_PATH/components/bt/common/ble_log/extension/log_compression/host/Kconfig.host.in"
endif
```

## components/bt/common/ble_log/extension/log_compression/host/Kconfig.host.in
```kconfig
menuconfig BLE_HOST_COMPRESSED_LOG_ENABLE
    bool "Enable BLE Host log compression(Preview)"
    depends on BLE_COMPRESSED_LOG_ENABLE
    depends on BT_BLUEDROID_ENABLED || BT_NIMBLE_ENABLED
    default n
    help
            Apply compression to host logs. Requires
            base BLE compression to be enabled. Specifically optimizes log
            storage and transmission.

            Note: This library depends on additional Python packages. It will
            function correctly only after these dependencies are installed;
            refer to:
            "components/bt/common/ble_log/log_compression/README.en.md"
            for installation instructions.

config BLE_HOST_COMPRESSED_LOG_BUFFER_LEN
    int "Host log buffer length"
    depends on BLE_HOST_COMPRESSED_LOG_ENABLE
    default 300
    help
                Maximum output length for a single log

source "$IDF_PATH/components/bt/common/ble_log/extension/log_compression/host/Kconfig.host.bluedroid.in"
source "$IDF_PATH/components/bt/common/ble_log/extension/log_compression/host/Kconfig.host.nimble.in"
```

## components/bt/common/ble_log/extension/log_compression/iso/audio/Kconfig.iso.in
```kconfig
menuconfig BLE_ISO_COMPRESSED_LOG_ENABLE
    bool "Enable BLE Audio/ISO log compression(Preview)"
    depends on BLE_COMPRESSED_LOG_ENABLE
    depends on BT_ISO
    default n
    help
            Apply compression to BLE Audio/ISO protocol stack logs. Requires
            base BLE compression to be enabled. Specifically optimizes log
            storage and transmission for BLE Audio and ISO.

            Note: This library depends on additional Python packages. It will
            function correctly only after these dependencies are installed;
            refer to:
            "components/bt/common/ble_log/log_compression/README.en.md"
            for installation instructions.

            If the required packages are not installed, the log-compression
            mechanism will remain disabled even when this Config is enabled.

config BLE_ISO_COMPRESSED_LOG_BUFFER_LEN
    int "BLE Audio/ISO log buffer length"
    depends on BLE_ISO_COMPRESSED_LOG_ENABLE
    default 300
    help
            Maximum output length for a single log

source "$IDF_PATH/components/bt/common/ble_log/extension/log_compression/iso/audio/Kconfig.iso.tags.in"
```

## components/bt/common/ble_log/extension/log_compression/iso/audio/Kconfig.iso.tags.in
```kconfig
if BLE_ISO_COMPRESSED_LOG_ENABLE
    menu "Select the Audio/ISO stack log tag to be compressed"
        config BLE_ISO_STACK_ERR_LOG_COMPRESSION
            bool "Compress ERROR log of BLE Audio/ISO"
            default y
            help
                    The error log in the BLE Audio/ISO component will be compressed
        config BLE_ISO_STACK_ERR_LOG_PRESERVE
            bool "Keep the original error log statement"
            depends on BLE_ISO_STACK_ERR_LOG_COMPRESSION
            default y
            help
                    When this option is enabled, the log data will be output
                    through both the compressed log interface and the original
                    UART interface at the same time, meaning that the log
                    statements will appear on both paths. However, please note
                    that this dual-output approach introduces additional code
                    and string constants, which will increase the size of the
                    firmware binary file. When this option is disabled, the
                    logs will no longer be printed through the original UART
                    output path; instead, they will only be output through the
                    compressed log interface. As the code and strings related
                    to the original UART output are omitted, the size of the
                    firmware binary file can be effectively reduced.

        config BLE_ISO_STACK_WARN_LOG_COMPRESSION
            bool "Compress WARN log of BLE Audio/ISO"
            default y
            help
                    The warn log in the BLE Audio/ISO component will be compressed
        config BLE_ISO_STACK_WARN_LOG_PRESERVE
            bool "Keep the original warn log statement"
            depends on BLE_ISO_STACK_WARN_LOG_COMPRESSION
            default y
            help
                    Please refer to the help information in BLE_ISO_STACK_ERR_LOG_PRESERVE

        config BLE_ISO_STACK_INFO_LOG_COMPRESSION
            bool "Compress INFO log of BLE Audio/ISO"
            default y
            help
                    The info log in the BLE Audio/ISO component will be compressed
        config BLE_ISO_STACK_INFO_LOG_PRESERVE
            bool "Keep the original info log statement"
            depends on BLE_ISO_STACK_INFO_LOG_COMPRESSION
            default n
            help
                    Please refer to the help information in BLE_ISO_STACK_ERR_LOG_PRESERVE

        config BLE_ISO_STACK_DEBUG_LOG_COMPRESSION
            bool "Compress DEBUG log of BLE Audio/ISO"
            default y
            help
                    The debug log in the BLE Audio/ISO component will be compressed
        config BLE_ISO_STACK_DEBUG_LOG_PRESERVE
            bool "Keep the original debug log statement"
            depends on BLE_ISO_STACK_DEBUG_LOG_COMPRESSION
            default n
            help
                    Please refer to the help information in BLE_ISO_STACK_ERR_LOG_PRESERVE
    endmenu
endif
```
