## components/bt/esp_ble_audio/Kconfig/Kconfig.aics.in
```kconfig
# Bluetooth Audio - Audio Input Control Service options
#
# SPDX-FileCopyrightText: 2020 Bose Corporation
# SPDX-FileCopyrightText: 2020 Nordic Semiconductor ASA
#
# SPDX-License-Identifier: Apache-2.0
#

##################### Audio Input Control Service #####################

config BT_AICS_MAX_INSTANCE_COUNT
    int "Audio Input Control Service max instance count"
    default 0
    range 0 15
    help
        This option sets the maximum number of instances of Audio Input
        Control Services.

config BT_AICS
    bool # hidden
    default y if BT_AICS_MAX_INSTANCE_COUNT > 0
    help
        This hidden option enables support for Audio Input Control Service.

if BT_AICS

    config BT_AICS_MAX_INPUT_DESCRIPTION_SIZE
        int "Audio Input Control Service max input description size"
        default 32
        range 0 512
        help
            This option sets the maximum input description size in octets.

endif # BT_AICS

##################### Audio Input Control Service Client #####################

config BT_AICS_CLIENT_MAX_INSTANCE_COUNT
    int "Audio Input Control Service client max instance count"
    default 0
    range 0 15
    help
        This option sets the maximum number of instances of Audio Input
        Control Services.

config BT_AICS_CLIENT
    bool # hidden
    default y if BT_AICS_CLIENT_MAX_INSTANCE_COUNT > 0
    help
        This hidden option enables support for Audio Input Control Service.
```

## components/bt/esp_ble_audio/Kconfig/Kconfig.ascs.in
```kconfig
# Bluetooth Audio - Audio Stream Control configuration options
#
# SPDX-FileCopyrightText: 2020 Intel Corporation
# SPDX-FileCopyrightText: 2022 Nordic Semiconductor ASA

# SPDX-License-Identifier: Apache-2.0
#

config BT_ASCS
    bool "Audio Stream Control Service Support"
    help
        This option enables support for Audio Stream Control Service.

if BT_ASCS

    config BT_ASCS_MAX_ASE_SNK_COUNT
        int "Maximum number of Audio Stream Endpoint Sink Characteristics"
        default 2
        range 0 255
        help
            An ASE Sink characteristic represents the state of an ASE, which is
            coupled to a single direction of a unicast Audio Stream.

    config BT_ASCS_MAX_ASE_SRC_COUNT
        int "Maximum number of Audio Stream Endpoint Source Characteristics"
        default 2
        range 0 255
        help
            An ASE Source characteristic represents the state of an ASE, which is
            coupled to a single direction of a unicast Audio Stream.

    config BT_ASCS_ASE_SNK
        bool # hidden
        default y if BT_ASCS_MAX_ASE_SNK_COUNT > 0
        select BT_PAC_SNK
        select BT_AUDIO_RX

    config BT_ASCS_ASE_SRC
        bool # hidden
        default y if BT_ASCS_MAX_ASE_SRC_COUNT > 0
        select BT_PAC_SRC
        select BT_AUDIO_TX

    config BT_ASCS_MAX_ACTIVE_ASES
        int "Number of simultaneously supported ASE sessions"
        default BT_ISO_MAX_CHAN
        range 1 65535
        help
            The number of simultaneously supported active ASEs, in particular
            meaning the number of ASEs that are allowed to be in a non-idle state at
            a single time.

    config BT_ASCS_ISO_DISCONNECT_DELAY
        int "Milliseconds of delay before ASCS disconnects ISO after stream stop"
        range 0 5000
        default 500
        help
            The number of milliseconds ASCS will wait before disconnecting the ISO
            of a stopped stream. The delay is added as it is the Unicast Client's
            responsibility, but this is a failsafe to ensure that ISO channel is
            being properly disconnected.

    config BT_ASCS_ASE_BUF_TIMEOUT
        int "Milliseconds of timeout when handle concurrent access to the long read ASE buffer"
        range 0 1000
        default 50
        help
            The number of milliseconds that the ASCS implementation will maximum wait before rejecting
            an ASE read or dropping a notification if the ASE state is being accessed by another
            thread.


endif # BT_ASCS
```

## components/bt/esp_ble_audio/Kconfig/Kconfig.bap.in
```kconfig
# Bluetooth Audio - Basic Audio Profile configuration options
#
# SPDX-FileCopyrightText: 2020 Intel Corporation
# SPDX-FileCopyrightText: 2022-2025 Nordic Semiconductor ASA

# SPDX-License-Identifier: Apache-2.0
#

config BT_BAP_UNICAST
    bool
    default y if BT_BAP_UNICAST_SERVER || BT_BAP_UNICAST_CLIENT

config BT_BAP_UNICAST_SERVER
    bool "Bluetooth Unicast Audio Server Support"
    select BT_ISO_PERIPHERAL
    select BT_ASCS
    select BT_PAC_SNK if BT_ASCS_ASE_SNK
    select BT_PAC_SRC if BT_ASCS_ASE_SRC
    help
        This option enables support for Bluetooth Unicast Audio Server
        using Isochronous channels.

config BT_BAP_UNICAST_CLIENT
    bool "Bluetooth Unicast Audio Client Support"
    select BT_ISO_CENTRAL
    help
        This option enables support for Bluetooth Unicast Audio Client
        using Isochronous channels.

config BT_AUDIO_CODEC_CFG_MAX_DATA_SIZE
    int "Codec Specific Configuration Data Size"
    default 19
    range 0 255
    help
        Number of octets to support for Codec Specific Configuration data.
        The default value 19 matches the required fields for the LC3 codec.

config BT_AUDIO_CODEC_CFG_MAX_METADATA_SIZE
    int "Codec Specific Configuration Metadata Size"
    default 20
    range 0 255
    help
        Number of octets to support for Codec Specific Configuration metadata.

config BT_BAP_BASS_MAX_SUBGROUPS
    int "Maximum number of subgroups supported for the BASS receive states"
    default 1
    range 1 24
    help
        This option sets the maximum number of subgroups supported.
        Due to limitations in advertising data, the maximum size of all subgroups are 249.
        The minimum size of a subgroup is 10 octets.
        So effectively there can be a maximum of 24 subgroups in a BASE.

config BT_AUDIO_CODEC_CAP_MAX_DATA_SIZE
    int "Codec Capabilities Data Size"
    default 19
    range 0 255
    help
        Number of octets to support for Codec Specific Capabilities data.
        The default value 19 matches the required fields for the LC3 codec.

config BT_AUDIO_CODEC_CAP_MAX_METADATA_SIZE
    int "Codec Capabilities Metadata Size"
    default 4
    range 0 255
    help
        Number of octets to support for Codec Specific Capabilities metadata.

if BT_BAP_UNICAST_CLIENT

    config BT_BAP_UNICAST_CLIENT_GROUP_COUNT
        int "Basic Audio Unicast Group count"
        default 1
        range 1 BT_ISO_MAX_CIG
        help
            This option sets the number of connected audio groups to support as
            the unicast client.

    config BT_BAP_UNICAST_CLIENT_GROUP_STREAM_COUNT
        int "Basic Audio Profile Unicast Group Connected Isochronous Stream (CIS) count"
        depends on BT_BAP_UNICAST_CLIENT_GROUP_COUNT > 0
        default 1
        range 1 BT_ISO_MAX_CHAN if BT_ISO_MAX_CHAN < 31
        range 1 31
        help
            This option sets the maximum number of CIS per unicast group to support.
            Since BAP streams are unidirectional, two BAP streams may use a single CIS, the number of
            BAP audio streams per group may be up to twice of this value.

    config BT_BAP_UNICAST_CLIENT_ASE_SNK_COUNT
        int "Basic Audio Profile ASE Sink count"
        default 2
        range 0 255
        help
            This option enables caching a number of Audio Stream Endpoint Sink
            instances for Basic Audio Profile on a per connection basis.

    config BT_BAP_UNICAST_CLIENT_ASE_SRC_COUNT
        int "Basic Audio Profile ASE Source count"
        default 2
        range 0 255
        help
            This option enables caching a number of Audio Stream Endpoint Source
            instances for Basic Audio Profile on a per connection basis.

    config BT_BAP_UNICAST_CLIENT_ASE_SNK
        bool # hidden
        default y if BT_BAP_UNICAST_CLIENT_ASE_SNK_COUNT > 0

    config BT_BAP_UNICAST_CLIENT_ASE_SRC
        bool # hidden
        default y if BT_BAP_UNICAST_CLIENT_ASE_SRC_COUNT > 0

endif # BT_BAP_UNICAST_CLIENT

config BT_BAP_BROADCAST_SOURCE
    bool "Bluetooth Broadcast Source Audio Support"
    select BT_ISO_BROADCASTER
    help
        This option enables support for Bluetooth Broadcast Source Audio using
        Isochronous channels.

if BT_BAP_BROADCAST_SOURCE

    config BT_BAP_BROADCAST_SRC_SUBGROUP_COUNT
        int "Basic Audio Broadcast Source subgroup count"
        default 1
        range 1 BT_ISO_MAX_CHAN if BT_ISO_MAX_CHAN < 31
        range 1 31
        help
            This option sets the maximum number of subgroups per broadcast source
            to support.

    config BT_BAP_BROADCAST_SRC_COUNT
        int "Basic Audio Broadcaster source count"
        default 1
        range 1 BT_ISO_MAX_BIG
        help
            This option sets the number of broadcast sources to support.
            One broadcast source can send multiple streams
            (up to BT_BAP_BROADCAST_SRC_STREAM_COUNT per broadcast source).


    config BT_BAP_BROADCAST_SRC_STREAM_COUNT
        int "Basic Audio Broadcast Source Stream count"
        default 1
        range 1 BT_ISO_MAX_CHAN if BT_ISO_MAX_CHAN < 31
        range 1 31
        help
            This option sets the maximum number of streams per broadcast source
            to support.

endif # BT_BAP_BROADCAST_SOURCE

config BT_BAP_BROADCAST_SINK
    bool "Bluetooth Broadcast Sink Audio Support"
    select BT_ISO_SYNC_RECEIVER
    select BT_PAC_SNK
    depends on BT_BAP_SCAN_DELEGATOR
    help
        This option enables support for Bluetooth Broadcast Sink Audio using
        Isochronous channels.

if BT_BAP_BROADCAST_SINK

    config BT_BAP_BROADCAST_SNK_SUBGROUP_COUNT
        int "Basic Audio Profile Broadcast Sink subgroup count"
        default 1
        range 1 BT_BAP_BASS_MAX_SUBGROUPS
        help
            This option sets the maximum number of subgroups per broadcast sink
            to support.

    config BT_BAP_BROADCAST_SNK_COUNT
        int "Basic Audio Broadcaster Sink count"
        default 1
        range 0 BT_ISO_MAX_BIG
        help
            This option sets the number of broadcast sinks to support.
            One broadcast sink can receive multiple streams
            (up to BT_BAP_BROADCAST_SNK_STREAM_COUNT per broadcast sink).

    config BT_BAP_BROADCAST_SNK_STREAM_COUNT
        int "Basic Audio Broadcast Sink Stream count"
        depends on BT_BAP_BROADCAST_SNK_COUNT > 0
        default 1
        range 1 BT_ISO_MAX_CHAN if BT_ISO_MAX_CHAN < 31
        range 1 31
        help
            This option sets the maximum number of streams per broadcast sink
            to support.

endif # BT_BAP_BROADCAST_SINK

config BT_BAP_SCAN_DELEGATOR
    bool "Basic Audio Profile Scan Delegator role support"
    select BT_ISO_SYNC_RECEIVER
    help
        This option enables support for the Scan Delegator role and the
        Broadcast Audio Scan Service (BASS).

if BT_BAP_SCAN_DELEGATOR

    config BT_BAP_SCAN_DELEGATOR_RECV_STATE_COUNT
        int "Scan Delegator Receive State Count"
        default 1
        range 1 3
        help
            Sets the number of receive state characteristics present on the
            server. Each characteristic may hold information to sync to a
            periodic advertise or a broadcast isochronous stream.

    config BT_BAP_SCAN_DELEGATOR_BUF_TIMEOUT
        int "Milliseconds of timeout when handle concurrent access to the long read ASE buffer"
        range 0 1000
        default 50
        help
            The maximum number of milliseconds that the scan delegator implementation will wait
            before rejecting a read or dropping a notification if the scan delegator state is
            being accessed by another thread.

endif # BT_BAP_SCAN_DELEGATOR

config BT_BAP_BROADCAST_ASSISTANT
    bool "Basic Audio Profile Broadcast Assistant role support"
    select BT_ISO_SYNC_RECEIVER
    select BT_AUDIO
    help
        This option enables support for the Broadcast Assistant role.

if BT_BAP_BROADCAST_ASSISTANT

    config BT_BAP_BROADCAST_ASSISTANT_RECV_STATE_COUNT
        int "Broadcast Assistant Max Receive State Count"
        default 1
        range 1 255
        help
            Sets the number of maximum receive stat characteristics that will be
            discovered and ready to use. Each characteristic may hold information
            to sync to a periodic advertise or a broadcast isochronous stream.

endif # BT_BAP_BROADCAST_ASSISTANT

config BT_BAP_DEBUG_STREAM_DATA
    bool "Bluetooth Audio Stream data debug"
    help
        Use this option to enable Bluetooth Audio Stream data debug logs for
        the Bluetooth Audio functionality. This will enable debug logs for all
        audio data received and sent.

config BT_BAP_STREAM
    # Virtual/hidden option
    bool
    default y if BT_ASCS || BT_BAP_UNICAST_CLIENT || \
        BT_BAP_BROADCAST_SOURCE || BT_BAP_BROADCAST_SINK

config BT_BAP_DEBUG_STREAM_SEQ_NUM
    bool "Bluetooth Audio Stream sequence number debug"
    default y
    help
        Use this option to enable Bluetooth Audio Stream sequence number debugging logs for
        the Bluetooth Audio functionality. This will provide a warning if the application
        provides unexpected sequence numbers.

config BT_BAP_BASE
    bool
    default y if BT_BAP_BROADCAST_SINK || BT_BAP_BROADCAST_ASSISTANT || BT_BAP_SCAN_DELEGATOR
```

## components/bt/esp_ble_audio/Kconfig/Kconfig.cap.in
```kconfig
# Bluetooth Audio - Common Audio Profile (CAP) options
#
# SPDX-FileCopyrightText: 2022 Nordic Semiconductor ASA
#
# SPDX-License-Identifier: Apache-2.0
#

config BT_CAP
    bool # hidden
    default y if BT_CAP_ACCEPTOR || BT_CAP_INITIATOR

config BT_CAP_ACCEPTOR
    bool "Common Audio Profile Acceptor Role Support"
    depends on BT_BAP_UNICAST_SERVER || (BT_BAP_BROADCAST_SINK && BT_BAP_SCAN_DELEGATOR)
    depends on BT_AUDIO_CODEC_CFG_MAX_METADATA_SIZE >= 4
    help
        Enabling this will enable the CAP Acceptor role. This instantiates the
        common audio service (CAS).

config BT_CAP_ACCEPTOR_SET_MEMBER
    bool "Common Audio Profile Acceptor Role Set Member support"
    depends on BT_CAP_ACCEPTOR
    depends on BT_CSIP_SET_MEMBER
    help
        Enabling this will allow a CAP acceptor to be a set member.
        Enabling this will require a manual register of the CAS service.
        Enabling will take one of the allocated CSIS instances
        (BT_CSIP_SET_MEMBER_MAX_INSTANCE_COUNT).

config BT_CAP_INITIATOR_UNICAST
    bool # hidden
    default y if BT_CAP_INITIATOR && BT_BAP_UNICAST_CLIENT

config BT_CAP_INITIATOR
    bool "Common Audio Profile Initiator Role Support"
    depends on (BT_BAP_UNICAST_CLIENT && BT_CSIP_SET_COORDINATOR) || BT_BAP_BROADCAST_SOURCE
    depends on BT_AUDIO_CODEC_CFG_MAX_METADATA_SIZE >= 4
    help
        Enabling this will enable the CAP Initiator role.

config BT_CAP_COMMANDER
    bool "Common Audio Profile Initiator Role Support"
    depends on (BT_BAP_BROADCAST_ASSISTANT && BT_BAP_SCAN_DELEGATOR && BT_CSIP_SET_COORDINATOR) || \
        (BT_BAP_SCAN_DELEGATOR && BT_CSIP_SET_COORDINATOR) || \
        (BT_VCP_VOL_CTLR && BT_CSIP_SET_COORDINATOR) || \
        (BT_MICP_MIC_CTLR && BT_CSIP_SET_COORDINATOR) || \
        BT_TBS_CLIENT || \
        BT_MCC
    help
        Enabling this will enable the CAP Initiator role.

config BT_CAP_HANDOVER
    bool "Common Audio Profile Handover Procedures"
    depends on BT_CAP_COMMANDER && BT_CAP_INITIATOR && BT_BAP_BROADCAST_ASSISTANT && \
        BT_BAP_BROADCAST_SOURCE && BT_BAP_UNICAST_CLIENT_ASE_SNK_COUNT > 0
    help
        Enable support for the CAP Handover procedures, allowing a device to switch between
        broadcast and unicast for a usecase.
```
