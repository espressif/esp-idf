## components/bt/esp_ble_audio/Kconfig/Kconfig.ccp.in
```kconfig
# Bluetooth Audio - Call Control Profile (CCP) configuration options
#
# SPDX-FileCopyrightText: 2024 Nordic Semiconductor ASA
#
# SPDX-License-Identifier: Apache-2.0
#

config BT_CCP_CALL_CONTROL_CLIENT
    bool "Call Control Profile Client Support"
    depends on BT_TBS_CLIENT
    help
        This option enables support for the Call Control Profile Client which uses the Telephone
        Bearer Service (TBS) client to control calls on a remote device.

if BT_CCP_CALL_CONTROL_CLIENT

    config BT_CCP_CALL_CONTROL_CLIENT_BEARER_COUNT
        int "Telephone bearer count"
        default 1
        range 1 255 if BT_TBS_CLIENT_TBS
        range 1 1
        help
            The number of supported telephone bearers on the CCP Call Control Client

endif # BT_CCP_CALL_CONTROL_CLIENT

config BT_CCP_CALL_CONTROL_SERVER
    bool "Call Control Profile Call Control Server Support"
    depends on BT_TBS
    help
        This option enables support for the Call Control Profile Call Control Server which uses
        the Telephone Bearer Service (TBS) to hold and control calls on a device.

if BT_CCP_CALL_CONTROL_SERVER

    config BT_CCP_CALL_CONTROL_SERVER_BEARER_COUNT
        int "Telephone bearer count"
        default 1
        range 1 255
        help
            The number of supported telephone bearers on the CCP Call Control Server

    config BT_CCP_CALL_CONTROL_SERVER_PROVIDER_NAME_MAX_LEN
        # The original BT_CCP_CALL_CONTROL_SERVER_PROVIDER_NAME_MAX_LENGTH is reported
        # as too long while running pre-commit check.
        int "The maximum length of the bearer provider name excluding null terminator"
        default BT_TBS_MAX_PROVIDER_NAME_LENGTH
        range 1 BT_TBS_MAX_PROVIDER_NAME_LENGTH
        help
            Sets the maximum length of the bearer provider name.

endif # BT_CCP_CALL_CONTROL_SERVER
```
