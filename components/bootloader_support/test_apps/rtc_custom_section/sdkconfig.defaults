## components/bt/common/ble_log/extension/log_compression/profile/mesh/Kconfig.mesh.in
```kconfig
menuconfig BLE_MESH_COMPRESSED_LOG_ENABLE
    bool "Enable BLE Mesh log compression(Preview)"
    depends on BLE_COMPRESSED_LOG_ENABLE
    depends on BLE_MESH
    default n
    help
            Apply compression to ESP-BLE-MESH protocol stack logs. Requires
            base BLE compression to be enabled. Specifically optimizes log
            storage and transmission for ble mesh.

            Note: This library depends on additional Python packages. It will
            function correctly only after these dependencies are installed;
            refer to:
            "components/bt/common/ble_log/log_compression/README.en.md"
            for installation instructions.

            If the required packages are not installed, the log-compression
            mechanism will remain disabled even when this Config is enabled.

config BLE_MESH_COMPRESSED_LOG_BUFFER_LEN
    int "BLE Mesh log buffer length"
    depends on BLE_MESH_COMPRESSED_LOG_ENABLE
    default 400
    help
            Maximum output length for a single log

source "$IDF_PATH/components/bt/common/ble_log/extension/log_compression/profile/mesh/Kconfig.mesh.tags.in"
```

## components/bt/common/ble_log/extension/log_compression/profile/mesh/Kconfig.mesh.tags.in
```kconfig
if BLE_MESH_COMPRESSED_LOG_ENABLE
    menu "Select the stack log tag to be compressed"
        config BLE_MESH_STACK_ERR_LOG_COMPRESSION
            bool "Compress ERROR log of ESP-BLE-MESH"
            default y
            help
                    The error log in the BLE-MESH component will be compressed
        config BLE_MESH_STACK_ERR_LOG_PRESERVE
            bool "Keep the original error log statement"
            depends on BLE_MESH_STACK_ERR_LOG_COMPRESSION
            default y
            help
                    When this option is enabled, the log data will be output
                    through both the compressed log interface and the original
                    UART interface at the same time, meaning that the log
                    statements will appear on both paths. However, please note
                    that this dual-output approach introduces additional code
                    and string constants, which will increase the size of the
                    firmware binary file. When this option is disabled, the
                    logs will no longer be printed through the original UART
                    output path; instead, they will only be output through the
                    compressed log interface. As the code and strings related
                    to the original UART output are omitted, the size of the
                    firmware binary file can be effectively reduced.

        config BLE_MESH_STACK_WARN_LOG_COMPRESSION
            bool "Compress warn log of ESP-BLE-MESH"
            default y
            help
                    The warn log in the BLE-MESH component will be compressed
        config BLE_MESH_STACK_WARN_LOG_PRESERVE
            bool "Keep the original warn log statement"
            depends on BLE_MESH_STACK_WARN_LOG_COMPRESSION
            default y
            help
                    Please refer to the help information in BLE_MESH_STACK_ERR_LOG_PRESERVE
        config BLE_MESH_STACK_INFO_LOG_COMPRESSION
            bool "Compress info log of ESP-BLE-MESH"
            default y
            help
                    The info log in the BLE-MESH component will be compressed
        config BLE_MESH_STACK_INFO_LOG_PRESERVE
            bool "Keep the original info log statement"
            depends on BLE_MESH_STACK_INFO_LOG_COMPRESSION
            default n
            help
                    Please refer to the help information in BLE_MESH_STACK_ERR_LOG_PRESERVE
        config BLE_MESH_STACK_DEBUG_LOG_COMPRESSION
            bool "Compress debug log of ESP-BLE-MESH"
            default y
            help
                    The debug log in the BLE-MESH component will be compressed
        config BLE_MESH_STACK_DEBUG_LOG_PRESERVE
            bool "Keep the original debug log statement"
            depends on BLE_MESH_STACK_DEBUG_LOG_COMPRESSION
            default n
            help
                    Please refer to the help information in BLE_MESH_STACK_ERR_LOG_PRESERVE
    endmenu
    menu "Select the net buf log tag to be compressed"
        config BLE_MESH_NET_BUF_ERR_LOG_COMPRESSION
            bool "Compress ERROR log of ESP-BLE-MESH"
            default y
            help
                    The error log in the BLE-MESH component will be compressed
        config BLE_MESH_NET_BUF_ERR_LOG_PRESERVE
            bool "Keep the original error log statement"
            depends on BLE_MESH_NET_BUF_ERR_LOG_COMPRESSION
            default y
            help
                    When this option is enabled, the log data will be output
                    through both the compressed log interface and the original
                    UART interface at the same time, meaning that the log
                    statements will appear on both paths. However, please note
                    that this dual-output approach introduces additional code
                    and string constants, which will increase the size of the
                    firmware binary file. When this option is disabled, the
                    logs will no longer be printed through the original UART
                    output path; instead, they will only be output through the
                    compressed log interface. As the code and strings related
                    to the original UART output are omitted, the size of the
                    firmware binary file can be effectively reduced.
        config BLE_MESH_NET_BUF_WARN_LOG_COMPRESSION
            bool "Compress warn log of ESP-BLE-MESH"
            default y
            help
                    The warn log in the BLE-MESH component will be compressed
        config BLE_MESH_NET_BUF_WARN_LOG_PRESERVE
            bool "Keep the original warn log statement"
            depends on BLE_MESH_NET_BUF_WARN_LOG_COMPRESSION
            default y
            help
                    Please refer to the help information in BLE_MESH_NET_BUF_ERR_LOG_PRESERVE
        config BLE_MESH_NET_BUF_INFO_LOG_COMPRESSION
            bool "Compress info log of ESP-BLE-MESH"
            default y
            help
                    The info log in the BLE-MESH component will be compressed
        config BLE_MESH_NET_BUF_INFO_LOG_PRESERVE
            bool "Keep the original info log statement"
            depends on BLE_MESH_NET_BUF_INFO_LOG_COMPRESSION
            default n
            help
                    Please refer to the help information in BLE_MESH_NET_BUF_ERR_LOG_PRESERVE
        config BLE_MESH_NET_BUF_DEBUG_LOG_COMPRESSION
            bool "Compress debug log of ESP-BLE-MESH"
            default y
            help
                    The debug log in the BLE-MESH component will be compressed
        config BLE_MESH_NET_BUF_DEBUG_LOG_PRESERVE
            bool "Keep the original debug log statement"
            depends on BLE_MESH_NET_BUF_DEBUG_LOG_COMPRESSION
            default n
            help
                    Please refer to the help information in BLE_MESH_NET_BUF_ERR_LOG_PRESERVE
    endmenu
endif
```
