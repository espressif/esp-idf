## components/partition_table/Kconfig.projbuild
```kconfig
menu "Partition Table"

    choice PARTITION_TABLE_TYPE
        prompt "Partition Table"
        default PARTITION_TABLE_SINGLE_APP
        help
            The partition table to flash to the ESP32. The partition table
            determines where apps, data and other resources are expected to
            be found.

            The predefined partition table CSV descriptions can be found
            in the components/partition_table directory. These are mostly intended
            for example and development use, it's expect that for production use you
            will copy one of these CSV files and create a custom partition CSV for
            your application.

        config PARTITION_TABLE_SINGLE_APP
            bool "Single factory app, no OTA"
            help
                This is the default partition table, designed to fit into a 2MB or
                larger flash with a single 1MB app partition.

                The corresponding CSV file in the IDF directory is
                components/partition_table/partitions_singleapp.csv

                This partition table is not suitable for an app that needs OTA
                (over the air update) capability.
        config PARTITION_TABLE_SINGLE_APP_LARGE
            bool "Single factory app (large), no OTA"
            help
                This is a variation of the default partition table, that expands
                the 1MB app partition size to 1.5MB to fit more code.

                The corresponding CSV file in the IDF directory is
                components/partition_table/partitions_singleapp_large.csv

                This partition table is not suitable for an app that needs OTA
                (over the air update) capability.
        config PARTITION_TABLE_TWO_OTA
            bool "Factory app, two OTA definitions"
            help
                This is a basic OTA-enabled partition table with a factory app
                partition plus two OTA app partitions. All are 1MB, so this
                partition table requires 4MB or larger flash size.

                The corresponding CSV file in the IDF directory is
                components/partition_table/partitions_two_ota.csv
        config PARTITION_TABLE_CUSTOM
            bool "Custom partition table CSV"
            help
                Specify the path to the partition table CSV to use for your project.

                Consult the Partition Table section in the ESP-IDF Programmers Guide
                for more information.
        config PARTITION_TABLE_SINGLE_APP_ENCRYPTED_NVS
            bool "Single factory app, no OTA, encrypted NVS"
            depends on !ESP32_COREDUMP_ENABLE_TO_FLASH && NVS_SEC_KEY_PROTECT_USING_FLASH_ENC

            help
                This is a variation of the default "Single factory app, no OTA" partition table
                that supports encrypted NVS when using flash encryption. See the Flash Encryption section
                in the ESP-IDF Programmers Guide for more information.

                The corresponding CSV file in the IDF directory is
                components/partition_table/partitions_singleapp_encr_nvs.csv
        config PARTITION_TABLE_SINGLE_APP_LARGE_ENC_NVS
            bool "Single factory app (large), no OTA, encrypted NVS"
            depends on !ESP32_COREDUMP_ENABLE_TO_FLASH && NVS_SEC_KEY_PROTECT_USING_FLASH_ENC
            help
                This is a variation of the "Single factory app (large), no OTA" partition table
                that supports encrypted NVS when using flash encryption. See the Flash Encryption section
                in the ESP-IDF Programmers Guide for more information.

                The corresponding CSV file in the IDF directory is
                components/partition_table/partitions_singleapp_large_encr_nvs.csv
        config PARTITION_TABLE_TWO_OTA_ENCRYPTED_NVS
            bool "Factory app, two OTA definitions, encrypted NVS"
            depends on !ESP_COREDUMP_ENABLE_TO_FLASH && NVS_SEC_KEY_PROTECT_USING_FLASH_ENC
            help
                This is a variation of the "Factory app, two OTA definitions" partition table
                that supports encrypted NVS when using flash encryption. See the Flash Encryption section
                in the ESP-IDF Programmers Guide for more information.

                The corresponding CSV file in the IDF directory is
                components/partition_table/partitions_two_ota_encr_nvs.csv
    endchoice

    config PARTITION_TABLE_CUSTOM_FILENAME
        string "Custom partition CSV file" if PARTITION_TABLE_CUSTOM
        default "partitions.csv"
        help
            Name of the custom partition CSV filename.
            This path is evaluated relative to the project root directory by default.
            However, if the absolute path for the CSV file is provided, then the absolute path is configured.

    config PARTITION_TABLE_FILENAME
        string
        default "partitions_singleapp.csv" if PARTITION_TABLE_SINGLE_APP && !ESP_COREDUMP_ENABLE_TO_FLASH
        default "partitions_singleapp_coredump.csv" if PARTITION_TABLE_SINGLE_APP && ESP_COREDUMP_ENABLE_TO_FLASH
        default "partitions_singleapp_encr_nvs.csv" if PARTITION_TABLE_SINGLE_APP_ENCRYPTED_NVS
        default "partitions_singleapp_large.csv" if PARTITION_TABLE_SINGLE_APP_LARGE && !ESP_COREDUMP_ENABLE_TO_FLASH
        default "partitions_singleapp_large_coredump.csv" if PARTITION_TABLE_SINGLE_APP_LARGE && ESP_COREDUMP_ENABLE_TO_FLASH # NOERROR
        default "partitions_singleapp_large_encr_nvs.csv" if PARTITION_TABLE_SINGLE_APP_LARGE_ENC_NVS
        default "partitions_two_ota.csv" if PARTITION_TABLE_TWO_OTA && !ESP_COREDUMP_ENABLE_TO_FLASH
        default "partitions_two_ota_coredump.csv" if PARTITION_TABLE_TWO_OTA && ESP_COREDUMP_ENABLE_TO_FLASH
        default "partitions_two_ota_encr_nvs.csv" if PARTITION_TABLE_TWO_OTA_ENCRYPTED_NVS
        default PARTITION_TABLE_CUSTOM_FILENAME if PARTITION_TABLE_CUSTOM

    config PARTITION_TABLE_OFFSET
        hex "Offset of partition table"
        default 0x8000
        help
            The address of partition table (by default 0x8000).
            Allows you to move the partition table, it gives more space for the bootloader.
            Note that the bootloader and app will both need to be compiled with the same PARTITION_TABLE_OFFSET value.

            This number should be a multiple of 0x1000.

            Note that partition offsets in the partition table CSV file may need to be changed if this value is set to
            a higher value. To have each partition offset adapt to the configured partition table offset, leave all
            partition offsets blank in the CSV file.

    config PARTITION_TABLE_MD5
        bool "Generate an MD5 checksum for the partition table"
        default y
        depends on !APP_COMPATIBLE_PRE_V3_1_BOOTLOADERS && !IDF_TARGET_LINUX
        help
            Generate an MD5 checksum for the partition table for protecting the
            integrity of the table. The generation should be turned off for legacy
            bootloaders which cannot recognize the MD5 checksum in the partition
            table.

endmenu
```

## components/pincore/Kconfig
```kconfig
if FREERTOS_UNICORE

comment "FreeRTOS set to run unicore, PinCore module disabled"

endif

if !FREERTOS_UNICORE

config PINCORE_MODULE_ENABLED
	bool "Enable functions pinning thread to specific or current core"
    default "y"
    help
    	Enable if you use functions that don't feel good when they
    	swap to a different core, and want to secure them to stay
    	on current or dedicated core for a specific code area.


endif
```

## components/protocomm/Kconfig
```kconfig
menu "Protocomm"

    config ESP_PROTOCOMM_SUPPORT_SECURITY_VERSION_0
        bool "Support protocomm security version 0 (no security)"
        default y
        help
            Enable support of security version 0.
            Disabling this option saves some code size.
            Consult the Enabling protocomm security version section of the
            Protocomm documentation in ESP-IDF Programming guide for more details.

    config ESP_PROTOCOMM_SUPPORT_SECURITY_VERSION_1
        bool "Support protocomm security version 1 (Curve25519 key exchange + AES-CTR encryption/decryption)"
        default y
        help
            Enable support of security version 1.
            Disabling this option saves some code size.
            Consult the Enabling protocomm security version section of the
            Protocomm documentation in ESP-IDF Programming guide for more details.

    config ESP_PROTOCOMM_SUPPORT_SECURITY_VERSION_2
        bool "Support protocomm security version 2 (SRP6a-based key exchange + AES-GCM encryption/decryption)"
        default y
        help
            Enable support of security version 2.
            Disabling this option saves some code size.
            Consult the Enabling protocomm security version section of the
            Protocomm documentation in ESP-IDF Programming guide for more details.

    config ESP_PROTOCOMM_SUPPORT_SECURITY_PATCH_VERSION
        bool
        default y
        help
            Enable support of security patch version. This is a hidden config option
            kept for external components like "network_provisioning" to find out if
            protocomm component support security patch version. This config option
            also indicates availability of a new API `protocomm_get_sec_version`.
            Please refer to Protocomm documentation in ESP-IDF Programming guide for
            more details.

    config ESP_PROTOCOMM_KEEP_BLE_ON_AFTER_BLE_STOP
        bool
        depends on BT_ENABLED
        help
            Keep BT on after calling protocomm_ble_stop

    config ESP_PROTOCOMM_DISCONNECT_AFTER_BLE_STOP
        bool
        depends on ESP_PROTOCOMM_KEEP_BLE_ON_AFTER_BLE_STOP
        help
            Terminate connection after calling protocomm_ble_stop

endmenu
```

## components/pthread/Kconfig
```kconfig
menu "PThreads"

    config PTHREAD_TASK_PRIO_DEFAULT
        int "Default task priority"
        range 0 255
        default 5
        help
            Priority used to create new tasks with default pthread parameters.

    config PTHREAD_TASK_STACK_SIZE_DEFAULT
        int "Default task stack size"
        default 3072
        help
            Stack size used to create new tasks with default pthread parameters.

    config PTHREAD_STACK_MIN
        int "Minimum allowed pthread stack size"
        default 768
        help
            Minimum allowed pthread stack size set in attributes passed to pthread_create

    choice PTHREAD_TASK_CORE_DEFAULT
        bool "Default pthread core affinity"
        default PTHREAD_DEFAULT_CORE_NO_AFFINITY
        depends on !FREERTOS_UNICORE
        help
            The default core to which pthreads are pinned.

        config PTHREAD_DEFAULT_CORE_NO_AFFINITY
            bool "No affinity"
        config PTHREAD_DEFAULT_CORE_0
            bool "Core 0"
        config PTHREAD_DEFAULT_CORE_1
            bool "Core 1"
    endchoice

    config PTHREAD_TASK_CORE_DEFAULT
        int
        default -1 if PTHREAD_DEFAULT_CORE_NO_AFFINITY || FREERTOS_UNICORE
        default 0 if PTHREAD_DEFAULT_CORE_0
        default 1 if PTHREAD_DEFAULT_CORE_1

    config PTHREAD_TASK_NAME_DEFAULT
        string "Default name of pthreads"
        default "pthread"
        help
            The default name of pthreads.

endmenu
```

## components/pthread/test_apps/pthread_psram_tests/sdkconfig.defaults
```kconfig
CONFIG_ESP_MAIN_TASK_STACK_SIZE=8192
CONFIG_ESP_TASK_WDT_INIT=n
CONFIG_FREERTOS_HZ=1000
CONFIG_FREERTOS_WATCHPOINT_END_OF_STACK=y
CONFIG_SPIRAM=y
```

## components/rt/test_apps/posix_rt_test/sdkconfig.defaults
```kconfig
# This "default" configuration is appended to all other configurations
CONFIG_ESP_TASK_WDT_INIT=n
```

## components/soc/Kconfig
```kconfig
menu "SoC Settings"
    # No visible menu/configs for now
    visible if 0

    menu "MMU Config"
        orsource "$IDF_TARGET/Kconfig.mmu"

        config MMU_PAGE_MODE
            string
            default "8KB" if MMU_PAGE_SIZE_8KB
            default "16KB" if MMU_PAGE_SIZE_16KB
            default "32KB" if MMU_PAGE_SIZE_32KB
            default "128KB" if MMU_PAGE_SIZE_128KB
            default "256KB" if MMU_PAGE_SIZE_256KB
            default "64KB" if MMU_PAGE_SIZE_64KB

        config MMU_PAGE_SIZE
            # Some chips support different flash MMU page sizes: 64k, 32k, 16k.
            # Since the number of MMU pages is limited, the maximum flash size supported
            # for each page size is reduced proportionally: 4 MB, 2MB, 1MB. To make best
            # use of small flash sizes (reducing the wasted space due to alignment), we
            # need to use the smallest possible MMU page size for the given flash size.
            hex
            default 0x2000 if MMU_PAGE_SIZE_8KB
            default 0x4000 if MMU_PAGE_SIZE_16KB
            default 0x8000 if MMU_PAGE_SIZE_32KB
            default 0x10000 if MMU_PAGE_SIZE_64KB
            default 0x20000 if MMU_PAGE_SIZE_128KB
            default 0x40000 if MMU_PAGE_SIZE_256KB
    endmenu

endmenu
```

## components/soc/esp32c2/Kconfig.mmu
```kconfig
# This Config is used for configure the MMU.
# Be configured based on flash size selection.
# Invisible to users.

config MMU_PAGE_SIZE_16KB
    bool
    default y if ESPTOOLPY_FLASHSIZE_1MB
    default n

config MMU_PAGE_SIZE_32KB
    bool
    default y if ESPTOOLPY_FLASHSIZE_2MB
    default n

config MMU_PAGE_SIZE_64KB
    bool
    default y if !MMU_PAGE_SIZE_32KB && !MMU_PAGE_SIZE_16KB
    default n
```

## components/soc/esp32c3/Kconfig.mmu
```kconfig
# This Config is used for configure the MMU.
# Be configured based on flash size selection.
# Invisible to users.

config MMU_PAGE_SIZE_64KB
    bool
    default y
```
