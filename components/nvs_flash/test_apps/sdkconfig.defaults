## components/nvs_flash/test_apps/sdkconfig.defaults
```kconfig
# General options for additional checks
CONFIG_BOOTLOADER_LOG_LEVEL_WARN=y
CONFIG_NVS_ASSERT_ERROR_CHECK=y

CONFIG_ESP_TASK_WDT_EN=y
CONFIG_ESP_TASK_WDT_INIT=n
```

## components/nvs_flash/test_apps_bootloader/sdkconfig.defaults.esp32c2
```kconfig
CONFIG_IDF_TARGET="esp32c2"
CONFIG_ESP32C2_REV_MIN_200=y
CONFIG_MBEDTLS_USE_CRYPTO_ROM_IMPL_BOOTLOADER=y
```

## components/nvs_sec_provider/Kconfig
```kconfig
menu "NVS Security Provider"
    visible if NVS_ENCRYPTION

    choice NVS_SEC_KEY_PROTECTION_SCHEME
        prompt "NVS Encryption: Key Protection Scheme"
        depends on NVS_ENCRYPTION
        default NVS_SEC_KEY_PROTECT_USING_FLASH_ENC
        help
            This choice defines the default NVS encryption keys protection scheme;
            which will be used for the default NVS partition.
            Users can use the corresponding scheme registration APIs to register other
            schemes for the default as well as other NVS partitions.

        config NVS_SEC_KEY_PROTECT_USING_FLASH_ENC
            bool "Using Flash Encryption"
            depends on SECURE_FLASH_ENC_ENABLED
            help
                Protect the NVS Encryption Keys using Flash Encryption
                Requires a separate 'nvs_keys' partition (which will be encrypted by flash encryption)
                for storing the NVS encryption keys

        config NVS_SEC_KEY_PROTECT_USING_HMAC
            bool "Using HMAC peripheral"
            depends on SOC_HMAC_SUPPORTED
            help
                Derive and protect the NVS Encryption Keys using the HMAC peripheral
                Requires the specified eFuse block (NVS_SEC_HMAC_EFUSE_KEY_ID or the v2 API argument)
                to be empty or pre-written with a key with the purpose ESP_EFUSE_KEY_PURPOSE_HMAC_UP

    endchoice

    config NVS_SEC_HMAC_EFUSE_KEY_ID
        int "eFuse key ID storing the HMAC key"
        depends on NVS_SEC_KEY_PROTECT_USING_HMAC
        range 0 6
        default 6
        help
            eFuse block key ID storing the HMAC key for deriving the NVS encryption keys

            Note: The eFuse block key ID required by the HMAC scheme
            (CONFIG_NVS_SEC_KEY_PROTECT_USING_HMAC) is set using this config when the default
            NVS partition is initialized with nvs_flash_init(). The eFuse block key ID can
            also be set at runtime by passing the appropriate value to the NVS security scheme
            registration APIs.

endmenu
```

## components/openssl/Kconfig
```kconfig
menu "OpenSSL"

    config OPENSSL_DEBUG
        bool "Enable OpenSSL debugging"
        default n
        help
            Enable OpenSSL debugging function.

            If the option is enabled, "SSL_DEBUG" works.

    config OPENSSL_DEBUG_LEVEL
        int "OpenSSL debugging level"
        default 0
        range 0 255
        depends on OPENSSL_DEBUG
        help
            OpenSSL debugging level.

            Only function whose debugging level is higher than "OPENSSL_DEBUG_LEVEL" works.

            For example:
            If OPENSSL_DEBUG_LEVEL = 2, you use function "SSL_DEBUG(1, "malloc failed")". Because 1 < 2, it will not
            print.

    config OPENSSL_LOWLEVEL_DEBUG
        bool "Enable OpenSSL low-level module debugging"
        default n
        depends on OPENSSL_DEBUG
        select MBEDTLS_DEBUG
        help
            If the option is enabled, low-level module debugging function of OpenSSL is enabled, e.g. mbedtls internal
            debugging function.

    choice OPENSSL_ASSERT
        prompt "Select OpenSSL assert function"
        default OPENSSL_ASSERT_EXIT
        help
            OpenSSL function needs "assert" function to check if input parameters are valid.

            If you want to use assert debugging function, "OPENSSL_DEBUG" should be enabled.

        config OPENSSL_ASSERT_DO_NOTHING
            bool "Do nothing"
            help
                Do nothing and "SSL_ASSERT" does not work.

        config OPENSSL_ASSERT_EXIT
            bool "Check and exit"
            help
                Enable assert exiting, it will check and return error code.

        config OPENSSL_ASSERT_DEBUG
            bool "Show debugging message"
            depends on OPENSSL_DEBUG
            help
                Enable assert debugging, it will check and show debugging message.

        config OPENSSL_ASSERT_DEBUG_EXIT
            bool "Show debugging message and exit"
            depends on OPENSSL_DEBUG
            help
                Enable assert debugging and exiting, it will check, show debugging message and return error code.

        config OPENSSL_ASSERT_DEBUG_BLOCK
            bool "Show debugging message and block"
            depends on OPENSSL_DEBUG
            help
                Enable assert debugging and blocking, it will check, show debugging message and block by "while (1);".

    endchoice

endmenu
```
