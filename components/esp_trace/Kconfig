## components/freemodbus/Kconfig
```kconfig
menu "Modbus configuration"

    config FMB_COMM_MODE_TCP_EN
        bool "Enable Modbus stack support for TCP communication mode"
        default y
        help
                Enable Modbus TCP option for stack.

    config FMB_TCP_PORT_DEFAULT
        int "Modbus TCP port number"
        range 0 65535
        default 502
        depends on FMB_COMM_MODE_TCP_EN
        help
                Modbus default port number used by Modbus TCP stack

    config FMB_TCP_PORT_MAX_CONN
        int "Maximum allowed connections for TCP stack"
        range 1 6
        default 5
        depends on FMB_COMM_MODE_TCP_EN
        help
                Maximum allowed connections number for Modbus TCP stack.
                This is used by Modbus master and slave port layer to establish connections.
                This parameter may decrease performance of Modbus stack and can cause
                increasing of processing time (increase only if absolutely necessary).

    config FMB_TCP_CONNECTION_TOUT_SEC
        int "Modbus TCP connection timeout"
        range 1 3600
        default 20
        depends on FMB_COMM_MODE_TCP_EN
        help
                Modbus TCP connection timeout in seconds.
                Once expired the current connection with the client will be closed
                and Modbus slave will be waiting for new connection to accept.

    config FMB_COMM_MODE_RTU_EN
        bool "Enable Modbus stack support for RTU mode"
        default y
        help
                Enable RTU Modbus communication mode option for Modbus serial stack.

    config FMB_COMM_MODE_ASCII_EN
        bool "Enable Modbus stack support for ASCII mode"
        default y
        help
                Enable ASCII Modbus communication mode option for Modbus serial stack.

    config FMB_MASTER_TIMEOUT_MS_RESPOND
        int "Slave respond timeout (Milliseconds)"
        default 150
        range 50 3000
        help
                If master sends a frame which is not broadcast, it has to wait sometime for slave response.
                if slave is not respond in this time, the master will process timeout error.

    config FMB_MASTER_DELAY_MS_CONVERT
        int "Slave conversion delay (Milliseconds)"
        default 200
        range 50 400
        help
                If master sends a broadcast frame, it has to wait conversion time to delay,
                then master can send next frame.

    config FMB_QUEUE_LENGTH
        int "Modbus serial task queue length"
        range 0 200
        default 20
        help
                Modbus serial driver queue length. It is used by event queue task.
                See the serial driver API for more information.

    config FMB_PORT_TASK_STACK_SIZE
        int "Modbus port task stack size"
        range 2048 8192
        default 4096
        help
                Modbus port task stack size for rx/tx event processing.
                It may be adjusted when debugging is enabled (for example).

    config FMB_SERIAL_BUF_SIZE
        int "Modbus serial task RX/TX buffer size"
        range 0 2048
        default 256
        help
                Modbus serial task RX and TX buffer size for UART driver initialization.
                This buffer is used for modbus frame transfer. The Modbus protocol maximum
                frame size is 256 bytes. Bigger size can be used for non standard implementations.

    config FMB_SERIAL_ASCII_BITS_PER_SYMB
        int "Number of data bits per ASCII character"
        default 8
        range 7 8
        depends on FMB_COMM_MODE_ASCII_EN
        help
                This option defines the number of data bits per ASCII character.

    config FMB_SERIAL_ASCII_TIMEOUT_RESPOND_MS
        int "Response timeout for ASCII communication mode (ms)"
        default 1000
        range 300 2000
        depends on FMB_COMM_MODE_ASCII_EN
        help
                This option defines response timeout of slave in milliseconds for ASCII communication mode.
                Thus the timeout will expire and allow the master program to handle the error.

    config FMB_PORT_TASK_PRIO
        int "Modbus port task priority"
        range 3 23
        default 10
        help
                Modbus port data processing task priority.
                The priority of Modbus controller task is equal to (CONFIG_FMB_PORT_TASK_PRIO - 1).

    choice FMB_PORT_TASK_AFFINITY
        prompt "Modbus task affinity"
        default FMB_PORT_TASK_AFFINITY_CPU0
        depends on !FREERTOS_UNICORE
        help
            Allows setting the core affinity of the Modbus controller task, i.e. whether the task is pinned to
            particular CPU, or allowed to run on any CPU.

        config FMB_PORT_TASK_AFFINITY_NO_AFFINITY
            bool "No affinity"
        config FMB_PORT_TASK_AFFINITY_CPU0
            bool "CPU0"
        config FMB_PORT_TASK_AFFINITY_CPU1
            bool "CPU1"

    endchoice

    config FMB_PORT_TASK_AFFINITY
        hex
        default FREERTOS_NO_AFFINITY if FMB_PORT_TASK_AFFINITY_NO_AFFINITY || FREERTOS_UNICORE
        default 0x0 if FMB_PORT_TASK_AFFINITY_CPU0
        default 0x1 if FMB_PORT_TASK_AFFINITY_CPU1

    config FMB_CONTROLLER_SLAVE_ID_SUPPORT
        bool "Modbus controller slave ID support"
        default y
        help
                Modbus slave ID support enable.
                When enabled the Modbus <Report Slave ID> command is supported by stack.

    config FMB_CONTROLLER_SLAVE_ID
        hex "Modbus controller slave ID"
        range 0 4294967295
        default 0x00112233
        depends on FMB_CONTROLLER_SLAVE_ID_SUPPORT
        help
                Modbus slave ID value to identify modbus device
                in the network using <Report Slave ID> command.
                Most significant byte of ID is used as short device ID and
                other three bytes used as long ID.

    config FMB_CONTROLLER_NOTIFY_TIMEOUT
        int "Modbus controller notification timeout (ms)"
        range 0 200
        default 20
        help
                Modbus controller notification timeout in milliseconds.
                This timeout is used to send notification about accessed parameters.

    config FMB_CONTROLLER_NOTIFY_QUEUE_SIZE
        int "Modbus controller notification queue size"
        range 0 200
        default 20
        help
                Modbus controller notification queue size.
                The notification queue is used to get information about accessed parameters.

    config FMB_CONTROLLER_STACK_SIZE
        int "Modbus controller stack size"
        range 0 8192
        default 4096
        help
                Modbus controller task stack size. The Stack size may be adjusted when
                debug mode is used which requires more stack size (for example).

    config FMB_EVENT_QUEUE_TIMEOUT
        int "Modbus stack event queue timeout (ms)"
        range 0 500
        default 20
        help
                Modbus stack event queue timeout in milliseconds. This may help to optimize
                Modbus stack event processing time.

    config FMB_TIMER_PORT_ENABLED
        bool "Modbus stack use timer for 3.5T symbol time measurement"
        default n
        help
                If this option is set the Modbus stack uses timer for T3.5 time measurement.
                Else the internal UART TOUT timeout is used for 3.5T symbol time measurement.

    config FMB_TIMER_USE_ISR_DISPATCH_METHOD
        bool "Modbus timer uses ISR dispatch method"
        default n
        select ESP_TIMER_SUPPORTS_ISR_DISPATCH_METHOD
        select UART_ISR_IN_IRAM
        help
                If this option is set the Modbus stack uses ISR dispatch method
                to send timeout events from the callback function called from ISR.
                This option has dependency with the UART_ISR_IN_IRAM option which places UART interrupt
                handler into IRAM to prevent delays related to processing of UART events.

endmenu
```

## components/freemodbus/test/serial/mb_serial_master/sdkconfig.defaults
```kconfig
#
# Modbus configuration
#
CONFIG_MB_COMM_MODE_ASCII=y
CONFIG_MB_UART_BAUD_RATE=115200
CONFIG_FMB_TIMER_PORT_ENABLED=n
CONFIG_FMB_TIMER_ISR_IN_IRAM=y
CONFIG_FMB_MASTER_DELAY_MS_CONVERT=200
CONFIG_FMB_MASTER_TIMEOUT_MS_RESPOND=400
CONFIG_FMB_TIMER_USE_ISR_DISPATCH_METHOD=y
```

## components/freemodbus/test/serial/mb_serial_slave/main/Kconfig.projbuild
```kconfig
menu "Modbus Example Configuration"

    config MB_UART_PORT_NUM
        int "UART port number"
        range 0 2 if IDF_TARGET_ESP32 || IDF_TARGET_ESP32S3
        default 2 if IDF_TARGET_ESP32 || IDF_TARGET_ESP32S3
        range 0 1 if IDF_TARGET_ESP32S2 || IDF_TARGET_ESP32C3
        default 1 if IDF_TARGET_ESP32S2 || IDF_TARGET_ESP32C3
        help
            UART communication port number for Modbus example.

    config MB_UART_BAUD_RATE
        int "UART communication speed"
        range 1200 115200
        default 115200
        help
            UART communication speed for Modbus example.

    config MB_UART_RXD
        int "UART RXD pin number"
        range 0 34 if IDF_TARGET_ESP32
        default 22 if IDF_TARGET_ESP32
        range 0 46 if IDF_TARGET_ESP32S2
        range 0 47 if IDF_TARGET_ESP32S3
        range 0 19 if IDF_TARGET_ESP32C3
        default 8 if IDF_TARGET_ESP32S2 || IDF_TARGET_ESP32S3 || IDF_TARGET_ESP32C3
        help
            GPIO number for UART RX pin. See UART documentation for more information
            about available pin numbers for UART.

    config MB_UART_TXD
        int "UART TXD pin number"
        range 0 34 if IDF_TARGET_ESP32
        default 23 if IDF_TARGET_ESP32
        range 0 46 if IDF_TARGET_ESP32S2
        range 0 47 if IDF_TARGET_ESP32S3
        range 0 19 if IDF_TARGET_ESP32C3
        default 9 if IDF_TARGET_ESP32S2 || IDF_TARGET_ESP32S3 || IDF_TARGET_ESP32C3
        help
            GPIO number for UART TX pin. See UART documentation for more information
            about available pin numbers for UART.

    config MB_UART_RTS
        int "UART RTS pin number"
        range 0 34 if IDF_TARGET_ESP32
        default 18 if IDF_TARGET_ESP32
        range 0 46 if IDF_TARGET_ESP32S2
        range 0 47 if IDF_TARGET_ESP32S3
        range 0 19 if IDF_TARGET_ESP32C3
        default 10 if IDF_TARGET_ESP32S2 || IDF_TARGET_ESP32S3 || IDF_TARGET_ESP32C3
        help
            GPIO number for UART RTS pin. This pin is connected to
            ~RE/DE pin of RS485 transceiver to switch direction.
            See UART documentation for more information about available pin
            numbers for UART.

    choice MB_COMM_MODE
        prompt "Modbus communication mode"
        default MB_COMM_MODE_RTU if CONFIG_FMB_COMM_MODE_RTU_EN
        help
            Selection of Modbus communication mode option for Modbus.

        config MB_COMM_MODE_RTU
            bool "RTU mode"
            depends on FMB_COMM_MODE_RTU_EN

        config MB_COMM_MODE_ASCII
            bool "ASCII mode"
            depends on FMB_COMM_MODE_ASCII_EN

    endchoice

    config MB_SLAVE_ADDR
        int "Modbus slave address"
        range 1 127
        default 1
        help
            This is the Modbus slave address in the network.
            It is used to organize Modbus network with several slaves connected into the same segment.


endmenu
```

## components/freemodbus/test/serial/mb_serial_slave/sdkconfig.defaults
```kconfig
#
# Modbus configuration
#
CONFIG_MB_COMM_MODE_ASCII=y
CONFIG_MB_SLAVE_ADDR=1
CONFIG_MB_UART_BAUD_RATE=115200
CONFIG_FMB_TIMER_PORT_ENABLED=n
CONFIG_FMB_TIMER_ISR_IN_IRAM=y
CONFIG_FMB_TIMER_USE_ISR_DISPATCH_METHOD=y
```
