## components/log/Kconfig
```kconfig
menu "Log"

    choice LOG_VERSION
        prompt "Log version"
        default LOG_VERSION_1
        help
            Select the log version to be used by the ESP log component.

            - "V1": This version integrates log formatting into the format string provided by the user.
                    Logs are processed and formatted during compile time, leading to a larger binary file.
                    Example: ESP_LOGI("boot", "chip revision: v%d.%d", major, minor);
                    Output: I (56) boot: chip revision: v3.0
                    Note: Log strings are stored in Flash with added formatting characters.
                    Format string on flash: "[0;32mI (%lu) %s: chip revision: v%d.%d [0m"

            - "V2": This version centralizes log formatting within the esp_log() function.
                    User-supplied format strings are stored without added formatting, reducing binary size.
                    Example: ESP_LOGI("boot", "chip revision: v%d.%d", major, minor);
                    Output: I (56) boot: chip revision: v3.0
                    Note: This version supports runtime configuration of formatting and is more flexible,
                    logging from constrained environments (ex.: ISR, Startup, Cache disabled).
                    It may consumes a bit more stack and affect performance.
                    Format string on flash: "chip revision: v%d.%d"

            Use V1 for minimal stack usage and simpler implementation.
            Use V2 for smaller binary sizes, more flexible log formatting, and advanced features like disabling
            colors or timestamps.

        config LOG_VERSION_1
            bool "V1"
            help
                Select this option to use Log V1. Recommended for projects with strict stack constraints
                or that prioritize performance over flexibility.

        config LOG_VERSION_2
            bool "V2"
            help
                Select this option to use Log V2. Recommended for projects that require smaller binaries,
                runtime log formatting configuration, or advanced logging features.
    endchoice

    config LOG_VERSION
        int
        default 1 if LOG_VERSION_1
        default 2 if LOG_VERSION_2
        help
            This configuration sets the log version number based on the chosen log version.

    rsource "./Kconfig.level"

    rsource "./Kconfig.format"

    rsource "./Kconfig.settings"

    config LOG_API_CONSTRAINED_ENV_SAFE
        bool "Enable safe ESP_LOGx fallback in constrained environments (ISR, cache disabled)"
        depends on LOG_VERSION_2 && !ESP_ROM_HAS_VPRINTF_FUNC && !LOG_MODE_BINARY_EN
        default y
        help
            This option is only relevant on chips where ets_vprintf is NOT in ROM

            When enabled, Log V2 routes ESP_DRAM_LOGx, ESP_EARLY_LOGx, and runtime
            constrained-environment log calls (ISR, cache disabled) through esp_log(),
            which uses esp_rom_vprintf for formatting.

            When disabled, ESP_DRAM_LOGx and ESP_EARLY_LOGx expand directly
            to esp_rom_printf (a true ROM function with zero IRAM cost), bypassing
            esp_log(). Normal ESP_LOGx calls that happen to run in a constrained
            environment (ISR, cache disabled) will use the standard vprintf function
            instead of esp_rom_vprintf; if the standard vprintf resides in flash,
            such calls may crash. Use ESP_DRAM_LOGx for any logging that must work
            with cache disabled or from an ISR.

            Disable this option to save ~1.2 KB of IRAM on memory-constrained devices.
            Enable it if you need ESP_LOGx to safely fall back to ROM-based printing
            in ISRs or with cache disabled, or if you need constrained-environment
            logs in binary log format.

    config LOG_IN_IRAM
        bool "Place logging functions in IRAM" if SPI_FLASH_AUTO_SUSPEND
        default y
        select ESP_ROM_PRINT_IN_IRAM

endmenu
```

## components/log/Kconfig.format
```kconfig
menu "Format"

    config LOG_COLORS
        bool "Color"
        default n
        select LOG_COLORS_SUPPORT if LOG_VERSION_2
        help
            Enable ANSI terminal color codes. Logs (info, errors, warnings) will contain color codes.
            In order to view these, your terminal program must support ANSI color codes.

            This is disabled by default, as colors are added in IDF Monitor. If you want to use new lines
            in the messages or you are using a different terminal program, you may want to enable this option.

    config LOG_COLORS_SUPPORT
        bool "Allow enabling color output at run time"
        depends on LOG_VERSION_2
        default n
        help
            Enables support for color codes in the esp_log() function. If CONFIG_LOG_COLORS is enabled, this option
            is always active. If CONFIG_LOG_COLORS is disabled, this option allows you to still handle color codes
            in specific files by defining ESP_LOG_COLOR_DISABLED as 0 before including esp_log.h.

            Note that enabling this option may slightly increase IRAM usage due to additional color handling
            functionality. It provides flexibility to manage color output even when CONFIG_LOG_COLORS is turned off.

    choice LOG_TIMESTAMP_SOURCE
        prompt "Timestamp"
        default LOG_TIMESTAMP_SOURCE_RTOS
        help
            Choose what sort of timestamp is displayed in the log output:

            - "None" - The log will only contain the actual log messages themselves
              without any time-related information. Avoiding timestamps can help conserve
              processing power and memory. It might useful when you
              perform log analysis or debugging, sometimes it's more straightforward
              to work with logs that lack timestamps, especially if the time of occurrence
              is not critical for understanding the issues.

            - "Milliseconds since boot" is calculated from the RTOS tick count multiplied
              by the tick period. This time will reset after a software reboot.
              e.g. (90000)

            - "System time (HH:MM:SS.sss)" is taken from POSIX time functions which use the chip's
              RTC and high resolution timers to maintain an accurate time. The system time is
              initialized to 0 on startup, it can be set with an SNTP sync, or with
              POSIX time functions. This time will not reset after a software reboot.
              e.g. (00:01:30.000)

            - "System time (YY-MM-DD HH:MM:SS.sss)" it is the same as the above,
              but also prints the date as well.

            - "Unix time in milliseconds" is the same as the two above,
              but in Unix time format and in milliseconds.
              e.g. (1718795571035).

            - NOTE: Currently this will not get used in logging from binary blobs
              (i.e WiFi & Bluetooth libraries), these will always print
              milliseconds since boot.

        config LOG_TIMESTAMP_SOURCE_NONE
            bool "None"
            depends on LOG_VERSION_2

        config LOG_TIMESTAMP_SOURCE_RTOS
            bool "Milliseconds Since Boot"
            select LOG_TIMESTAMP_SUPPORT if LOG_VERSION_2

        config LOG_TIMESTAMP_SOURCE_SYSTEM
            bool "System Time (HH:MM:SS.sss)"
            select LOG_TIMESTAMP_SUPPORT if LOG_VERSION_2

        config LOG_TIMESTAMP_SOURCE_SYSTEM_FULL
            bool "System Time (YY-MM-DD HH:MM:SS.sss)"
            select LOG_TIMESTAMP_SUPPORT if LOG_VERSION_2
            depends on LOG_VERSION_2

        config LOG_TIMESTAMP_SOURCE_UNIX
            bool "Unix time in milliseconds"
            select LOG_TIMESTAMP_SUPPORT if LOG_VERSION_2
            depends on LOG_VERSION_2

    endchoice # LOG_TIMESTAMP_SOURCE

    config LOG_TIMESTAMP_SUPPORT
        bool "Allow enabling timestamp output at run time"
        depends on LOG_VERSION_2
        default y
        help
            Enables support for timestamp in the esp_log() function.
            If CONFIG_LOG_TIMESTAMP_SOURCE_NONE, this option allows you to still handle timestamp
            in specific files by defining ESP_LOG_TIMESTAMP_DISABLED as 0 before including esp_log.h.

            Note that enabling this option may slightly increase IRAM usage due to additional timestamp handling
            functionality. It provides flexibility to manage timestamp output even when
            CONFIG_LOG_TIMESTAMP_SOURCE_NONE.

endmenu
```

## components/log/Kconfig.level
```kconfig
menu "Log Level"

    choice LOG_DEFAULT_LEVEL
        bool "Default log verbosity"
        default LOG_DEFAULT_LEVEL_INFO
        help
            Specify how much output to see in logs by default.
            You can set lower verbosity level at runtime using
            esp_log_level_set() function if LOG_DYNAMIC_LEVEL_CONTROL
            is enabled.

            By default, this setting limits which log statements
            are compiled into the program. For example, selecting
            "Warning" would mean that changing log level to "Debug"
            at runtime will not be possible. To allow increasing log
            level above the default at runtime, see the next option.

        config LOG_DEFAULT_LEVEL_NONE
            bool "No output"
        config LOG_DEFAULT_LEVEL_ERROR
            bool "Error"
        config LOG_DEFAULT_LEVEL_WARN
            bool "Warning"
        config LOG_DEFAULT_LEVEL_INFO
            bool "Info"
        config LOG_DEFAULT_LEVEL_DEBUG
            bool "Debug"
        config LOG_DEFAULT_LEVEL_VERBOSE
            bool "Verbose"
    endchoice

    config LOG_DEFAULT_LEVEL
        int
        default 0 if LOG_DEFAULT_LEVEL_NONE
        default 1 if LOG_DEFAULT_LEVEL_ERROR
        default 2 if LOG_DEFAULT_LEVEL_WARN
        default 3 if LOG_DEFAULT_LEVEL_INFO
        default 4 if LOG_DEFAULT_LEVEL_DEBUG
        default 5 if LOG_DEFAULT_LEVEL_VERBOSE

    choice LOG_MAXIMUM_LEVEL
        bool "Maximum log verbosity"
        default LOG_MAXIMUM_EQUALS_DEFAULT
        help
            This config option sets the highest log verbosity that it's possible to select
            at runtime by calling esp_log_level_set(). This level may be higher than
            the default verbosity level which is set when the app starts up.

            This can be used enable debugging output only at a critical point, for a particular
            tag, or to minimize startup time but then enable more logs once the firmware has
            loaded.

            Note that increasing the maximum available log level will increase the firmware
            binary size.

            This option only applies to logging from the app, the bootloader log level is
            fixed at compile time to the separate "Bootloader log verbosity" setting.

        config LOG_MAXIMUM_EQUALS_DEFAULT
            bool "Same as default"
        config LOG_MAXIMUM_LEVEL_ERROR
            bool "Error"
            depends on LOG_DEFAULT_LEVEL < 1
        config LOG_MAXIMUM_LEVEL_WARN
            bool "Warning"
            depends on LOG_DEFAULT_LEVEL < 2
        config LOG_MAXIMUM_LEVEL_INFO
            bool "Info"
            depends on LOG_DEFAULT_LEVEL < 3
        config LOG_MAXIMUM_LEVEL_DEBUG
            bool "Debug"
            depends on LOG_DEFAULT_LEVEL < 4
        config LOG_MAXIMUM_LEVEL_VERBOSE
            bool "Verbose"
            depends on LOG_DEFAULT_LEVEL < 5
    endchoice

    config LOG_MAXIMUM_LEVEL
        int
        default LOG_DEFAULT_LEVEL if LOG_MAXIMUM_EQUALS_DEFAULT
        default 0 if LOG_MAXIMUM_LEVEL_NONE
        default 1 if LOG_MAXIMUM_LEVEL_ERROR
        default 2 if LOG_MAXIMUM_LEVEL_WARN
        default 3 if LOG_MAXIMUM_LEVEL_INFO
        default 4 if LOG_MAXIMUM_LEVEL_DEBUG
        default 5 if LOG_MAXIMUM_LEVEL_VERBOSE

    orsource "./Kconfig.level_settings"

endmenu
```
