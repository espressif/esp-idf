## components/freemodbus/test/tcp/mb_tcp_master/main/Kconfig.projbuild
```kconfig
menu "Modbus TCP Example Configuration"

    choice MB_SLAVE_IP_RESOLVER
        prompt "Select method to resolve slave IP addresses"
        help
                Select method which is used to resolve slave IP addresses
                and configure Master TCP IP stack.

            config MB_MDNS_IP_RESOLVER
                bool "Resolve Modbus slave addresses using mDNS service."

            config MB_SLAVE_IP_FROM_STDIN
                bool "Configure Modbus slave addresses from stdin"
    endchoice

endmenu
```
