## components/freertos/test_apps/freertos/main/Kconfig.projbuild
```kconfig
menu "FreeRTOS Test App Configuration"

    config FREERTOS_ENABLE_COVERAGE_TESTS
        bool "Enable code coverage instrumentation for FreeRTOS"
        depends on ESP_GCOV_ENABLE
        default n
        help
            When enabled, FreeRTOS kernel, port, and ESP additions source files will be compiled with
            code coverage instrumentation flags (--coverage) to enable GCOV code coverage testing.

            Note: This option will increase binary size and may impact performance. It should only be
            enabled when running coverage tests.

endmenu
```

## components/freertos/test_apps/freertos/sdkconfig.defaults
```kconfig
CONFIG_ESP_MAIN_TASK_STACK_SIZE=8192
CONFIG_ESP_TASK_WDT_INIT=n
CONFIG_FREERTOS_HZ=1000
CONFIG_FREERTOS_THREAD_LOCAL_STORAGE_POINTERS=3
CONFIG_FREERTOS_QUEUE_REGISTRY_SIZE=7
CONFIG_FREERTOS_TIMER_TASK_STACK_DEPTH=3000
CONFIG_FREERTOS_USE_TRACE_FACILITY=y
CONFIG_FREERTOS_WATCHPOINT_END_OF_STACK=y
```

## components/hal/Kconfig
```kconfig
menu "Hardware Abstraction Layer (HAL) and Low Level (LL)"
    choice HAL_DEFAULT_ASSERTION_LEVEL
        bool "Default HAL assertion level"
        default HAL_ASSERTION_EQUALS_SYSTEM
        help
            Set the assert behavior / level for HAL component.
            HAL component assert level can be set separately,
            but the level can't exceed the system assertion level.
            e.g. If the system assertion is disabled, then the HAL
            assertion can't be enabled either. If the system assertion
            is enable, then the HAL assertion can still be disabled
            by this Kconfig option.

        config HAL_ASSERTION_EQUALS_SYSTEM
            bool "Same as system assertion level"
        config HAL_ASSERTION_DISABLE
            bool "Disabled"
            depends on COMPILER_OPTIMIZATION_ASSERTION_LEVEL >= 0
        config HAL_ASSERTION_SILENT
            bool "Silent"
            depends on COMPILER_OPTIMIZATION_ASSERTION_LEVEL >= 1
        config HAL_ASSERTION_ENABLE
            bool "Enabled"
            depends on COMPILER_OPTIMIZATION_ASSERTION_LEVEL >= 2
    endchoice

    config HAL_DEFAULT_ASSERTION_LEVEL
        int
        default COMPILER_OPTIMIZATION_ASSERTION_LEVEL if HAL_ASSERTION_EQUALS_SYSTEM
        default 0 if HAL_ASSERTION_DISABLE
        default 1 if HAL_ASSERTION_SILENT
        default 2 if HAL_ASSERTION_ENABLE

    choice HAL_LOG_LEVEL
        bool "HAL layer log verbosity"
        default HAL_LOG_LEVEL_INFO
        # If LOG component is linked, one of the following configuration symbol will be defined.
        # Else, none will be defined, in that case, we need this HAL_LOG_LEVEL symbol.
        depends on !LOG_DEFAULT_LEVEL_NONE && !LOG_DEFAULT_LEVEL_ERROR && !LOG_DEFAULT_LEVEL_WARN && \
            !LOG_DEFAULT_LEVEL_INFO && !LOG_DEFAULT_LEVEL_DEBUG && !LOG_DEFAULT_LEVEL_VERBOSE

        help
            Specify how much output to see in HAL logs.

        config HAL_LOG_LEVEL_NONE
            bool "No output"
        config HAL_LOG_LEVEL_ERROR
            bool "Error"
        config HAL_LOG_LEVEL_WARN
            bool "Warning"
        config HAL_LOG_LEVEL_INFO
            bool "Info"
        config HAL_LOG_LEVEL_DEBUG
            bool "Debug"
        config HAL_LOG_LEVEL_VERBOSE
            bool "Verbose"
    endchoice

    config HAL_LOG_LEVEL
        int
        default 0 if HAL_LOG_LEVEL_NONE
        default 1 if HAL_LOG_LEVEL_ERROR
        default 2 if HAL_LOG_LEVEL_WARN
        default 3 if HAL_LOG_LEVEL_INFO
        default 4 if HAL_LOG_LEVEL_DEBUG
        default 5 if HAL_LOG_LEVEL_VERBOSE

    orsource "../esp_hal_wdt/Kconfig.hal_wdt"

    orsource "../esp_hal_systimer/Kconfig.hal_systimer"

    orsource "../esp_hal_gpio/Kconfig.hal_gpio"

    orsource "../esp_hal_security/Kconfig.hal_security"

endmenu
```

## components/hal/test_apps/crypto/main/Kconfig.projbuild
```kconfig
menu "Test App Configuration"

    config CRYPTO_TEST_APP_ENABLE_FPGA_TESTS
        bool "Allow enabling the crypto tests that require burning efuses"
        default y if IDF_ENV_FPGA
        default n
        help
            This includes the crypto tests that actually require burning some efuses.
            It is better to run these tests on an FPGA to avoid mistakenly burning eFuses.

    config CRYPTO_TEST_APP_ENABLE_DS_TESTS
        bool "Enable DS Peripheral test cases"
        default y
        help
            Enabling this option includes DS Peripheral related test cases in the build for supported targets.

    config CRYPTO_TEST_APP_ENABLE_HMAC_TESTS
        bool "Enable HMAC Peripheral test cases"
        default y
        help
            Enabling this option includes HMAC Peripheral related test cases in the build for supported targets.

    config CRYPTO_TEST_APP_ENABLE_ECDSA_TESTS
        depends on !CRYPTO_TEST_APP_ENABLE_HMAC_TESTS
        bool "Enable ECDSA Peripheral test cases"
        default n
        help
            Enabling this option includes ECDSA Peripheral related test cases in the build for supported targets.

    config CRYPTO_TESTAPP_USE_AES_INTERRUPT
        bool "Use interrupt for long AES operations"
        depends on  SOC_AES_SUPPORTED
        default n
        help
            Use an interrupt to coordinate long AES operations.

endmenu
```

## components/hal/test_apps/crypto/sdkconfig.defaults
```kconfig
CONFIG_ESP_TASK_WDT_EN=y
CONFIG_ESP_TASK_WDT_INIT=n
CONFIG_UNITY_ENABLE_FIXTURE=y

CONFIG_PARTITION_TABLE_CUSTOM=y
CONFIG_PARTITION_TABLE_CUSTOM_FILENAME="partitions.csv"
CONFIG_PARTITION_TABLE_FILENAME="partitions.csv"
CONFIG_PARTITION_TABLE_OFFSET=0x8000
```

## components/hal/test_apps/ecc/sdkconfig.defaults
```kconfig
CONFIG_ESP_TASK_WDT_EN=y
CONFIG_ESP_TASK_WDT_INIT=n
CONFIG_ESP_CRYPTO_DPA_PROTECTION_AT_STARTUP=n
```

## components/heap/Kconfig
```kconfig
menu "Heap memory debugging"

    choice HEAP_CORRUPTION_DETECTION
        prompt "Heap corruption detection"
        default HEAP_POISONING_DISABLED
        help
            Enable heap poisoning features to detect heap corruption caused by out-of-bounds access to heap memory.

            See the "Heap Memory Debugging" page of the IDF documentation
            for a description of each level of heap corruption detection.

        config HEAP_POISONING_DISABLED
            bool "Basic (no poisoning)"
        config HEAP_POISONING_LIGHT
            bool "Light impact"
        config HEAP_POISONING_COMPREHENSIVE
            bool "Comprehensive"
    endchoice

    choice HEAP_TRACING_DEST
        bool "Heap tracing"
        default HEAP_TRACING_OFF
        help
            Enables the heap tracing API defined in esp_heap_trace.h.

            This function causes a moderate increase in IRAM code side and a minor increase in heap function
            (malloc/free/realloc) CPU overhead, even when the tracing feature is not used.
            So it's best to keep it disabled unless tracing is being used.

        config HEAP_TRACING_OFF
            bool "Disabled"
        config HEAP_TRACING_STANDALONE
            bool "Standalone"
            select HEAP_TRACING
        config HEAP_TRACING_TOHOST
            bool "Host-based"
            select HEAP_TRACING
    endchoice

    config HEAP_TRACING
        bool
        default F
        help
            Enables/disables heap tracing API.

    config HEAP_TRACING_STACK_DEPTH
        int "Heap tracing stack depth"
        range 0 0 if IDF_TARGET_ARCH_RISCV # Disabled for RISC-V due to `__builtin_return_address` limitation
        default 0 if IDF_TARGET_ARCH_RISCV
        range 0 32
        default 2
        depends on HEAP_TRACING
        help
            Number of stack frames to save when tracing heap operation callers.

            More stack frames uses more memory in the heap trace buffer (and slows down allocation), but
            can provide useful information.

    config HEAP_USE_HOOKS
        bool "Use allocation and free hooks"
        help
            Enable the user to implement function hooks triggered for each successful allocation and free.

    config HEAP_TASK_TRACKING
        bool "Enable heap task tracking"
        help
            Enables tracking the task responsible for each heap allocation.

            This function depends on heap poisoning being enabled and adds four more bytes of overhead for each block
            allocated.

    config HEAP_TRACE_HASH_MAP
        bool "Use hash map mechanism to access heap trace records"
        depends on HEAP_TRACING_STANDALONE
        default n
        help
            Enable this flag to use a hash map to increase performance in handling
            heap trace records.

            Heap trace standalone supports storing records as a list, or a list + hash map.

            Using only a list takes less memory, but calls to 'free' will get slower as the
            list grows. This is particularly affected when using HEAP_TRACE_ALL mode.

            By using a list + hash map, calls to 'free' remain fast, at the cost of
            additional memory to store the hash map.

    config HEAP_TRACE_HASH_MAP_IN_EXT_RAM
        bool "Place hash map in external RAM"
        depends on HEAP_TRACE_HASH_MAP
        default n
        help
            When enabled this configuration forces the hash map to be placed in external RAM.

    config HEAP_TRACE_HASH_MAP_SIZE
        int "The number of entries in the hash map"
        depends on HEAP_TRACE_HASH_MAP
        default 512
        help
            Defines the number of entries in the heap trace hashmap. Each entry takes 8 bytes.
            The bigger this number is, the better the performance. Recommended range: 200 - 2000.

    config HEAP_ABORT_WHEN_ALLOCATION_FAILS
        bool "Abort if memory allocation fails"
        default n
        help
            When enabled, if a memory allocation operation fails it will cause a system abort.

    config HEAP_TLSF_USE_ROM_IMPL
        bool "Use ROM implementation of heap tlsf library"
        depends on ESP_ROM_HAS_HEAP_TLSF
        default y
        help
            Enable this flag to use heap functions from ROM instead of ESP-IDF.

            If keeping this as "n" in your project, you will have less free IRAM.
            If making this as "y" in your project, you will increase free IRAM,
            but you will lose the possibility to debug this module, and some new
            features will be added and bugs will be fixed in the IDF source
            but cannot be synced to ROM.

    config HEAP_PLACE_FUNCTION_INTO_FLASH
        bool "Force the entire heap component to be placed in flash memory"
        depends on !HEAP_TLSF_USE_ROM_IMPL
        default n
        help
            Enable this flag to save up RAM space by placing the heap component in the flash memory

            Note that it is only safe to enable this configuration if no functions from esp_heap_caps.h
            or esp_heap_trace.h are called from ISR.

endmenu
```

## components/heap/test_apps/heap_tests/sdkconfig.defaults
```kconfig
CONFIG_COMPILER_DUMP_RTL_FILES=y
CONFIG_ESP_TASK_WDT_CHECK_IDLE_TASK_CPU0=n
CONFIG_ESP_SYSTEM_MEMPROT=n # for c2 and c6 this config must be disabled for certain tests

CONFIG_COMPILER_STACK_CHECK_MODE_ALL=y
CONFIG_COMPILER_STACK_CHECK=y
CONFIG_FREERTOS_IN_IRAM=y
```

## components/heap/test_apps/sdkconfig.defaults
```kconfig
CONFIG_COMPILER_DUMP_RTL_FILES=y
CONFIG_ESP_TASK_WDT_CHECK_IDLE_TASK_CPU0=n
CONFIG_ESP_SYSTEM_MEMPROT_FEATURE=n # memory protection needs to be disabled for certain tests
```

## components/http_server/Kconfig
```kconfig
menu "HTTP Server"

config HTTPD_MAX_REQ_HDR_LEN
    int "Max HTTP Request Header Length"
    default 512
    help
        This sets the maximum supported size of headers section in HTTP request packet to be processed by the server

config HTTPD_MAX_URI_LEN
    int "Max HTTP URI Length"
    default 512
    help
        This sets the maximum supported size of HTTP request URI to be processed by the server

endmenu
```
