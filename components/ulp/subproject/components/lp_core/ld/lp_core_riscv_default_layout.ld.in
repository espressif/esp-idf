/*
 * SPDX-FileCopyrightText: 2023-2026 Espressif Systems (Shanghai) CO LTD
 * SPDX-License-Identifier: Apache-2.0
 *
 * Default layout part (base + layout + checks). Replaced by a custom layout
 * when LP_CORE_LINKER_INCLUDE is set via the LINKER_LAYOUT option. Routes the
 * application to HP RAM when CONFIG_ULP_COPROC_RUN_FROM_HP_MEM is enabled.
 */
MEMORY
{
    lp_ram(RWX) : ORIGIN = LP_CORE_USER_MEMORY_REGION_START, LENGTH = LP_CORE_USER_MEMORY_REGION_END - LP_CORE_USER_MEMORY_REGION_START
}

#if CONFIG_ULP_COPROC_RUN_FROM_HP_MEM
REGION_ALIAS("default_app_seg", hp_ram);
#else
REGION_ALIAS("default_app_seg", lp_ram);
#endif

SECTIONS
{
    LP_CORE_TEXT_START(lp_ram)
#if CONFIG_ULP_COPROC_RUN_FROM_HP_MEM
    . = ORIGIN(hp_ram);
#endif

    LP_CORE_DEFAULT_TEXT(default_app_seg)

    LP_CORE_TEXT_END()
    LP_CORE_DATA_START()

    LP_CORE_DEFAULT_DATA(default_app_seg)

    LP_CORE_DATA_END()
}
