## components/esp_psram/esp32s3/Kconfig.spiram
```kconfig
config SPIRAM
    bool "Support for external, SPI-connected RAM"
    default "n"
    help
        This enables support for an external SPI RAM chip, connected in parallel with the
        main SPI flash chip.

menu "SPI RAM config"
    depends on SPIRAM

    choice SPIRAM_MODE
        prompt "Mode (QUAD/OCT) of SPI RAM chip in use"
        default SPIRAM_MODE_QUAD

        config SPIRAM_MODE_QUAD
            bool "Quad Mode PSRAM"

        config SPIRAM_MODE_OCT
            bool "Octal Mode PSRAM"
    endchoice

    choice SPIRAM_TYPE
        prompt "Type of SPIRAM chip in use"
        default SPIRAM_TYPE_AUTO

        config SPIRAM_TYPE_AUTO
            bool "Auto-detect"

        config SPIRAM_TYPE_ESPPSRAM16
            bool "ESP-PSRAM16 or APS1604"
            depends on SPIRAM_MODE_QUAD

        config SPIRAM_TYPE_ESPPSRAM32
            bool "ESP-PSRAM32"
            depends on SPIRAM_MODE_QUAD

        config SPIRAM_TYPE_ESPPSRAM64
            bool "ESP-PSRAM64 , LY68L6400 or APS6408"
    endchoice

    config SPIRAM_CLK_IO
        int
        default 30

    config SPIRAM_CS_IO
        int
        default 26

    config SPIRAM_XIP_FROM_PSRAM
        bool "Enable Executable in place from (XiP) from PSRAM feature"
        default n
        select SPIRAM_FETCH_INSTRUCTIONS
        select SPIRAM_RODATA
        help
            Helper for selecting both `SPIRAM_FETCH_INSTRUCTIONS` and `SPIRAM_RODATA`

    config SPIRAM_FETCH_INSTRUCTIONS
        bool "Move Instructions in Flash to PSRAM"
        default n
        help
            If enabled, instructions in flash will be moved into PSRAM on startup.
            If SPIRAM_RODATA is also enabled, code that requires execution during an MSPI1 Flash operation
            can forgo being placed in IRAM. Therefore codes that need to be executing during Flash
            operation can continue working normally.

            This feature is useful for high throughput peripheral involved applications to improve
            the performance during MSPI1 flash operations. PSRAM access speed is faster than Flash access.
            So the performance is better. (see External RAM documentation for more details).

    config SPIRAM_RODATA
        bool "Move Read-Only Data in Flash to PSRAM"
        default n
        help
            If enabled, rodata in flash will be moved into PSRAM on startup.
            If SPIRAM_FETCH_INSTRUCTIONS is also enabled, code that requires execution during an MSPI1 Flash operation
            is not necessary to be placed in IRAM. Therefore codes that need to be executing during Flash
            operation can continue working normally.

            This feature is useful for high throughput peripheral involved applications to improve
            the performance during MSPI1 flash operations. PSRAM access speed is faster than Flash access.
            So the performance is better. (see External RAM documentation for more details).

    choice SPIRAM_SPEED
        prompt "Set RAM clock speed"
        default SPIRAM_SPEED_40M
        help
            Select the speed for the SPI RAM chip.

        config SPIRAM_SPEED_120M
            depends on SPIRAM_MODE_QUAD || IDF_EXPERIMENTAL_FEATURES
            bool "120MHz clock speed (READ DOCS FIRST)"

            help
                - Quad PSRAM 120 MHz is stable.

                - Octal PSRAM 120 MHz is an experimental feature, it works when
                  the temperature is stable.

                    Risks:
                        If your chip powers on at a certain temperature, then after the temperature
                        increases or decreases by approximately 20 Celsius degrees (depending on the
                        chip), the accesses to / from PSRAM will crash randomly.

        config SPIRAM_SPEED_80M
            bool "80MHz clock speed"
        config SPIRAM_SPEED_40M
            bool "40Mhz clock speed"
    endchoice

    config SPIRAM_TIMING_TUNING_POINT_VIA_TEMPERATURE_SENSOR
        depends on SPIRAM_SPEED_120M && SPIRAM_MODE_OCT && IDF_EXPERIMENTAL_FEATURES
        bool "Adjust PSRAM timing tuning point via on-chip temperature sensor in real-time"
        default n
        help
            Temperature would influence the source clock frequency so that the timing tuning point set in start-up
            might not be always proper when temperature varies in high range. This configuration would help checking
            the temperature in real-time, and adjust timing point automatically when temperature change.
            (see External RAM documentation for more details)

    config SPIRAM_TIMING_MEASURE_TEMPERATURE_INTERVAL_SECOND
        depends on SPIRAM_TIMING_TUNING_POINT_VIA_TEMPERATURE_SENSOR
        int "PSRAM timing tuning measure temperature interval (unit: second)"
        default 5
        help
            Due to adjusting timing point automatically when temperature change, the task will measure current
            temperature value in some specific interval. This configuration option would help you to set the
            proper interval. The interval unit is second.

    config SPIRAM_SPEED
        int
        default 120 if SPIRAM_SPEED_120M
        default 80 if SPIRAM_SPEED_80M
        default 40 if SPIRAM_SPEED_40M

    config SPIRAM_ECC_ENABLE
        bool "Enable SPI RAM ECC"
        default n
        depends on SPIRAM_MODE_OCT
        help
            Enable MSPI Error-Correcting Code function when accessing SPIRAM.

            If enabled, 1/16 of the SPI RAM total size will be reserved for error-correcting code.

    source "$IDF_PATH/components/esp_psram/Kconfig.spiram.common"    # insert non-chip-specific items here
endmenu
```

## components/esp_psram/esp32s31/Kconfig.spiram
```kconfig
config SPIRAM
    bool "Support for external PSRAM"
    default "n"
    help
        This enables support for an external PSRAM chip, connected in parallel with the
        main SPI flash chip.

menu "PSRAM config"
    depends on SPIRAM

    choice SPIRAM_MODE
        prompt "Line Mode of PSRAM chip in use"
        default SPIRAM_MODE_OCT

        config SPIRAM_MODE_OCT
            bool "8-Line-Mode PSRAM"
    endchoice

    choice SPIRAM_SPEED
        prompt "Set PSRAM clock speed"
        default SPIRAM_SPEED_200M
        help
            Select the speed for the PSRAM chip.

        config SPIRAM_SPEED_250M
            bool "250MHz clock speed"

        config SPIRAM_SPEED_200M
            bool "200MHz clock speed"

        config SPIRAM_SPEED_80M
            bool "80MHz clock speed"

        config SPIRAM_SPEED_40M
            bool "40MHz clock speed"
    endchoice

    config SPIRAM_SPEED
        int
        default 40 if SPIRAM_SPEED_40M
        default 80 if SPIRAM_SPEED_80M
        default 100 if SPIRAM_SPEED_100M
        default 200 if SPIRAM_SPEED_200M
        default 250 if SPIRAM_SPEED_250M

    config SPIRAM_FETCH_INSTRUCTIONS
        bool
        help
            Enable this option allows moving application's instruction segment from the SPI Flash to
            PSRAM

    config SPIRAM_RODATA
        bool
        help
            Enable this option allows moving application's rodata segment from the SPI Flash to
            PSRAM

    config SPIRAM_XIP_FROM_PSRAM
        bool "Enable Executable in place from (XiP) from PSRAM feature (READ HELP)"
        default n
        depends on SPIRAM_BOOT_INIT
        select SPIRAM_FETCH_INSTRUCTIONS
        select SPIRAM_RODATA
        select SPIRAM_FLASH_LOAD_TO_PSRAM
        help
            If enabled, firmware in flash including instructions and data will be moved into PSRAM on startup,
            firmware code will execute directly from PSRAM.

            With this option enabled, code that requires execution during an MSPI1 Flash operation
            does not have to be placed in IRAM. Therefore codes that need to be executing during Flash
            operations can continue working normally.

            Because P4 flash and PSRAM are using two separate SPI buses, moving flash content to PSRAM will
            actually increase the load of the PSRAM MSPI bus, so the exact impact on performance will be dependent
            on your app usage of PSRAM. For example, as the PSRAM bus speed could be much faster than flash bus speed,
            if the instructions and data that are used to be in flash are not accessed very frequently, you might
            get better performance with this option enabled. We suggest doing performance profiling to determine
            if enabling this option.

    config SPIRAM_FLASH_LOAD_TO_PSRAM
        bool
        help
            This is a helper indicating this condition:
            `CONFIG_SPIRAM_XIP_FROM_PSRAM && CONFIG_IDF_TARGET_ESP32S31`

    config SPIRAM_ECC_ENABLE
        bool "Enable PSRAM ECC"
        default n
        help
            Enable Error-Correcting Code function when accessing PSRAM.

            If enabled, 1/8 of the PSRAM total size will be reserved for error-correcting code.

    source "$IDF_PATH/components/esp_psram/Kconfig.spiram.common"    # insert non-chip-specific items here

endmenu

menu "PSRAM LDO Configurations"

    choice SPIRAM_LDO_VOLTAGE_DOMAIN
        prompt "PSRAM power domain voltage"
        default SPIRAM_LDO_VOLTAGE_1800_MV
        help
            Select the voltage used by the PSRAM power domain.

        config SPIRAM_LDO_VOLTAGE_1800_MV
            bool "1.8V"
    endchoice

    config SPIRAM_LDO_VOLTAGE_DOMAIN
        int
        default 1800 if SPIRAM_LDO_VOLTAGE_1800_MV
endmenu
```

## components/esp_psram/test_apps/psram_no_malloc_task_stack/sdkconfig.defaults
```kconfig
CONFIG_ESP_TASK_WDT_EN=n
CONFIG_SPIRAM=y
CONFIG_SPIRAM_USE_CAPS_ALLOC=y
CONFIG_SPIRAM_ALLOW_STACK_EXTERNAL_MEMORY=y
```

## components/esp_ringbuf/Kconfig
```kconfig
menu "ESP Ringbuf"

    config RINGBUF_IN_IRAM
        bool "Place ring buffer functions in IRAM"
        default n
        help
            Place ring buffer functions in IRAM for better performance.
            By default, ring buffer functions are placed in Flash to save IRAM.
            Enable this option if you need maximum performance for ring buffer operations.

            Note: This option increases IRAM usage.

    config RINGBUF_PLACE_ISR_FUNCTIONS_INTO_FLASH
        bool "Place ISR ringbuf functions into flash"
        depends on !RINGBUF_IN_IRAM
        default n
        help
            Place ISR ringbuf functions (like xRingbufferSendFromISR/xRingbufferReceiveFromISR) into flash.
            This frees up IRAM, but the functions can no longer be called when the cache is disabled
            or from an IRAM interrupt context.

            This option is not compatible with ESP-IDF drivers which are configured to
            run the ISR from an IRAM context, e.g. CONFIG_UART_ISR_IN_IRAM.

endmenu
```

## components/esp_ringbuf/test_apps/sdkconfig.defaults
```kconfig
# This "default" configuration is appended to all other configurations
# The contents of "sdkconfig.debug_helpers" is also appended to all other configurations (see CMakeLists.txt)
CONFIG_ESP_TASK_WDT_INIT=n
```
