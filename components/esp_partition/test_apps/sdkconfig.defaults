## components/esp_pm/test_apps/esp_pm/sdkconfig.defaults
```kconfig
# This "default" configuration is appended to all other configurations
# The contents of "sdkconfig.debug_helpers" is also appended to all other configurations (see CMakeLists.txt)
CONFIG_PM_ENABLE=y
CONFIG_FREERTOS_USE_TICKLESS_IDLE=y
CONFIG_ESP_TASK_WDT_INIT=n

# SMP FreeRTOS currently does not support power management IDF-4997
CONFIG_FREERTOS_SMP=n
```

## components/esp_pm/test_apps/esp_pm/sdkconfig.defaults.esp32s3
```kconfig
# Target specific default configurations

# Enable the ULP FSM to test it as a wake up source
CONFIG_ULP_COPROC_TYPE_FSM=y
```

## components/esp_psram/Kconfig
```kconfig
menu "ESP PSRAM"
    depends on !APP_BUILD_TYPE_PURE_RAM_APP
    # Will be refactored after !18050 to merge target-specific items

    orsource "./$IDF_TARGET/Kconfig.spiram"

endmenu  # ESP PSRAM
```
