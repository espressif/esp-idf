## components/wear_levelling/test_apps/sdkconfig.defaults
```kconfig
# General options for additional checks
CONFIG_HEAP_POISONING_COMPREHENSIVE=y
CONFIG_COMPILER_WARN_WRITE_STRINGS=y
CONFIG_BOOTLOADER_LOG_LEVEL_WARN=y
CONFIG_FREERTOS_WATCHPOINT_END_OF_STACK=y
CONFIG_COMPILER_STACK_CHECK_MODE_STRONG=y
CONFIG_COMPILER_STACK_CHECK=y

# Enable Unity fixture support
CONFIG_UNITY_ENABLE_FIXTURE=y
CONFIG_UNITY_ENABLE_IDF_TEST_RUNNER=n

# Custom partition table for this test app
CONFIG_PARTITION_TABLE_CUSTOM=y
CONFIG_PARTITION_TABLE_CUSTOM_FILENAME="partitions.csv"
```

## components/wifi_provisioning/Kconfig
```kconfig
menu "Wi-Fi Provisioning Manager"
    visible if (SOC_WIFI_SUPPORTED || SOC_WIRELESS_HOST_SUPPORTED)
    config WIFI_PROV_SCAN_MAX_ENTRIES
        int "Max Wi-Fi Scan Result Entries"
        default 16
        range 1 255
        help
            This sets the maximum number of entries of Wi-Fi scan results that will be kept by the provisioning manager

    config WIFI_PROV_AUTOSTOP_TIMEOUT
        int "Provisioning auto-stop timeout"
        default 30
        range 5 600
        help
            Time (in seconds) after which the Wi-Fi provisioning manager will auto-stop after connecting to
            a Wi-Fi network successfully.

    config WIFI_PROV_BLE_BONDING
        bool
        prompt "Enable BLE bonding"
        depends on BT_ENABLED
        help
            This option is applicable only when provisioning transport is BLE.

    config WIFI_PROV_BLE_SEC_CONN
        bool
        prompt "Enable BLE Secure connection flag"
        depends on  BT_NIMBLE_ENABLED
        default y
        help
            Used to enable Secure connection support when provisioning transport is BLE.

    config WIFI_PROV_BLE_FORCE_ENCRYPTION
        bool
        prompt "Force Link Encryption during characteristic Read / Write"
        depends on BT_ENABLED
        help
            Used to enforce link encryption when attempting to read / write characteristic

    config WIFI_PROV_BLE_NOTIFY
        bool
        prompt "Add support for Notification for provisioning BLE descriptors"
        depends on BT_ENABLED
        help
            Used to enable support Notification in BLE descriptors of prov* characteristics

    config WIFI_PROV_KEEP_BLE_ON_AFTER_PROV
        bool "Keep BT on after provisioning is done"
        depends on BT_ENABLED
        select ESP_PROTOCOMM_KEEP_BLE_ON_AFTER_BLE_STOP

    config WIFI_PROV_DISCONNECT_AFTER_PROV
        bool "Terminate connection after provisioning is done"
        depends on WIFI_PROV_KEEP_BLE_ON_AFTER_PROV
        default y
        select ESP_PROTOCOMM_DISCONNECT_AFTER_BLE_STOP

    choice WIFI_PROV_STA_SCAN_METHOD
        bool "Wifi Provisioning Scan Method"
        default WIFI_PROV_STA_ALL_CHANNEL_SCAN
        config WIFI_PROV_STA_ALL_CHANNEL_SCAN
            bool "All Channel Scan"
            help
                    Scan will end after scanning the entire channel. This option is useful in Mesh WiFi Systems.
        config WIFI_PROV_STA_FAST_SCAN
            bool "Fast Scan"
            help
                    Scan will end after an AP matching with the SSID has been detected.
    endchoice
endmenu
```

## components/wpa_supplicant/Kconfig
```kconfig
menu "Supplicant"

    config WPA_MBEDTLS_CRYPTO
        bool "Use MbedTLS crypto APIs"
        default y
        select MBEDTLS_AES_C
        select MBEDTLS_ECP_C
        select MBEDTLS_ECDH_C
        select MBEDTLS_ECDSA_C
        select MBEDTLS_TLS_ENABLED
        help
            Select this option to use MbedTLS crypto APIs which utilize hardware acceleration.

    if WPA_MBEDTLS_CRYPTO
        config WPA_MBEDTLS_TLS_CLIENT
            bool "Use MbedTLS TLS client for WiFi Enterprise connection"
            default y
            select MBEDTLS_TLS_ENABLED
            help
                Select this option to use MbedTLS TLS client for WPA2 enterprise connection.
                Please note that from MbedTLS-3.0 onwards, MbedTLS does not support SSL-3.0
                TLS-v1.0, TLS-v1.1 versions. Incase your server is using one of these version,
                it is advisable to update your server.
                Please disable this option for compatibilty with older TLS versions.
    endif

    config WPA_WAPI_PSK
        bool "Enable WAPI PSK support"
        depends on SOC_WIFI_WAPI_SUPPORT
        default n
        help
            Select this option to enable WAPI-PSK
            which is a Chinese National Standard Encryption for Wireless LANs (GB 15629.11-2003).

    config WPA_SUITE_B_192
        bool "Enable NSA suite B support with 192 bit key"
        default n
        select ESP_WIFI_GCMP_SUPPORT
        select ESP_WIFI_GMAC_SUPPORT
        help
            Select this option to enable 192 bit NSA suite-B.
            This is necessary to support WPA3 192 bit security.

    config WPA_DEBUG_PRINT
        bool "Print debug messages from WPA Supplicant"
        default n
        help
            Select this option to print logging information from WPA supplicant,
            this includes handshake information and key hex dumps depending
            on the project logging level.

            Enabling this could increase the build size ~60kb
            depending on the project logging level.

    config WPA_TESTING_OPTIONS
        bool "Add DPP testing code"
        default n
        help
            Select this to enable unity test for DPP.

    config WPA_WPS_STRICT
        bool "Strictly validate all WPS attributes"
        default n
        help
            Select this option to enable validate each WPS attribute
            rigorously. Disabling this add the workaorunds with various APs.
            Enabling this may cause inter operability issues with some APs.

    config WPA_11KV_SUPPORT
        bool "Enable 802.11k, 802.11v APIs Support"
        default n
        help
            Select this option to enable 802.11k 802.11v APIs(RRM and BTM support).
            Only APIs which are helpful for network assisted roaming
            are supported for now.
            Enable this option with BTM and RRM enabled in sta config
            to make device ready for network assisted roaming.
            BTM: BSS transition management enables an AP to request a station to transition
            to a specific AP, or to indicate to a station a set of preferred APs.
            RRM: Radio measurements enable STAs to understand the radio environment,
            it enables STAs to observe and gather data on radio link performance
            and on the radio environment. Current implementation adds beacon report,
            link measurement, neighbor report.

    config WPA_SCAN_CACHE
        bool "Keep scan results in cache"
        depends on WPA_11KV_SUPPORT
        default n
        help
            Keep scan results in cache, if not enabled, those
            will be flushed immediately.

    config WPA_MBO_SUPPORT
        bool "Enable Multi Band Operation Certification Support"
        default n
        select WPA_11KV_SUPPORT
        select WPA_SCAN_CACHE
        help
            Select this option to enable WiFi Multiband operation certification support.

    config WPA_DPP_SUPPORT
        bool "Enable DPP support"
        default n
        select WPA_MBEDTLS_CRYPTO
        help
            Select this option to enable WiFi Easy Connect Support.

    config WPA_11R_SUPPORT
        bool "Enable 802.11R (Fast Transition) Support"
        default n
        help
            Select this option to enable WiFi Fast Transition Support.

    config WPA_WPS_SOFTAP_REGISTRAR
        bool "Add WPS Registrar support in SoftAP mode"
        depends on ESP_WIFI_SOFTAP_SUPPORT
        default n
        help
            Select this option to enable WPS registrar support in softAP mode.

endmenu
```

## components/wpa_supplicant/test_apps/sdkconfig.defaults
```kconfig
CONFIG_ESP_MAIN_TASK_STACK_SIZE=8192
CONFIG_ESP_TASK_WDT=n
CONFIG_ESP_WIFI_TESTING_OPTIONS=y
CONFIG_ESP_WIFI_DPP_SUPPORT=y
CONFIG_ESP_WIFI_ENABLE_WPA3_SAE=y
```

## examples/09_openssl/main/Kconfig.projbuild
```kconfig
menu "Example Configuration"

choice OPENSSL_DEMO
    prompt "Openssl demo"
    default OPENSSL_CLIENT_DEMO
    help
        Openssl test demo mode, client or server.
        
config OPENSSL_CLIENT_DEMO
	bool "client demo"
config OPENSSL_SERVER_DEMO
	bool "server demon"
endchoice

config WIFI_SSID
    string "WiFi SSID"
    default "myssid"
    help
        SSID (network name) for the example to connect to.

config WIFI_PASSWORD
    string "WiFi Password"
    default "myssid"
    help
        WiFi password (WPA or WPA2) for the example to use.

endmenu
```

## examples/23_coap_client/main/Kconfig.projbuild
```kconfig
menu "Example Configuration"

config TARGET_DOMAIN_URI
    string "Target Uri"
    default "coap://californium.eclipse.org"
    help
        Target uri for the example to use.

config WIFI_SSID
    string "WiFi SSID"
    default "myssid"
    help
        SSID (network name) for the example to connect to.

config WIFI_PASSWORD
    string "WiFi Password"
    default "mypassword"
    help
        WiFi password (WPA or WPA2) for the example to use.

endmenu
```

## examples/24_coap_server/main/Kconfig.projbuild
```kconfig
menu "Example Configuration"

config LOCAL_PORT_NUMBER
    int "Local port number"
    range 0 65535
    default 5683
    help
        Local port number for the example to use.

config WIFI_SSID
    string "WiFi SSID"
    default "myssid"
    help
        SSID (network name) for the example to connect to.

config WIFI_PASSWORD
    string "WiFi Password"
    default "mypassword"
    help
        WiFi password (WPA or WPA2) for the example to use.

endmenu
```

## examples/bluetooth/a2dp_gatts_coex/sdkconfig.defaults
```kconfig
# Override some defaults so BT stack is enabled and
# Classic BT is enabled and BT_DRAM_RELEASE is disabled
CONFIG_BT_ENABLED=y
CONFIG_BTDM_CONTROLLER_MODE_BLE_ONLY=
CONFIG_BTDM_CONTROLLER_MODE_BR_EDR_ONLY=
CONFIG_BTDM_CONTROLLER_MODE_BTDM=y
CONFIG_BTDM_CONTROLLER_PINNED_TO_CORE_0=y
CONFIG_BTDM_CONTROLLER_PINNED_TO_CORE_1=n
CONFIG_BTDM_CONTROLLER_PINNED_TO_CORE=0
CONFIG_BTDM_CONTROLLER_HCI_MODE_VHCI=y
CONFIG_BTDM_CONTROLLER_HCI_MODE_UART_H4=n
CONFIG_BLUEDROID_ENABLED=y
CONFIG_BLUEDROID_PINNED_TO_CORE_0=y
CONFIG_BLUEDROID_PINNED_TO_CORE_1=n
CONFIG_BLUEDROID_PINNED_TO_CORE=0
CONFIG_BTC_TASK_STACK_SIZE=3072
CONFIG_BLUEDROID_MEM_DEBUG=n
CONFIG_CLASSIC_BT_ENABLED=y
CONFIG_A2DP_ENABLE=y
CONFIG_A2DP_SINK_ENABLE=y
CONFIG_A2DP_SRC_ENABLE=n
CONFIG_A2DP_SINK_TASK_STACK_SIZE=2048
CONFIG_BT_SPP_ENABLED=n
CONFIG_GATTS_ENABLE=y
CONFIG_GATTC_ENABLE=n
CONFIG_BLE_SMP_ENABLE=n
CONFIG_BLE_ENABLE_SRVCHG_REG=y
CONFIG_BT_STACK_NO_LOG=n
CONFIG_BT_ACL_CONNECTIONS=4
CONFIG_BT_ALLOCATION_FROM_SPIRAM_FIRST=n
CONFIG_BT_BLE_DYNAMIC_ENV_MEMORY=n
CONFIG_SMP_ENABLE=y
```

## examples/bluetooth/a2dp_sink/main/Kconfig.projbuild
```kconfig
menu "A2DP Example Configuration"

choice A2DP_SINK_OUTPUT
    prompt "A2DP Sink Output"
    default A2DP_SINK_OUTPUT_EXTERNAL_I2S
    help
        Select to use Internal DAC or external I2S driver

config A2DP_SINK_OUTPUT_INTERNAL_DAC
    bool "Internal DAC"
    help
        Select this to use Internal DAC sink output

config A2DP_SINK_OUTPUT_EXTERNAL_I2S
    bool "External I2S Codec"
    help
        Select this to use External I2S sink output

endchoice

config I2S_LRCK_PIN
    int "I2S LRCK (WS) GPIO"
    default 22
    depends on A2DP_SINK_OUTPUT_EXTERNAL_I2S
    help
        GPIO number to use for I2S LRCK(WS) Driver.

config I2S_BCK_PIN
    int "I2S BCK GPIO"
    default 26
    depends on A2DP_SINK_OUTPUT_EXTERNAL_I2S
    help
        GPIO number to use for I2S BCK Driver.

config I2S_DATA_PIN
    int "I2S DATA GPIO"
    default 25
    depends on A2DP_SINK_OUTPUT_EXTERNAL_I2S
    help
        GPIO number to use for I2S Data Driver.


endmenu
```

## examples/bluetooth/a2dp_sink/sdkconfig.defaults
```kconfig
# Override some defaults so BT stack is enabled and
# Classic BT is enabled and BT_DRAM_RELEASE is disabled
CONFIG_BT_ENABLED=y
CONFIG_BTDM_CONTROLLER_MODE_BLE_ONLY=
CONFIG_BTDM_CONTROLLER_MODE_BR_EDR_ONLY=y
CONFIG_BTDM_CONTROLLER_MODE_BTDM=
CONFIG_BLUEDROID_ENABLED=y
CONFIG_CLASSIC_BT_ENABLED=y
CONFIG_A2DP_ENABLE=y
CONFIG_BT_SPP_ENABLED=n
CONFIG_GATTS_ENABLE=n
CONFIG_GATTC_ENABLE=n
CONFIG_BLE_SMP_ENABLE=n
```

## examples/bluetooth/a2dp_source/sdkconfig.defaults
```kconfig
# Override some defaults so BT stack is enabled and
# Classic BT is enabled
CONFIG_BT_ENABLED=y
CONFIG_BLUEDROID_ENABLED=y
CONFIG_CLASSIC_BT_ENABLED=y
CONFIG_A2DP_ENABLE=y
CONFIG_BT_SPP_ENABLED=n
CONFIG_GATTS_ENABLE=n
CONFIG_GATTC_ENABLE=n
CONFIG_BLE_SMP_ENABLE=n
```

## examples/bluetooth/ble_adv/sdkconfig.defaults
```kconfig
# Override some defaults so BT stack is enabled
# in this example

#
# BT config
#
CONFIG_BT_ENABLED=y
```

## examples/bluetooth/ble_get_started/bluedroid/Bluedroid_GATT_Server/main/Kconfig.projbuild
```kconfig
menu "Example 'GATT SERVER' Config"

    config EXAMPLE_SET_RAW_ADV_DATA
        bool "Use raw data for advertising packets and scan response data"
        help
            If this config item is set, raw binary data will be used to generate advertising & scan response data.
            This option uses the esp_ble_gap_config_adv_data_raw() and esp_ble_gap_config_scan_rsp_data_raw()
            functions.

            If this config item is unset, advertising & scan response data is provided via a higher-level
            esp_ble_adv_data_t structure. The lower layer will generate the BLE packets. This option has higher
            overhead at runtime.

    orsource "$IDF_PATH/examples/common_components/env_caps/$IDF_TARGET/Kconfig.env_caps"

    choice EXAMPLE_BLINK_LED
        prompt "Blink LED type"
        default EXAMPLE_BLINK_LED_STRIP
        help
            Select the LED type. A normal level controlled LED or an addressable LED strip.
            The default selection is based on the Espressif DevKit boards.
            You can change the default selection according to your board.

        config EXAMPLE_BLINK_LED_GPIO
            bool "GPIO"
        config EXAMPLE_BLINK_LED_STRIP
            bool "LED strip"
    endchoice

    choice EXAMPLE_BLINK_LED_STRIP_BACKEND
        depends on EXAMPLE_BLINK_LED_STRIP
        prompt "LED strip backend peripheral"
        default EXAMPLE_BLINK_LED_STRIP_BACKEND_RMT if SOC_RMT_SUPPORTED
        default EXAMPLE_BLINK_LED_STRIP_BACKEND_SPI
        help
            Select the backend peripheral to drive the LED strip.

        config EXAMPLE_BLINK_LED_STRIP_BACKEND_RMT
            depends on SOC_RMT_SUPPORTED
            bool "RMT"
        config EXAMPLE_BLINK_LED_STRIP_BACKEND_SPI
            bool "SPI"
    endchoice

    config EXAMPLE_BLINK_GPIO
        int "Blink GPIO number"
        range ENV_GPIO_RANGE_MIN ENV_GPIO_OUT_RANGE_MAX
        default 8
        help
            GPIO number (IOxx) to blink on and off the LED.
            Some GPIOs are used for other purposes (flash connections, etc.) and cannot be used to blink.


endmenu
```

## examples/bluetooth/ble_get_started/bluedroid/Bluedroid_GATT_Server/sdkconfig.defaults.esp32c2
```kconfig
# Override some defaults so BT stack is enabled
# by default in this example
CONFIG_IDF_TARGET="esp32c2"
CONFIG_BT_ENABLED=y
# CONFIG_BT_BLE_50_FEATURES_SUPPORTED is not set
CONFIG_BT_BLE_42_FEATURES_SUPPORTED=y
# CONFIG_BT_LE_50_FEATURE_SUPPORT is not set
CONFIG_BT_LE_HCI_EVT_BUF_SIZE=257
CONFIG_XTAL_FREQ_26=y
CONFIG_EXAMPLE_BLINK_LED_STRIP=n
CONFIG_EXAMPLE_BLINK_LED_GPIO=y
CONFIG_EXAMPLE_BLINK_GPIO=8
```

## examples/bluetooth/ble_get_started/nimble/NimBLE_Beacon/sdkconfig.defaults
```kconfig
CONFIG_BT_ENABLED=y
CONFIG_BT_NIMBLE_ENABLED=y
CONFIG_BT_NIMBLE_50_FEATURE_SUPPORT=n
```
