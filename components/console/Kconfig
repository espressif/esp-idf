## components/console/Kconfig
```kconfig
menu "Console Library"

    config CONSOLE_SORTED_HELP
        bool "Enable sorted help"
        default n
        help
            Instead of listing the commands in the order of registration, the help command lists
            the available commands in sorted order, if this option is enabled.

endmenu
```

## components/console/test_apps/usb_serial_jtag_repl_no_input/sdkconfig.defaults
```kconfig
# sdkconfig.debug_helpers is also appended from CMakeLists.txt.
# ESP32-P4 bootloader starts at 0x2000 and can exceed the default 0x6000 limit.
CONFIG_PARTITION_TABLE_OFFSET=0x9000

# Match issue setup: USB-Serial-JTAG is the primary console.
CONFIG_ESP_CONSOLE_USB_SERIAL_JTAG=y

# Match issue setup: no secondary console.
CONFIG_ESP_CONSOLE_SECONDARY_NONE=y

CONFIG_ESP_SYSTEM_USE_FRAME_POINTER=y
```

## components/cxx/test_apps/exception/sdkconfig.defaults
```kconfig
CONFIG_COMPILER_CXX_EXCEPTIONS=y
CONFIG_COMPILER_CXX_EXCEPTIONS_EMG_POOL_SIZE=1024
CONFIG_BOOTLOADER_LOG_LEVEL_WARN=y
CONFIG_FREERTOS_HZ=1000
CONFIG_FREERTOS_WATCHPOINT_END_OF_STACK=y
CONFIG_HEAP_POISONING_COMPREHENSIVE=y
CONFIG_ESP_TASK_WDT_EN=n
CONFIG_COMPILER_STACK_CHECK_MODE_STRONG=y
CONFIG_COMPILER_STACK_CHECK=y
CONFIG_COMPILER_WARN_WRITE_STRINGS=y
CONFIG_UNITY_ENABLE_BACKTRACE_ON_FAIL=y
CONFIG_FREERTOS_TIMER_TASK_STACK_DEPTH=3000
```

## components/driver/Kconfig
```kconfig
menu "Legacy Driver Configurations"

    orsource "./twai/Kconfig.twai"

    menu "Legacy I2C Driver Configurations"
        depends on SOC_I2C_SUPPORTED
        config I2C_SUPPRESS_DEPRECATE_WARN
            bool "Suppress legacy driver deprecated warning"
            default n
            help
                whether to suppress the deprecation warnings when using legacy i2c driver
                (driver/i2c.h). If you want to continue using the legacy driver,
                and don't want to see related deprecation warnings, you can enable this option.

        config I2C_SKIP_LEGACY_CONFLICT_CHECK
            bool "Skip legacy conflict check"
            default n
            help
                This configuration option allows the user to bypass the conflict check mechanism with legacy code.
    endmenu # Legacy I2C Driver Configurationss

    menu "Legacy Touch Sensor Driver Configurations"
        depends on SOC_TOUCH_SENSOR_SUPPORTED
        config TOUCH_SUPPRESS_DEPRECATE_WARN
            bool "Suppress legacy driver deprecated warning"
            default n
            help
                whether to suppress the deprecation warnings when using legacy touch sensor driver
                (driver/touch_sensor.h). If you want to continue using the legacy driver,
                and don't want to see related deprecation warnings, you can enable this option.

        config TOUCH_SKIP_LEGACY_CONFLICT_CHECK
            bool "Skip legacy conflict check"
            default n
            help
                This configuration option allows the user to bypass the conflict check mechanism with legacy code.
    endmenu # Legacy Touch Sensor Driver Configurationss
endmenu  # Driver configurations
```

## components/driver/ledc/Kconfig.ledc
```kconfig
menu "LEDC Configuration"

    config LEDC_CTRL_FUNC_IN_IRAM
        bool "Place LEDC control functions into IRAM"
        default n
        help
            Place LEDC control functions (ledc_update_duty and ledc_stop) into IRAM,
            so that these functions can be IRAM-safe and able to be called in an IRAM context.
            Enabling this option can improve driver performance as well.

endmenu # LEDC Configuration
```

## components/driver/mcpwm/Kconfig.mcpwm
```kconfig
menu "MCPWM Configuration"
    depends on SOC_MCPWM_SUPPORTED
    config MCPWM_ISR_IRAM_SAFE
        bool "Place MCPWM ISR function into IRAM"
        default n
        help
            This will ensure the MCPWM interrupt handle is IRAM-Safe, allow to avoid flash
            cache misses, and also be able to run whilst the cache is disabled.
            (e.g. SPI Flash write)

    config MCPWM_CTRL_FUNC_IN_IRAM
        bool "Place MCPWM control functions into IRAM"
        default n
        help
            Place MCPWM control functions (like set_compare_value) into IRAM,
            so that these functions can be IRAM-safe and able to be called in the other IRAM interrupt context.
            Enabling this option can improve driver performance as well.

    config MCPWM_SUPPRESS_DEPRECATE_WARN
        bool "Suppress legacy driver deprecated warning"
        default n
        help
            Wether to suppress the deprecation warnings when using legacy MCPWM driver (driver/mcpwm.h).
            If you want to continue using the legacy driver, and don't want to see related deprecation warnings,
            you can enable this option.

    config MCPWM_ENABLE_DEBUG_LOG
        bool "Enable debug log"
        default n
        help
            Wether to enable the debug log message for MCPWM driver.
            Note that, this option only controls the MCPWM driver log, won't affect other drivers.
endmenu # MCPWM Configuration
```

## components/driver/pcnt/Kconfig.pcnt
```kconfig
menu "PCNT Configuration"
    depends on SOC_PCNT_SUPPORTED
    config PCNT_CTRL_FUNC_IN_IRAM
        bool "Place PCNT control functions into IRAM"
        default n
        help
            Place PCNT control functions (like start/stop) into IRAM,
            so that these functions can be IRAM-safe and able to be called in the other IRAM interrupt context.
            Enabling this option can improve driver performance as well.

    config PCNT_ISR_IRAM_SAFE
        bool "PCNT ISR IRAM-Safe"
        default n
        help
            Ensure the PCNT interrupt is IRAM-Safe by allowing the interrupt handler to be
            executable when the cache is disabled (e.g. SPI Flash write).

    config PCNT_SUPPRESS_DEPRECATE_WARN
        bool "Suppress legacy driver deprecated warning"
        default n
        help
            Wether to suppress the deprecation warnings when using legacy PCNT driver (driver/pcnt.h).
            If you want to continue using the legacy driver, and don't want to see related deprecation warnings,
            you can enable this option.

    config PCNT_ENABLE_DEBUG_LOG
        bool "Enable debug log"
        default n
        help
            Wether to enable the debug log message for PCNT driver.
            Note that, this option only controls the PCNT driver log, won't affect other drivers.
endmenu # PCNT Configuration
```

## components/driver/test_apps/gpio/sdkconfig.defaults
```kconfig
CONFIG_FREERTOS_HZ=1000
CONFIG_ESP_TASK_WDT=n
CONFIG_SDM_SUPPRESS_DEPRECATE_WARN=y
```

## components/driver/test_apps/gptimer/sdkconfig.defaults
```kconfig
CONFIG_FREERTOS_HZ=1000
CONFIG_ESP_TASK_WDT=n
# Disable nano printf, because we need to print the timer count in %llu format
CONFIG_NEWLIB_NANO_FORMAT=n
```

## components/driver/test_apps/i2s/sdkconfig.defaults
```kconfig
CONFIG_I2S_SUPPRESS_DEPRECATE_WARN=y
CONFIG_PCNT_SUPPRESS_DEPRECATE_WARN=y
CONFIG_ESP_TASK_WDT=n
```

## components/driver/test_apps/i2s_test_apps/legacy_i2s_adc_dac/sdkconfig.defaults
```kconfig
CONFIG_I2S_SUPPRESS_DEPRECATE_WARN=y
CONFIG_ADC_SUPPRESS_DEPRECATE_WARN=y
CONFIG_DAC_SUPPRESS_DEPRECATE_WARN=y
CONFIG_I2S_ENABLE_DEBUG_LOG=y
CONFIG_ESP_TASK_WDT_EN=n
```

## components/driver/test_apps/i2s_test_apps/legacy_i2s_driver/sdkconfig.defaults
```kconfig
CONFIG_I2S_SUPPRESS_DEPRECATE_WARN=y
CONFIG_ADC_SUPPRESS_DEPRECATE_WARN=y
CONFIG_I2S_ENABLE_DEBUG_LOG=y
CONFIG_ESP_TASK_WDT=n
```

## components/driver/test_apps/ledc/sdkconfig.defaults
```kconfig
CONFIG_FREERTOS_HZ=1000
CONFIG_ESP_TASK_WDT_INIT=n
# Disable memory protection, because "LEDC continue work after software reset" test case requires a cpu reset
CONFIG_ESP_SYSTEM_MEMPROT_FEATURE=n
```

## components/driver/test_apps/legacy_adc_driver/sdkconfig.defaults
```kconfig
CONFIG_FREERTOS_HZ=1000
CONFIG_ESP_TASK_WDT=n
CONFIG_ADC_SUPPRESS_DEPRECATE_WARN=y
```

## components/driver/test_apps/legacy_i2c_driver/sdkconfig.defaults
```kconfig
CONFIG_FREERTOS_HZ=1000
CONFIG_ESP_TASK_WDT_INIT=n

CONFIG_I2C_SUPPRESS_DEPRECATE_WARN=y
```

## components/driver/test_apps/legacy_mcpwm_driver/sdkconfig.defaults
```kconfig
CONFIG_FREERTOS_HZ=1000
CONFIG_ESP_TASK_WDT=n
CONFIG_MCPWM_SUPPRESS_DEPRECATE_WARN=y
```

## components/driver/test_apps/legacy_pcnt_driver/sdkconfig.defaults
```kconfig
# Defaults for generating a new "sdkconfig" file (project settings).
# https://docs.espressif.com/projects/esp-idf/en/latest/esp32/api-guides/build-system.html#custom-sdkconfig-defaults
#
# NOTE - if this file changes, to get new defaults, you must erase any existing
# "sdkconfig" file (this will undo manual settings from "idf.py menuconfig").

CONFIG_FREERTOS_HZ=1000
CONFIG_ESP_TASK_WDT=n
CONFIG_PCNT_SUPPRESS_DEPRECATE_WARN=y
```

## components/driver/test_apps/legacy_rmt_driver/sdkconfig.defaults
```kconfig
CONFIG_FREERTOS_HZ=1000
CONFIG_ESP_TASK_WDT=n
CONFIG_RMT_SUPPRESS_DEPRECATE_WARN=y
```

## components/driver/test_apps/legacy_timer_driver/sdkconfig.defaults
```kconfig
CONFIG_FREERTOS_HZ=1000
CONFIG_ESP_TASK_WDT=n
CONFIG_GPTIMER_SUPPRESS_DEPRECATE_WARN=y
```

## components/driver/test_apps/legacy_twai/sdkconfig.defaults
```kconfig
CONFIG_FREERTOS_HZ=1000
CONFIG_ESP_TASK_WDT_INIT=n
# primitives for checking sleep internal state
CONFIG_ESP_SLEEP_DEBUG=y
```

## components/driver/test_apps/rmt/sdkconfig.defaults
```kconfig
CONFIG_FREERTOS_HZ=1000
CONFIG_ESP_TASK_WDT=n
CONFIG_UNITY_ENABLE_64BIT=y
CONFIG_ESP_MAIN_TASK_STACK_SIZE=4096
```

## components/driver/test_apps/rmt/sdkconfig.defaults.esp32s3
```kconfig
CONFIG_SPIRAM=y
CONFIG_SPIRAM_MODE_OCT=y
CONFIG_SPIRAM_SPEED_80M=y
CONFIG_SPIRAM_MALLOC_ALWAYSINTERNAL=0
```
