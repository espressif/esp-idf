## components/esp_system/port/soc/esp32/Kconfig.memory
```kconfig
menu "Memory"

    config ESP32_RTCDATA_IN_FAST_MEM
        bool "Place RTC_DATA_ATTR and RTC_RODATA_ATTR variables into RTC fast memory segment"
        default n
        depends on FREERTOS_UNICORE
        help
            This option allows to place .rtc_data and .rtc_rodata sections into
            RTC fast memory segment to free the slow memory region for ULP programs.
            This option depends on the CONFIG_FREERTOS_UNICORE option because RTC fast memory
            can be accessed only by PRO_CPU core.

    config ESP32_USE_FIXED_STATIC_RAM_SIZE
        bool "Use fixed static RAM size"
        default n
        help
            If this option is disabled, the DRAM part of the heap starts right after the .bss section,
            within the dram0_0 region. As a result, adding or removing some static variables
            will change the available heap size.

            If this option is enabled, the DRAM part of the heap starts right after the dram0_0 region,
            where its length is set with ESP32_FIXED_STATIC_RAM_SIZE

    config ESP32_FIXED_STATIC_RAM_SIZE
        hex "Fixed Static RAM size"
        default 0x1E000
        range 0 0x2c200
        depends on ESP32_USE_FIXED_STATIC_RAM_SIZE
        help
            RAM size dedicated for static variables (.data & .bss sections).
            Please note that the actual length will be reduced by BTDM_RESERVE_DRAM if Bluetooth
            controller is enabled.

    config ESP32_IRAM_AS_8BIT_ACCESSIBLE_MEMORY
        bool "Enable IRAM as 8 bit accessible memory"
        depends on FREERTOS_UNICORE
        help
            If enabled, application can use IRAM as byte accessible region for storing data
            (Note: IRAM region cannot be used as task stack)

            This is possible due to handling of exceptions `LoadStoreError (3)` and `LoadStoreAlignmentError (9)`
            Each unaligned read/write access will incur a penalty of maximum of 167 CPU cycles.

    menu "Non-backward compatible options"

        config ESP_SYSTEM_ESP32_SRAM1_REGION_AS_IRAM
            bool "Reserve parts of SRAM1 for app IRAM (WARNING, read help before enabling)"
            depends on !ESP32_TRAX
            help
                Reserve parts of SRAM1 for app IRAM which was previously reserved for bootloader DRAM.
                If booting an app on an older bootloader from before this option was introduced, the app will fail
                to boot due to not recognizing the new IRAM memory area.

                If this is the case please test carefully before pushing out any OTA updates.

    endmenu

endmenu # Memory
```

## components/esp_system/port/soc/esp32/Kconfig.system
```kconfig
config ESP32_DISABLE_BASIC_ROM_CONSOLE
    bool "Permanently disable BASIC ROM Console"
    default n
    help
        If set, the first time the app boots it will disable the BASIC ROM Console
        permanently (by burning an eFuse).

        Otherwise, the BASIC ROM Console starts on reset if no valid bootloader is
        read from the flash.

        (Enabling secure boot also disables the BASIC ROM Console by default.)

config ESP32_ECO3_CACHE_LOCK_FIX
    bool
    default y
    depends on !ESP_SYSTEM_SINGLE_CORE_MODE && SPIRAM
```

## components/esp_system/port/soc/esp32/Kconfig.tracemem
```kconfig
menu "Trace memory"

    config ESP32_MEMMAP_TRACEMEM
        bool
        default "n"

    config ESP32_MEMMAP_TRACEMEM_TWOBANKS
        bool
        default "n"

    config ESP32_TRAX
        bool "Use TRAX tracing feature"
        default "n"
        select ESP32_MEMMAP_TRACEMEM
        help
            The ESP32 contains a feature which allows you to trace the execution path the processor
            has taken through the program. This is stored in a chunk of 32K (16K for single-processor)
            of memory that can't be used for general purposes anymore. Disable this if you do not know
            what this is.

    config ESP32_TRAX_TWOBANKS
        bool "Reserve memory for tracing both pro as well as app cpu execution"
        default "n"
        depends on ESP32_TRAX && !ESP_SYSTEM_SINGLE_CORE_MODE
        select ESP32_MEMMAP_TRACEMEM_TWOBANKS
        help
            The ESP32 contains a feature which allows you to trace the execution path the processor
            has taken through the program. This is stored in a chunk of 32K (16K for single-processor)
            of memory that can't be used for general purposes anymore. Disable this if you do not know
            what this is.

            # Memory to reverse for trace, used in linker script
    config ESP32_TRACEMEM_RESERVE_DRAM
        hex
        default 0x8000 if ESP32_MEMMAP_TRACEMEM && ESP32_MEMMAP_TRACEMEM_TWOBANKS
        default 0x4000 if ESP32_MEMMAP_TRACEMEM && !ESP32_MEMMAP_TRACEMEM_TWOBANKS
        default 0x0

endmenu  # Trace memory
```

## components/esp_system/port/soc/esp32c2/Kconfig.cache
```kconfig
menu "Cache config"

    config ESP32C2_INSTRUCTION_CACHE_WRAP
        # TODO: IDF-4194
        bool
        prompt "Instruction cache wrap"
        help
            If enabled, instruction cache will use wrap mode to read spi flash.
            The wrap length is fixed to 32B

endmenu
```

## components/esp_system/port/soc/esp32c3/Kconfig.cpu
```kconfig
choice ESP_DEFAULT_CPU_FREQ_MHZ
    prompt "CPU frequency"
    default ESP_DEFAULT_CPU_FREQ_MHZ_40 if IDF_ENV_FPGA
    default ESP_DEFAULT_CPU_FREQ_MHZ_160
    help
        CPU frequency to be set on application startup.

    config ESP_DEFAULT_CPU_FREQ_MHZ_40
        bool "40 MHz"
        depends on IDF_ENV_FPGA
    config ESP_DEFAULT_CPU_FREQ_MHZ_80
        bool "80 MHz"
    config ESP_DEFAULT_CPU_FREQ_MHZ_160
        bool "160 MHz"
endchoice

config ESP_DEFAULT_CPU_FREQ_MHZ
    int
    default 40 if ESP_DEFAULT_CPU_FREQ_MHZ_40
    default 80 if ESP_DEFAULT_CPU_FREQ_MHZ_80
    default 160 if ESP_DEFAULT_CPU_FREQ_MHZ_160
```

## components/esp_system/port/soc/esp32c3/Kconfig.system
```kconfig
menu "Brownout Detector"
    config ESP_BROWNOUT_DET
        bool "Hardware brownout detect & reset"
        depends on !IDF_ENV_FPGA
        default y
        help
            The ESP32-C3 has a built-in brownout detector which can detect if the voltage is lower than
            a specific value. If this happens, it will reset the chip in order to prevent unintended
            behaviour.

    choice ESP_BROWNOUT_DET_LVL_SEL
        prompt "Brownout voltage level"
        depends on ESP_BROWNOUT_DET
        default ESP_BROWNOUT_DET_LVL_SEL_7
        help
            The brownout detector will reset the chip when the supply voltage is approximately
            below this level. Note that there may be some variation of brownout voltage level
            between each chip.

            #The voltage levels here are estimates, more work needs to be done to figure out the exact voltages
            #of the brownout threshold levels.
        config ESP_BROWNOUT_DET_LVL_SEL_7
            bool "2.51V"
        config ESP_BROWNOUT_DET_LVL_SEL_6
            bool "2.64V"
        config ESP_BROWNOUT_DET_LVL_SEL_5
            bool "2.76V"
        config ESP_BROWNOUT_DET_LVL_SEL_4
            bool "2.92V"
        config ESP_BROWNOUT_DET_LVL_SEL_3
            bool "3.10V"
        config ESP_BROWNOUT_DET_LVL_SEL_2
            bool "3.27V"
    endchoice

    config ESP_BROWNOUT_DET_LVL
        int
        default 2 if ESP_BROWNOUT_DET_LVL_SEL_2
        default 3 if ESP_BROWNOUT_DET_LVL_SEL_3
        default 4 if ESP_BROWNOUT_DET_LVL_SEL_4
        default 5 if ESP_BROWNOUT_DET_LVL_SEL_5
        default 6 if ESP_BROWNOUT_DET_LVL_SEL_6
        default 7 if ESP_BROWNOUT_DET_LVL_SEL_7

endmenu
```

## components/esp_system/port/soc/esp32c5/Kconfig.cpu
```kconfig
choice ESP_DEFAULT_CPU_FREQ_MHZ
    prompt "CPU frequency"
    default ESP_DEFAULT_CPU_FREQ_MHZ_40 if IDF_ENV_FPGA
    default ESP_DEFAULT_CPU_FREQ_MHZ_160 if SECURE_FLASH_ENC_ENABLED
    default ESP_DEFAULT_CPU_FREQ_MHZ_240
    help
        CPU frequency to be set on application startup. For flash encryption enabled case,
        the default CPU frequency is 160MHz as the encrypted flash writes are not stable at
        higher CPU clock. Please see SoC Errata document for details.

    config ESP_DEFAULT_CPU_FREQ_MHZ_40
        bool "40 MHz"
        depends on IDF_ENV_FPGA
    config ESP_DEFAULT_CPU_FREQ_MHZ_80
        bool "80 MHz"
    config ESP_DEFAULT_CPU_FREQ_MHZ_160
        bool "160 MHz"
    config ESP_DEFAULT_CPU_FREQ_MHZ_240
        # Encrypted flash writes aren't supported at 240 MHz.
        # Please see SoC Errata document for details.
        depends on !SECURE_FLASH_ENC_ENABLED
        bool "240 MHz"
        help
            When 240MHz is selected, esp_flash_write_encrypted() will automatically limit CPU frequency during
            execution:
            - v1.2 and above chips: limited to 160MHz
            - v1.0 and below chips: limited to 80MHz
            When 160MHz or lower is selected, no frequency limiting occurs during encrypted writes. Please refer to
            the ESP32-C5 SoC Errata document for more details.
endchoice

config ESP_DEFAULT_CPU_FREQ_MHZ
    int
    default 40 if ESP_DEFAULT_CPU_FREQ_MHZ_40
    default 80 if ESP_DEFAULT_CPU_FREQ_MHZ_80
    default 160 if ESP_DEFAULT_CPU_FREQ_MHZ_160
    default 240 if ESP_DEFAULT_CPU_FREQ_MHZ_240
```

## components/esp_system/port/soc/esp32c61/Kconfig.cache
```kconfig
menu "Cache config"

    config CACHE_L1_CACHE_SIZE
        hex
        default 0x8000

    config CACHE_L1_CACHE_LINE_SIZE
        int
        default 32

endmenu  # Cache config
```

## components/esp_system/port/soc/esp32h2/Kconfig.cpu
```kconfig
choice ESP_DEFAULT_CPU_FREQ_MHZ
    prompt "CPU frequency"
    default ESP_DEFAULT_CPU_FREQ_MHZ_32 if IDF_ENV_FPGA
    default ESP_DEFAULT_CPU_FREQ_MHZ_96
    help
        CPU frequency to be set on application startup.

    config ESP_DEFAULT_CPU_FREQ_MHZ_16
        bool "16 MHz"
        depends on IDF_ENV_FPGA
    config ESP_DEFAULT_CPU_FREQ_MHZ_32
        bool "32 MHz"
        depends on IDF_ENV_FPGA
    config ESP_DEFAULT_CPU_FREQ_MHZ_48
        bool "48 MHz"
        depends on !IDF_ENV_FPGA
    config ESP_DEFAULT_CPU_FREQ_MHZ_64
        bool "64 MHz"
    config ESP_DEFAULT_CPU_FREQ_MHZ_96
        bool "96 MHz"
        depends on !IDF_ENV_FPGA
endchoice

config ESP_DEFAULT_CPU_FREQ_MHZ
    int
    default 16 if ESP_DEFAULT_CPU_FREQ_MHZ_16
    default 32 if ESP_DEFAULT_CPU_FREQ_MHZ_32
    default 48 if ESP_DEFAULT_CPU_FREQ_MHZ_48
    default 64 if ESP_DEFAULT_CPU_FREQ_MHZ_64
    default 96 if ESP_DEFAULT_CPU_FREQ_MHZ_96
```

## components/esp_system/port/soc/esp32h2/Kconfig.system
```kconfig
menu "Brownout Detector"
    config ESP_BROWNOUT_DET
        bool "Hardware brownout detect & reset"
        depends on !IDF_ENV_FPGA
        default y
        help
            The ESP32-H2 has a built-in brownout detector which can detect if the voltage is lower than
            a specific value. If this happens, it will reset the chip in order to prevent unintended
            behaviour.

    choice ESP_BROWNOUT_DET_LVL_SEL
        prompt "Brownout voltage level"
        depends on ESP_BROWNOUT_DET
        default ESP_BROWNOUT_DET_LVL_SEL_0
        help
            The brownout detector will reset the chip when the supply voltage is approximately
            below this level. Note that there may be some variation of brownout voltage level
            between each chip.

            #The voltage levels here are estimates, more work needs to be done to figure out the exact voltages
            #of the brownout threshold levels.
        config ESP_BROWNOUT_DET_LVL_SEL_7
            bool "2.94V"
        config ESP_BROWNOUT_DET_LVL_SEL_6
            bool "2.88V"
        config ESP_BROWNOUT_DET_LVL_SEL_5
            bool "2.83V"
        config ESP_BROWNOUT_DET_LVL_SEL_4
            bool "2.78V"
        config ESP_BROWNOUT_DET_LVL_SEL_3
            bool "2.73V"
        config ESP_BROWNOUT_DET_LVL_SEL_2
            bool "2.67V"
        config ESP_BROWNOUT_DET_LVL_SEL_1
            bool "2.62V"
        config ESP_BROWNOUT_DET_LVL_SEL_0
            bool "2.57V"
    endchoice

    config ESP_BROWNOUT_DET_LVL
        int
        default 0 if ESP_BROWNOUT_DET_LVL_SEL_0
        default 1 if ESP_BROWNOUT_DET_LVL_SEL_1
        default 2 if ESP_BROWNOUT_DET_LVL_SEL_2
        default 3 if ESP_BROWNOUT_DET_LVL_SEL_3
        default 4 if ESP_BROWNOUT_DET_LVL_SEL_4
        default 5 if ESP_BROWNOUT_DET_LVL_SEL_5
        default 6 if ESP_BROWNOUT_DET_LVL_SEL_6
        default 7 if ESP_BROWNOUT_DET_LVL_SEL_7

endmenu
```
