## components/esp_driver_i2c/test_apps/i2c_test_apps/sdkconfig.defaults
```kconfig
CONFIG_FREERTOS_HZ=1000
CONFIG_ESP_TASK_WDT_INIT=n
CONFIG_I2C_ENABLE_SLAVE_DRIVER_VERSION_2=y
```

## components/esp_driver_i2s/Kconfig
```kconfig
menu "ESP-Driver:I2S Configurations"
    depends on SOC_I2S_SUPPORTED
    config I2S_ISR_IRAM_SAFE
        bool "I2S ISR IRAM-Safe"
        default n
        help
            Ensure the I2S interrupt is IRAM-Safe by allowing the interrupt handler to be
            executable when the cache is disabled (e.g. SPI Flash write).

    config I2S_ENABLE_DEBUG_LOG
        bool "Enable I2S debug log"
        default n
        help
            whether to enable the debug log message for I2S driver.
            Note that, this option only controls the I2S driver log, will not affect other drivers.
endmenu # I2S Configuration
```

## components/esp_driver_i2s/test_apps/i2s/sdkconfig.defaults
```kconfig
CONFIG_I2S_ENABLE_DEBUG_LOG=y
CONFIG_ESP_TASK_WDT_EN=n
# primitives for checking sleep internal state
CONFIG_ESP_SLEEP_DEBUG=y
```

## components/esp_driver_i3c/Kconfig
```kconfig
menu "ESP-Driver:I3C Master Configurations"

    config I3C_MASTER_ISR_CACHE_SAFE
        bool "I3C ISR Cache-Safe"
        select I3C_MASTER_ISR_HANDLER_IN_IRAM
        select GDMA_ISR_HANDLER_IN_IRAM if SOC_GDMA_SUPPORTED
        default n
        help
            Ensure the I3C interrupt is Cache-Safe by allowing the interrupt handler to be
            executable when the cache is disabled (e.g. SPI Flash write).

    config I3C_MASTER_ENABLE_DEBUG_LOG
        bool "Enable I3C debug log"
        default n
        help
            whether to enable the debug log message for I3C driver.
            Note that this option only controls the I3C driver log, will not affect other drivers.

    config I3C_MASTER_ISR_HANDLER_IN_IRAM
        bool "Place I3C master ISR handler into IRAM"
        select GDMA_CTRL_FUNC_IN_IRAM if SOC_GDMA_SUPPORTED
        default n
        help
            Place I3C master ISR handler into IRAM for better performance and fewer cache misses.

endmenu # I3C Master Configurations
```

## components/esp_driver_isp/Kconfig
```kconfig
menu "ESP-Driver:ISP Configurations"
    depends on SOC_ISP_SUPPORTED

    config ISP_ISR_IRAM_SAFE
        bool "ISP driver ISR IRAM-Safe"
        default n
        help
            Ensure the ISP driver ISR is IRAM-Safe. When enabled, the ISR handler
            will be available when the cache is disabled.

    config ISP_CTRL_FUNC_IN_IRAM
        bool "Place ISP control functions into IRAM"
        default n
        help
            Place ISP control functions into IRAM,
            so that these functions can be IRAM-safe and able to be called in the other IRAM interrupt context.
            Enabling this option can improve driver performance as well.

            Function list:
            - `esp_isp_sharpen_configure`

endmenu # ISP Configuration
```

## components/esp_driver_jpeg/Kconfig
```kconfig
menu "ESP-Driver:JPEG-Codec Configurations"
    depends on SOC_JPEG_CODEC_SUPPORTED

    config JPEG_ENABLE_DEBUG_LOG
        bool "Enable debug log"
        default n
        help
            whether to enable the debug log message for JPEG driver.
            Note that, this option only controls the JPEG driver log, won't affect other drivers.
            Please also note, enable this option will make jpeg codec process speed much slower.

endmenu
```

## components/esp_driver_jpeg/test_apps/jpeg_test_apps/sdkconfig.defaults
```kconfig
CONFIG_FREERTOS_HZ=1000
CONFIG_ESP_TASK_WDT_EN=n

# SPIRAM configurations

CONFIG_SPIRAM=y
CONFIG_SPIRAM_MODE_HEX=y
CONFIG_SPIRAM_SPEED_200M=y
CONFIG_IDF_EXPERIMENTAL_FEATURES=y

# Partition table configurations

CONFIG_PARTITION_TABLE_CUSTOM=y
CONFIG_PARTITION_TABLE_CUSTOM_FILENAME="partitions.csv"
CONFIG_ESPTOOLPY_FLASHSIZE_4MB=y

# primitives for checking sleep internal state
CONFIG_ESP_SLEEP_DEBUG=y
```

## components/esp_driver_jpeg/test_apps/jpeg_test_apps/sdkconfig.defaults.esp32s31
```kconfig
# SPIRAM configurations

CONFIG_SPIRAM=y
CONFIG_SPIRAM_MODE_OCT=y
CONFIG_SPIRAM_SPEED_250M=y
CONFIG_IDF_EXPERIMENTAL_FEATURES=y
```

## components/esp_driver_mcpwm/Kconfig
```kconfig
menu "ESP-Driver:MCPWM Configurations"
    depends on SOC_MCPWM_SUPPORTED

    config MCPWM_ISR_HANDLER_IN_IRAM
        bool "Place MCPWM ISR handler into IRAM to reduce latency"
        default y
        select MCPWM_OBJ_CACHE_SAFE
        help
            Place MCPWM ISR handler(s) in IRAM to reduce latency caused by cache miss.

    config MCPWM_ISR_CACHE_SAFE
        bool "Allow MCPWM ISR to execute when cache is disabled" if !SPI_FLASH_AUTO_SUSPEND
        default n
        select MCPWM_ISR_HANDLER_IN_IRAM
        help
            Enable this option to allow the MCPWM Interrupt Service Routine (ISR)
            to execute even when the cache is disabled. This can be useful in scenarios where the cache
            might be turned off, but the MCPWM functionality is still required to operate correctly.

    config MCPWM_CTRL_FUNC_IN_IRAM
        bool "Place MCPWM control functions in IRAM"
        default n
        select MCPWM_OBJ_CACHE_SAFE
        help
            Place MCPWM control functions in IRAM, to reduce latency caused by cache miss.
            If enabled, these functions can also be called when cache is disabled.

    config MCPWM_OBJ_CACHE_SAFE
        bool
        default n
        help
            This will ensure the MCPWM object will not be allocated from a memory region
            where its cache can be disabled.

    config MCPWM_ENABLE_DEBUG_LOG
        bool "Force enable debug log"
        default n
        help
            If enabled, MCPWM component will:
            1. ignore the global logging settings
            2. compile all log messages into the binary
            3. set the runtime log level to VERBOSE
            Please enable this option with caution, as it will increase the binary size.
endmenu
```

## components/esp_driver_parlio/Kconfig
```kconfig
menu "ESP-Driver:Parallel IO Configurations"
    depends on SOC_PARLIO_SUPPORTED

    config PARLIO_TX_ISR_HANDLER_IN_IRAM
        bool "Place Parallel IO TX ISR handler in IRAM to reduce latency"
        default y
        select PARLIO_OBJ_CACHE_SAFE
        select GDMA_CTRL_FUNC_IN_IRAM
        select ESP_PERIPH_CTRL_FUNC_IN_IRAM
        help
            Place Parallel IO TX ISR handler in IRAM to reduce latency caused by cache miss.

    config PARLIO_RX_ISR_HANDLER_IN_IRAM
        bool "Place Parallel IO RX ISR handler in IRAM to reduce latency"
        default y
        select PARLIO_OBJ_CACHE_SAFE
        select GDMA_CTRL_FUNC_IN_IRAM
        help
            Place Parallel IO RX ISR handler in IRAM to reduce latency caused by cache miss.

    config PARLIO_TX_ISR_CACHE_SAFE
        bool "Allow Parallel IO TX ISR to execute when cache is disabled"
        select PARLIO_TX_ISR_HANDLER_IN_IRAM
        select GDMA_ISR_HANDLER_IN_IRAM
        default n
        help
            Enable this option to allow the Parallel IO TX Interrupt Service Routine (ISR)
            to execute even when the cache is disabled. This can be useful in scenarios where the cache
            might be turned off, but the Parallel IO TX functionality is still required to operate correctly.

    config PARLIO_RX_ISR_CACHE_SAFE
        bool "Allow Parallel IO RX ISR to execute when cache is disabled"
        select PARLIO_RX_ISR_HANDLER_IN_IRAM
        select GDMA_ISR_HANDLER_IN_IRAM
        default n
        help
            Enable this option to allow the Parallel IO RX Interrupt Service Routine (ISR)
            to execute even when the cache is disabled. This can be useful in scenarios where the cache
            might be turned off, but the Parallel IO RX functionality is still required to operate correctly.

    config PARLIO_OBJ_CACHE_SAFE
        bool
        default n
        help
            This will ensure the driver object will not be allocated from a memory region
            where its cache can be disabled.

    config PARLIO_ENABLE_DEBUG_LOG
        bool "Force enable debug log"
        default n
        help
            If enabled, Parallel IO driver component will:
            1. ignore the global logging settings
            2. compile all log messages into the binary
            3. set the runtime log level to VERBOSE
            Please enable this option by caution, as it will increase the binary size.

    config PARLIO_ISR_IRAM_SAFE
        bool "Parallel IO ISR IRAM-Safe (Deprecated)"
        default n
        select PARLIO_TX_ISR_CACHE_SAFE
        select PARLIO_RX_ISR_CACHE_SAFE
        help
            Ensure the Parallel IO interrupt is IRAM-Safe by allowing the interrupt handler to be
            executable when the cache is disabled (e.g. SPI Flash write).

endmenu # Parallel IO Configuration
```

## components/esp_driver_parlio/test_apps/parlio/sdkconfig.defaults.esp32s31
```kconfig
CONFIG_SPIRAM=y
CONFIG_SPIRAM_SPEED_250M=y
CONFIG_SPIRAM_MALLOC_ALWAYSINTERNAL=0
```

## components/esp_driver_pcnt/Kconfig
```kconfig
menu "ESP-Driver:PCNT Configurations"
    depends on SOC_PCNT_SUPPORTED
    config PCNT_CTRL_FUNC_IN_IRAM
        bool "Place PCNT control functions into IRAM"
        default n
        help
            Place PCNT control functions (like start/stop) into IRAM,
            so that these functions can be IRAM-safe and able to be called in the other IRAM interrupt context.
            Enabling this option can improve driver performance as well.

    config PCNT_ISR_IRAM_SAFE
        bool "PCNT ISR IRAM-Safe"
        default n
        help
            Ensure the PCNT interrupt is IRAM-Safe by allowing the interrupt handler to be
            executable when the cache is disabled (e.g. SPI Flash write).

    config PCNT_ENABLE_DEBUG_LOG
        bool "Enable debug log"
        default n
        help
            whether to enable the debug log message for PCNT driver.
            Note that, this option only controls the PCNT driver log, won't affect other drivers.
endmenu
```

## components/esp_driver_ppa/test_apps/sdkconfig.defaults
```kconfig
CONFIG_FREERTOS_HZ=1000
CONFIG_ESP_TASK_WDT_EN=n
CONFIG_IDF_EXPERIMENTAL_FEATURES=y

CONFIG_ESP_SLEEP_DEBUG=y
```

## components/esp_driver_rmt/Kconfig
```kconfig
menu "ESP-Driver:RMT Configurations"
    depends on SOC_RMT_SUPPORTED

    config RMT_ENCODER_FUNC_IN_IRAM
        bool "Place RMT encoder function in IRAM"
        default y
        help
            Place RMT encoder function into IRAM for better performance and fewer cache misses.

    config RMT_TX_ISR_HANDLER_IN_IRAM
        bool "Place RMT TX ISR handler in IRAM to reduce latency"
        default y
        select RMT_OBJ_CACHE_SAFE
        help
            Place RMT TX ISR handler in IRAM to reduce latency caused by cache miss.

    config RMT_RX_ISR_HANDLER_IN_IRAM
        bool "Place RMT RX ISR handler in IRAM to reduce latency"
        default y
        select RMT_OBJ_CACHE_SAFE
        help
            Place RMT RX ISR handler in IRAM to reduce latency caused by cache miss.

    config RMT_RECV_FUNC_IN_IRAM
        bool "Place RMT receive function in IRAM"
        default n
        select RMT_OBJ_CACHE_SAFE
        help
            Place RMT receive function into IRAM for better performance and fewer cache misses.

    config RMT_TX_ISR_CACHE_SAFE
        bool "Allow RMT TX ISR to execute when cache is disabled" if !SPI_FLASH_AUTO_SUSPEND
        select RMT_TX_ISR_HANDLER_IN_IRAM
        select RMT_ENCODER_FUNC_IN_IRAM
        default n
        help
            Enable this option to allow the RMT TX Interrupt Service Routine (ISR)
            to execute even when the cache is disabled. This can be useful in scenarios where the cache
            might be turned off, but the RMT TX functionality is still required to operate correctly.

    config RMT_RX_ISR_CACHE_SAFE
        bool "Allow RMT RX ISR to execute when cache is disabled" if !SPI_FLASH_AUTO_SUSPEND
        select RMT_RX_ISR_HANDLER_IN_IRAM
        default n
        help
            Enable this option to allow the RMT RX Interrupt Service Routine (ISR)
            to execute even when the cache is disabled. This can be useful in scenarios where the cache
            might be turned off, but the RMT RX functionality is still required to operate correctly.

    config RMT_OBJ_CACHE_SAFE
        bool
        default n
        help
            This will ensure the RMT object will not be allocated from a memory region
            where its cache can be disabled.

    config RMT_ENABLE_DEBUG_LOG
        bool "Force enable debug log"
        default n
        help
            If enabled, RMT driver component will:
            1. ignore the global logging settings
            2. compile all log messages into the binary
            3. set the runtime log level to VERBOSE
            Please enable this option by caution, as it will increase the binary size.

    config RMT_ISR_IRAM_SAFE
        bool "RMT ISR IRAM-Safe (Deprecated)" if !SPI_FLASH_AUTO_SUSPEND
        select RMT_TX_ISR_CACHE_SAFE
        select RMT_RX_ISR_CACHE_SAFE
        default n
        help
            Ensure the RMT interrupt is IRAM-Safe by allowing the interrupt handler to be
            executable when the cache is disabled (e.g. SPI Flash write).

endmenu # RMT Configurations
```

## components/esp_driver_sdio/test_apps/sdio/sdio_common_tests/host_sdmmc/main/Kconfig.projbuild
```kconfig
menu "SDIO Slave Test Host Configuration"
    choice TEST_SDIO_SLAVE_TARGET
        prompt "SDIO Slave Chip"
        default TEST_SDIO_SLAVE_TARGET_ESP32
        help
            default test board conditions targets: ESP32, ESP32C6, ESP32C61

        config TEST_SDIO_SLAVE_TARGET_ESP32
            bool "SDIO Slave ESP32"
        config TEST_SDIO_SLAVE_TARGET_ESP32C5
            bool "SDIO Slave ESP32C5"
    endchoice
endmenu
```

## components/esp_driver_sdio/test_apps/sdio/sdio_common_tests/sdio/main/Kconfig.projbuild
```kconfig
menu "SDIO Slave Test Slave Configuration"
    choice TEST_SDIO_HOST_TARGET
        prompt "SDIO Host Chip"
        default TEST_SDIO_HOST_TARGET_ESP32
        help
            SDIO Host chip target

        config TEST_SDIO_HOST_TARGET_ESP32
            bool "SDIO Host ESP32"
        config TEST_SDIO_HOST_TARGET_ESP32P4
            bool "SDIO Host ESP32P4"
    endchoice
endmenu
```

## components/esp_driver_sdm/Kconfig
```kconfig
menu "ESP-Driver:Sigma Delta Modulator Configurations"
    depends on SOC_SDM_SUPPORTED

    config SDM_CTRL_FUNC_IN_IRAM
        bool "Place SDM control functions into IRAM"
        default n
        select SDM_OBJ_CACHE_SAFE
        help
            Place SDM control functions (like set_pulse_density) into IRAM,
            so that these functions can be IRAM-safe and able to be called in the other IRAM interrupt context.
            Enabling this option can improve driver performance as well.

    config SDM_OBJ_CACHE_SAFE
        bool
        default n
        help
            This will ensure the SDM object will not be allocated from a memory region
            where its cache can be disabled.

    config SDM_ENABLE_DEBUG_LOG
        bool "Force enable debug log"
        default n
        help
            If enabled, SDM driver will:
            1. ignore the global logging settings
            2. compile all log messages into the binary
            3. set the runtime log level to VERBOSE
            Please enable this option by caution, as it will increase the binary size.

endmenu # Sigma Delta Modulator Configurations
```
