## components/esp_hw_support/Kconfig.spiram.common
```kconfig
# Common (non-chip-specific) SPIRAM options
#
# sourced into the "SPIRAM config" submenu for a specific chip.

config SPIRAM_BOOT_INIT
    bool "Initialize SPI RAM during startup"
    default "y"
    help
        If this is enabled, the SPI RAM will be enabled during initial boot. Unless you
        have specific requirements, you'll want to leave this enabled so memory allocated
        during boot-up can also be placed in SPI RAM.

config SPIRAM_IGNORE_NOTFOUND
    bool "Ignore PSRAM when not found"
    default "n"
    depends on SPIRAM_BOOT_INIT && !SPIRAM_ALLOW_BSS_SEG_EXTERNAL_MEMORY
    help
        Normally, if psram initialization is enabled during compile time but not found at runtime, it
        is seen as an error making the CPU panic. If this is enabled, booting will complete
        but no PSRAM will be available.

choice SPIRAM_USE
    prompt "SPI RAM access method"
    default SPIRAM_USE_MALLOC
    help
        The SPI RAM can be accessed in multiple methods: by just having it available as an unmanaged
        memory region in the CPU's memory map, by integrating it in the heap as 'special' memory
        needing heap_caps_malloc to allocate, or by fully integrating it making malloc() also able to
        return SPI RAM pointers.

    config SPIRAM_USE_MEMMAP
        bool "Integrate RAM into memory map"
    config SPIRAM_USE_CAPS_ALLOC
        bool "Make RAM allocatable using heap_caps_malloc(..., MALLOC_CAP_SPIRAM)"
    config SPIRAM_USE_MALLOC
        bool "Make RAM allocatable using malloc() as well"
        select FREERTOS_SUPPORT_STATIC_ALLOCATION
endchoice

config SPIRAM_MEMTEST
    bool "Run memory test on SPI RAM initialization"
    default "y"
    depends on SPIRAM_BOOT_INIT
    help
        Runs a rudimentary memory test on initialization. Aborts when memory test fails. Disable this for
        slightly faster startup.

config SPIRAM_MALLOC_ALWAYSINTERNAL
    int "Maximum malloc() size, in bytes, to always put in internal memory"
    depends on SPIRAM_USE_MALLOC
    default 16384
    range 0 131072
    help
        If malloc() is capable of also allocating SPI-connected ram, its allocation strategy will prefer to
        allocate chunks less than this size in internal memory, while allocations larger than this will be
        done from external RAM. If allocation from the preferred region fails, an attempt is made to allocate
        from the non-preferred region instead, so malloc() will not suddenly fail when either internal or
        external memory is full.

config SPIRAM_TRY_ALLOCATE_WIFI_LWIP
    bool "Try to allocate memories of WiFi and LWIP in SPIRAM firstly. If failed, allocate internal memory"
    depends on SPIRAM_USE_CAPS_ALLOC || SPIRAM_USE_MALLOC
    default "n"
    help
        Try to allocate memories of WiFi and LWIP in SPIRAM firstly. If failed, try to allocate internal
        memory then.

config SPIRAM_MALLOC_RESERVE_INTERNAL
    int "Reserve this amount of bytes for data that specifically needs to be in DMA or internal memory"
    depends on SPIRAM_USE_MALLOC
    default 32768
    range 0 262144
    help
        Because the external/internal RAM allocation strategy is not always perfect, it sometimes may happen
        that the internal memory is entirely filled up. This causes allocations that are specifically done in
        internal memory, for example the stack for new tasks or memory to service DMA or have memory that's
        also available when SPI cache is down, to fail. This option reserves a pool specifically for requests
        like that; the memory in this pool is not given out when a normal malloc() is called.

        Set this to 0 to disable this feature.

        Note that because FreeRTOS stacks are forced to internal memory, they will also use this memory pool;
        be sure to keep this in mind when adjusting this value.

        Note also that the DMA reserved pool may not be one single contiguous memory region, depending on the
        configured size and the static memory usage of the app.

config SPIRAM_ALLOW_BSS_SEG_EXTERNAL_MEMORY
    bool "Allow .bss segment placed in external memory"
    default n
    depends on SPIRAM
    select ESP_ALLOW_BSS_SEG_EXTERNAL_MEMORY
    help
        If enabled, variables with EXT_RAM_BSS_ATTR attribute will be placed in SPIRAM instead of internal DRAM.
        BSS section of `lwip`, `net80211`, `pp`, `bt` libraries will be automatically placed
        in SPIRAM. BSS sections from other object files and libraries can also be placed in SPIRAM through
        linker fragment scheme `extram_bss`.

        Note that the variables placed in SPIRAM using EXT_RAM_BSS_ATTR will be zero initialized.

config SPIRAM_ALLOW_NOINIT_SEG_EXTERNAL_MEMORY
    bool "Allow .noinit segment placed in external memory"
    default n
    depends on SPIRAM && IDF_TARGET_ESP32
    help
        If enabled, noinit variables can be placed in PSRAM using EXT_RAM_NOINIT_ATTR.

        Note the values placed into this section will not be initialized at startup and should keep its value
        after software restart.

config SPIRAM_ECC_ENABLE
    bool "Enable SPI RAM ECC"
    default n
    depends on SPIRAM_MODE_OCT && IDF_TARGET_ESP32S3
    help
        Enable MSPI Error-Correcting Code function when accessing SPIRAM.

        If enabled, 1/16 of the SPI RAM total size will be reserved for error-correcting code.
```

## components/esp_hw_support/dma/Kconfig.dma
```kconfig
menu "GDMA Configurations"
    depends on SOC_GDMA_SUPPORTED
    config GDMA_CTRL_FUNC_IN_IRAM
        bool "Place GDMA control functions in IRAM"
        default n
        help
            Place GDMA control functions (like start/stop/append/reset) into IRAM,
            so that these functions can be IRAM-safe and able to be called in the other IRAM interrupt context.

    config GDMA_ISR_IRAM_SAFE
        bool "GDMA ISR IRAM-Safe"
        default n
        help
            This will ensure the GDMA interrupt handler is IRAM-Safe, allow to avoid flash
            cache misses, and also be able to run whilst the cache is disabled.
            (e.g. SPI Flash write).

    config GDMA_ENABLE_DEBUG_LOG
        bool "Enable debug log"
        default n
        help
            Whether to enable the debug log message for GDMA driver.
            Note that, this option only controls the GDMA driver log, won't affect other drivers.
endmenu # GDMA Configurations

menu "DW_GDMA Configurations"
    depends on SOC_DW_GDMA_SUPPORTED

    config DW_GDMA_CTRL_FUNC_IN_IRAM
        bool
        default n
        help
            Place DW_GDMA control functions (e.g. dw_gdma_channel_continue) into IRAM,
            so that these functions can be IRAM-safe and able to be called in the other IRAM interrupt context.

    config DW_GDMA_SETTER_FUNC_IN_IRAM
        bool
        default n
        help
            Place DW_GDMA setter functions (e.g. dw_gdma_channel_set_block_markers) into IRAM,
            so that these functions can be IRAM-safe and able to be called in the other IRAM interrupt context.

    config DW_GDMA_GETTER_FUNC_IN_IRAM
        bool
        default n
        help
            Place DW_GDMA getter functions (e.g. dw_gdma_link_list_get_item) into IRAM,
            so that these functions can be IRAM-safe and able to be called in the other IRAM interrupt context.

    config DW_GDMA_ISR_IRAM_SAFE
        bool
        default n
        help
            This will ensure the DW_GDMA interrupt handler is IRAM-Safe, allow to avoid flash
            cache misses, and also be able to run whilst the cache is disabled.
            (e.g. SPI Flash write).

    config DW_GDMA_ENABLE_DEBUG_LOG
        bool "Enable debug log"
        default n
        help
            Whether to enable the debug log message for DW_GDMA driver.
            Note that, this option only controls the DW_GDMA driver log, won't affect other drivers.
endmenu # DW_GDMA Configurations

menu "2D-DMA Configurations"
    depends on SOC_DMA2D_SUPPORTED

    config DMA2D_OPERATION_FUNC_IN_IRAM
        bool "Place 2D-DMA operation functions into IRAM"
        default n
        help
            Place 2D-DMA all operation functions, including control functions (e.g. start/stop/append/reset) and setter
            functions (e.g. connect/strategy/callback registration) into IRAM, so that these functions can be IRAM-safe
            and able to be called in the other IRAM interrupt context. It also helps optimizing the performance.

    config DMA2D_ISR_IRAM_SAFE
        bool "2D-DMA ISR IRAM-Safe"
        default n
        help
            This will ensure the 2D-DMA interrupt handler is IRAM-Safe, allow to avoid flash
            cache misses, and also be able to run whilst the cache is disabled.
            (e.g. SPI Flash write).
endmenu # 2D-DMA Configurations
```

## components/esp_hw_support/etm/Kconfig.etm
```kconfig
menu "Event Task Matrix (ETM) Configurations"
    depends on SOC_ETM_SUPPORTED
    config ETM_ENABLE_DEBUG_LOG
        bool "Force enable debug log"
        default n
        help
            If enabled, ETM driver will:
            1. ignore the global logging settings
            2. compile all log messages into the binary
            3. set the runtime log level to VERBOSE
            Please enable this option by caution, as it will increase the binary size.
endmenu # ETM Configuration
```

## components/esp_hw_support/lowpower/port/esp32p4/Kconfig.p4_rev3_mspi_workaround
```kconfig
config P4_REV3_MSPI_CRASH_AFTER_POWER_UP_WORKAROUND
    bool
    depends on IDF_TARGET_ESP32P4
    default y if ESP32P4_REV_MIN_300  # Fixed since REV3.1

config P4_REV3_MSPI_WORKAROUND_SIZE
    hex
    depends on IDF_TARGET_ESP32P4
    default 0x100 if ESP32P4_REV_MIN_300
    default 0
```

## components/esp_hw_support/port/esp32/Kconfig.hw_support
```kconfig
choice ESP32_REV_MIN
    prompt "Minimum Supported ESP32 Revision"
    default ESP32_REV_MIN_0
    help
        Required minimum chip revision. ESP-IDF will check for it and
        reject to boot if the chip revision fails the check.
        This ensures the chip used will have some modifications (features, or bugfixes).

        The complied binary will only support chips above this revision,
        this will also help to reduce binary size.

    config ESP32_REV_MIN_0
        bool "Rev v0.0 (ECO0)"
        # Brownout on Rev 0 is bugged, must use interrupt
        select ESP_SYSTEM_BROWNOUT_INTR
    config ESP32_REV_MIN_1
        bool "Rev v1.0 (ECO1)"
    config ESP32_REV_MIN_1_1
        bool "Rev v1.1 (ECO1.1)"
    config ESP32_REV_MIN_2
        bool "Rev v2.0 (ECO2)"
    config ESP32_REV_MIN_3
        bool "Rev v3.0 (ECO3)"
        select ESP_INT_WDT if ESP32_ECO3_CACHE_LOCK_FIX
    config ESP32_REV_MIN_3_1
        bool "Rev v3.1 (ECO4)"
        select ESP_INT_WDT if ESP32_ECO3_CACHE_LOCK_FIX
endchoice

config ESP32_REV_MIN
    # we keep it for compatibility. Use ESP32_REV_MIN_FULL instead.
    int
    default 0 if ESP32_REV_MIN_0
    default 1 if ESP32_REV_MIN_1 || ESP32_REV_MIN_1_1
    default 2 if ESP32_REV_MIN_2
    default 3 if ESP32_REV_MIN_3 || ESP32_REV_MIN_3_1

config ESP32_REV_MIN_FULL
    int
    default 0 if ESP32_REV_MIN_0
    default 100 if ESP32_REV_MIN_1
    default 101 if ESP32_REV_MIN_1_1
    default 200 if ESP32_REV_MIN_2
    default 300 if ESP32_REV_MIN_3
    default 301 if ESP32_REV_MIN_3_1

config ESP_REV_MIN_FULL
    int
    default ESP32_REV_MIN_FULL

    #
    # MAX Revision
    #

    comment "Maximum Supported ESP32 Revision (Rev v3.99)"
    # Maximum revision that IDF supports.
    # It can not be changed by user.
    # Only Espressif can change it when a new version will be supported in IDF.
    # Supports all chips starting from ESP32_REV_MIN_FULL to ESP32_REV_MAX_FULL

config ESP32_REV_MAX_FULL
    int
    default 399
    # keep in sync the "Maximum Supported Revision" description with this value

config ESP_REV_MAX_FULL
    int
    default ESP32_REV_MAX_FULL
```
