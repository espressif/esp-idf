## components/esp_hal_i2c/test_apps/hal_i2c/main/Kconfig.projbuild
```kconfig
menu "Example Configuration"

    menu "I2C Master"
        config I2C_MASTER_SCL
            int "SCL GPIO Num"
            default 4
            help
                GPIO number for I2C Master clock line.

        config I2C_MASTER_SDA
            int "SDA GPIO Num"
            default 5
            help
                GPIO number for I2C Master data line.

        config I2C_MASTER_FREQUENCY
            int "Master Frequency"
            default 400000
            help
                I2C Speed of Master device.
    endmenu

endmenu
```

## components/esp_hal_security/test_apps/crypto/main/Kconfig.projbuild
```kconfig
menu "Test App Configuration"

    config CRYPTO_TEST_APP_ENABLE_FPGA_TESTS
        bool "Allow enabling the crypto tests that require burning efuses"
        default y if IDF_ENV_FPGA
        default n
        help
            This includes the crypto tests that actually require burning some efuses.
            It is better to run these tests on an FPGA to avoid mistakenly burning eFuses.

    config CRYPTO_TEST_APP_ENABLE_DS_TESTS
        bool "Enable DS Peripheral test cases"
        default y
        help
            Enabling this option includes DS Peripheral related test cases in the build for supported targets.

    config CRYPTO_TEST_APP_ENABLE_HMAC_TESTS
        bool "Enable HMAC Peripheral test cases"
        default y
        help
            Enabling this option includes HMAC Peripheral related test cases in the build for supported targets.

    config CRYPTO_TEST_APP_ENABLE_ECDSA_TESTS
        depends on SOC_ECDSA_SUPPORTED && !CRYPTO_TEST_APP_ENABLE_HMAC_TESTS && !CRYPTO_TEST_APP_ENABLE_DS_TESTS
        bool "Enable ECDSA Peripheral test cases"
        default n
        help
            Enabling this option includes ECDSA Peripheral related test cases in the build for supported targets.

    config CRYPTO_TEST_APP_ENABLE_XTS_AES_TESTS
        depends on !CRYPTO_TEST_APP_ENABLE_DS_TESTS
        bool "Enable XTS-AES Peripheral test cases"
        default n
        help
            Enabling this option includes XTS-AES Peripheral related test cases in the build for supported targets.

    config CRYPTO_TESTAPP_USE_AES_INTERRUPT
        bool "Use interrupt for long AES operations"
        depends on SOC_AES_SUPPORTED
        default n
        help
            Use an interrupt to coordinate long AES operations.

    config CRYPTO_IS_KEY_MANAGER_SUPPORTED
        bool
        default n if IDF_TARGET_ESP32P4 && ESP32P4_SELECTS_REV_LESS_V3
        default y
        depends on SOC_KEY_MANAGER_SUPPORTED
        help
            A hidden config to determine if the Key Manager tests should be included.

endmenu
```

## components/esp_hal_security/test_apps/crypto/sdkconfig.defaults
```kconfig
CONFIG_COMPILER_STACK_CHECK=y
CONFIG_COMPILER_STACK_CHECK_MODE_STRONG=y
CONFIG_FREERTOS_WATCHPOINT_END_OF_STACK=y

CONFIG_ESP_TASK_WDT_EN=y
CONFIG_ESP_TASK_WDT_INIT=n
CONFIG_UNITY_ENABLE_FIXTURE=y

CONFIG_PARTITION_TABLE_CUSTOM=y
CONFIG_PARTITION_TABLE_CUSTOM_FILENAME="partitions.csv"
CONFIG_PARTITION_TABLE_FILENAME="partitions.csv"
CONFIG_PARTITION_TABLE_OFFSET=0x8000

# Enable block and DMA modes for AES
CONFIG_MBEDTLS_AES_HW_SMALL_DATA_LEN_OPTIM=y
```

## components/esp_hal_security/test_apps/tee/components/pms_and_cpu_intr/Kconfig
```kconfig
menu "Test-app related"

    config SOC_SUPPORT_TEE_SYS_APM_TEST
        bool
        depends on SOC_APM_SUPPORTED
        default y

    config SOC_SUPPORT_TEE_PERI_APM_TEST
        bool
        depends on SOC_APM_SUPPORTED && SOC_APM_SUPPORT_TEE_PERI_ACCESS_CTRL
        default y

    config SOC_SUPPORT_TEE_INTR_TEST
        bool
        depends on IDF_TARGET_ESP32C5 || IDF_TARGET_ESP32C61 || (IDF_TARGET_ESP32P4 && !ESP32P4_SELECTS_REV_LESS_V3)
        default y

endmenu
```

## components/esp_hal_security/test_apps/tee/sdkconfig.defaults
```kconfig
# Test-app related
CONFIG_FREERTOS_HZ=1000
CONFIG_ESP_INT_WDT=n
CONFIG_ESP_TASK_WDT_INIT=n
CONFIG_BOOTLOADER_LOG_LEVEL_WARN=y
CONFIG_ESP_SYSTEM_MEMPROT=n
```

## components/esp_hal_security/test_apps/tee/sdkconfig.defaults.esp32c6
```kconfig
# Enable LP core
CONFIG_ULP_COPROC_ENABLED=y
CONFIG_ULP_COPROC_RESERVE_MEM=8192
CONFIG_ESP_SYSTEM_ALLOW_RTC_FAST_MEM_AS_HEAP=n
```

## components/esp_hal_security/test_apps/tee/sdkconfig.defaults.esp32p4
```kconfig
# TODO: Need to find a way to query the current core ID in
# U-mode for multicore SoCs. Thus, TEE interrupt tests will
# run only in unicore mode till then.
CONFIG_FREERTOS_UNICORE=y

# Enable LP core
CONFIG_ULP_COPROC_ENABLED=y
CONFIG_ULP_COPROC_RESERVE_MEM=8192
CONFIG_ESP_SYSTEM_ALLOW_RTC_FAST_MEM_AS_HEAP=n

# Enable SPIRAM
CONFIG_SPIRAM=y

# Custom partition table
CONFIG_ESPTOOLPY_FLASHSIZE_4MB=y
CONFIG_PARTITION_TABLE_CUSTOM=y
CONFIG_PARTITION_TABLE_CUSTOM_FILENAME="partitions.csv"
CONFIG_PARTITION_TABLE_FILENAME="partitions.csv"
```

## components/esp_hal_systimer/Kconfig.hal_systimer
```kconfig
config HAL_SYSTIMER_USE_ROM_IMPL
    bool "Use ROM implementation of SysTimer HAL driver"
    depends on ESP_ROM_HAS_HAL_SYSTIMER
    default y
    help
        Enable this flag to use HAL functions from ROM instead of ESP-IDF.

        If keeping this as "n" in your project, you will have less free IRAM.
        If making this as "y" in your project, you will increase free IRAM,
        but you will lose the possibility to debug this module, and some new
        features will be added and bugs will be fixed in the IDF source
        but cannot be synced to ROM.
```

## components/esp_hid/Kconfig
```kconfig
menu "ESP HID"
    config ESPHID_TASK_SIZE_BT
        int "Task stack size for ESP HID BR/EDR"
        range 2048 10240
        default 2048
        help
            This is the stack size for the BT HID task.
            Default is 2048 bytes.

    config ESPHID_TASK_SIZE_BLE
        int "Task stack size for ESP HID BLE"
        range 2048 10240
        default 4096
        help
            This is the stack size for the BLE HID task.
            Default is 4096 bytes.
endmenu
```

## components/esp_http_client/Kconfig
```kconfig
menu "ESP HTTP client"


    config ESP_HTTP_CLIENT_ENABLE_HTTPS
        bool "Enable https"
        default y
        help
            This option will enable https protocol by linking esp-tls library and initializing SSL transport

    config ESP_HTTP_CLIENT_ENABLE_BASIC_AUTH
        bool "Enable HTTP Basic Authentication"
        default n
        help
            This option will enable HTTP Basic Authentication. It is disabled by default as Basic
            auth uses unencrypted encoding, so it introduces a vulnerability when not using TLS

    config ESP_HTTP_CLIENT_ENABLE_DIGEST_AUTH
        bool "Enable HTTP Digest Authentication"
        default n
        help
            This option will enable HTTP Digest Authentication. It is enabled by default, but use of this
            configuration is not recommended as the password can be derived from the exchange, so it introduces
            a vulnerability when not using TLS

    config ESP_HTTP_CLIENT_ENABLE_CUSTOM_TRANSPORT
        bool "Enable custom transport"
        default n
        help
            This option will enable injection of a custom tcp_transport handle, so the http operation
            will be performed on top of the user defined transport abstraction (if configured)

    config ESP_HTTP_CLIENT_ENABLE_GET_CONTENT_RANGE
        bool "Enable content range functionality"
        default n
        help
            This enables use of content range header in esp_http_client component.

    config ESP_HTTP_CLIENT_EVENT_POST_TIMEOUT
        int "Time in millisecond to wait for posting event"
        default 2000
        help
            This config option helps in setting the time in millisecond to wait for event to be posted to the
            system default event loop. Set it to -1 if you need to set timeout to portMAX_DELAY.

    config ESP_HTTP_CLIENT_PSA_CRYPTO_MIGRATE
        depends on MBEDTLS_VER_4_X_SUPPORT
        bool "Migrate ESP HTTP Client to use PSA Crypto"
        default y
        help
            Migrate ESP HTTP Client to use PSA Crypto.

    config ESP_HTTP_CLIENT_SAVE_RESPONSE_HEADERS
        bool "Save response headers"
        default n
        help
            This option will enable saving of response headers in esp_http_client component.
            When enabled, upto ESP_HTTP_CLIENT_MAX_SAVED_RESPONSE_HEADERS headers are saved.
            Enabling this option will increase the memory footprint of the component.

    config ESP_HTTP_CLIENT_MAX_SAVED_RESPONSE_HEADERS
        depends on ESP_HTTP_CLIENT_SAVE_RESPONSE_HEADERS
        int "Maximum number of response headers"
        default 10
        help
            This config option helps in setting the maximum number of response headers that
            can be saved in esp_http_client component.

    config ESP_HTTP_CLIENT_MAX_RESPONSE_HEADER_SIZE
        depends on ESP_HTTP_CLIENT_SAVE_RESPONSE_HEADERS
        int "Maximum size of response header"
        default 128
        help
            This config option helps in setting the maximum size of response header that
            can be saved in esp_http_client component.
            Note that the same size is used for key and value in the response headers.
endmenu
```

## components/esp_http_server/Kconfig
```kconfig
menu "HTTP Server"

    config HTTPD_MAX_REQ_HDR_LEN
        int "Max HTTP Request Header Length"
        default 512
        help
            This sets the maximum supported size of headers section in HTTP request packet to be processed by the
            server

    config HTTPD_MAX_URI_LEN
        int "Max HTTP URI Length"
        default 512
        help
            This sets the maximum supported size of HTTP request URI to be processed by the server

    config HTTPD_ERR_RESP_NO_DELAY
        bool "Use TCP_NODELAY socket option when sending HTTP error responses"
        default y
        help
            Using TCP_NODEALY socket option ensures that HTTP error response reaches the client before the
            underlying socket is closed. Please note that turning this off may cause multiple test failures

    config HTTPD_PURGE_BUF_LEN
        int "Length of temporary buffer for purging data"
        default 32
        help
            This sets the size of the temporary buffer used to receive and discard any remaining data that is
            received from the HTTP client in the request, but not processed as part of the server HTTP request
            handler.

            If the remaining data is larger than the available buffer size, the buffer will be filled in multiple
            iterations. The buffer should be small enough to fit on the stack, but large enough to avoid excessive
            iterations.

    config HTTPD_LOG_PURGE_DATA
        bool "Log purged content data at Debug level"
        default n
        help
            Enabling this will log discarded binary HTTP request data at Debug level.
            For large content data this may not be desirable as it will clutter the log.

    config HTTPD_WS_SUPPORT
        bool "WebSocket server support"
        default n
        help
            This sets the WebSocket server support.

    config HTTPD_QUEUE_WORK_BLOCKING
        bool "httpd_queue_work as blocking API"
        help
            This makes httpd_queue_work() API to wait until a message space is available on UDP control socket.
            It internally uses a counting semaphore with count set to `LWIP_UDP_RECVMBOX_SIZE` to achieve this.
            This config will slightly change API behavior to block until message gets delivered on control socket.

    config HTTPD_SERVER_EVENT_POST_TIMEOUT
        int "Time in millisecond to wait for posting event"
        default 2000
        help
            This config option helps in setting the time in millisecond to wait for event to be posted to the
            system default event loop. Set it to -1 if you need to set timeout to portMAX_DELAY.
endmenu
```

## components/esp_https_ota/Kconfig
```kconfig
menu "ESP HTTPS OTA"

    config ESP_HTTPS_OTA_DECRYPT_CB
        bool "Provide decryption callback"
        default n
        help
            Exposes an additional callback whereby firmware data could be decrypted
            before being processed by OTA update component. This can help to integrate
            external encryption related format and removal of such encapsulation layer
            from firmware image.

    config ESP_HTTPS_OTA_ALLOW_HTTP
        bool "Allow HTTP for OTA (WARNING: ONLY FOR TESTING PURPOSE, READ HELP)"
        default n
        help
            It is highly recommended to keep HTTPS (along with server certificate validation) enabled.
            Enabling this option comes with potential risk of:
            - Non-encrypted communication channel with server
            - Accepting firmware upgrade image from server with fake identity

    config ESP_HTTPS_OTA_EVENT_POST_TIMEOUT
        int "Time in millisecond to wait for posting event"
        default 2000
        help
            This config option helps in setting the time in millisecond to wait for event to be posted to the
            system default event loop. Set it to -1 if you need to set timeout to portMAX_DELAY.

    config ESP_HTTPS_OTA_ENABLE_PARTIAL_DOWNLOAD
        bool "Enable partial HTTP download for OTA"
        default n
        select ESP_HTTP_CLIENT_ENABLE_GET_CONTENT_RANGE
        help
            This enables use of range header in esp_https_ota component.
            The firmware image will be downloaded over multiple HTTP requests.

    config ESP_HTTPS_OTA_VERIFY_SPI_MODE
        bool "Verify SPI flash mode compatibility for application during OTA"
        default y
        help
            When enabled, the OTA process will verify that the SPI flash mode of the new
            application image is compatible with the currently running firmware. This helps
            prevent flashing firmware with incompatible SPI mode settings which could
            cause flash write failures.

endmenu
```

## components/esp_https_server/Kconfig
```kconfig
menu "ESP HTTPS server"

    config ESP_HTTPS_SERVER_ENABLE
        bool "Enable ESP_HTTPS_SERVER component"
        depends on (ESP_TLS_USING_MBEDTLS && MBEDTLS_TLS_SERVER)
        help
            Enable ESP HTTPS server component

    config ESP_HTTPS_SERVER_EVENT_POST_TIMEOUT
        int "Time in millisecond to wait for posting event"
        default 2000
        help
            This config option helps in setting the time in millisecond to wait for event to be posted to the
            system default event loop. Set it to -1 if you need to set timeout to portMAX_DELAY.

    config ESP_HTTPS_SERVER_CERT_SELECT_HOOK
        select ESP_TLS_SERVER_CERT_SELECT_HOOK
        bool "Enable certificate selection hook"
        default n
        help
            Enable certificate selection hook for ESP HTTPS Server. When enabled, this allows the server to
            dynamically select the appropriate certificate based on the client's Server Name Indication (SNI).
            This is useful for hosting multiple domains on a single server with different SSL certificates.

endmenu
```
