## components/esp_hw_support/port/esp32/Kconfig.rtc
```kconfig
choice RTC_CLK_SRC
    prompt "RTC clock source"
    default RTC_CLK_SRC_INT_RC
    help
        Choose which clock is used as RTC clock source.

        - "Internal 150kHz oscillator" option provides lowest deep sleep current
            consumption, and does not require extra external components. However
            frequency stability with respect to temperature is poor, so time may
            drift in deep/light sleep modes.
        - "External 32kHz crystal" provides better frequency stability, at the
            expense of slightly higher (1uA) deep sleep current consumption.
        - "External 32kHz oscillator" allows using 32kHz clock generated by an
            external circuit. In this case, external clock signal must be connected
            to 32K_XN pin. Amplitude should be <1.2V in case of sine wave signal,
            and <1V in case of square wave signal. Common mode voltage should be
            0.1 < Vcm < 0.5Vamp, where Vamp is the signal amplitude.
            Additionally, 1nF capacitor must be connected between 32K_XP pin and
            ground. 32K_XP pin can not be used as a GPIO in this case.
        - "Internal 8.5MHz oscillator divided by 256" option results in higher
            deep sleep current (by 5uA) but has better frequency stability than
            the internal 150kHz oscillator. It does not require external components.

    config RTC_CLK_SRC_INT_RC
        bool "Internal 150 kHz RC oscillator"
    config RTC_CLK_SRC_EXT_CRYS
        bool "External 32kHz crystal"
        select ESP_SYSTEM_RTC_EXT_XTAL
    config RTC_CLK_SRC_EXT_OSC
        bool "External 32kHz oscillator at 32K_XN pin"
        select ESP_SYSTEM_RTC_EXT_OSC
    config RTC_CLK_SRC_INT_8MD256
        bool "Internal 8.5MHz oscillator, divided by 256 (~33kHz)"
endchoice

choice RTC_EXT_CRYST_ADDIT_CURRENT_METHOD
    prompt "Additional current for external 32kHz crystal"
    depends on RTC_CLK_SRC_EXT_CRYS
    depends on ESP32_REV_MIN_FULL < 200
    default RTC_EXT_CRYST_ADDIT_CURRENT_NONE
    help
        With some 32kHz crystal configurations, the X32N and X32P pins may not have enough
        drive strength to keep the crystal oscillating. Choose the method to provide
        additional current from touchpad 9 to the external 32kHz crystal. Note that
        the deep sleep current is slightly high (4-5uA) and the touchpad and the
        wakeup sources of both touchpad and ULP are not available in method 1 and method 2.

        This problem is fixed in ESP32 ECO 3, so this workaround is not needed. Setting the
        project configuration to minimum revision ECO3 will disable this option, , allow
        all wakeup sources, and save some code size.

        - "None" option will not provide additional current to external crystal
        - "Method 1" option can't ensure 100% to solve the external 32k crystal start failed
            issue, but the touchpad can work in this method.
        - "Method 2" option can solve the external 32k issue, but the touchpad can't work
            in this method.

    config RTC_EXT_CRYST_ADDIT_CURRENT_NONE
        bool "None"
    config RTC_EXT_CRYST_ADDIT_CURRENT
        bool "Method 1"
    config RTC_EXT_CRYST_ADDIT_CURRENT_V2
        bool "Method 2"
endchoice

config RTC_CLK_CAL_CYCLES
    int "Number of cycles for RTC_SLOW_CLK calibration"
    default 3000 if RTC_CLK_SRC_EXT_CRYS || RTC_CLK_SRC_EXT_OSC || RTC_CLK_SRC_INT_8MD256
    default 1024 if RTC_CLK_SRC_INT_RC
    range 0 27000 if RTC_CLK_SRC_EXT_CRYS || RTC_CLK_SRC_EXT_OSC || RTC_CLK_SRC_INT_8MD256
    range 0 32766 if RTC_CLK_SRC_INT_RC
    help
        When the startup code initializes RTC_SLOW_CLK, it can perform
        calibration by comparing the RTC_SLOW_CLK frequency with main XTAL
        frequency. This option sets the number of RTC_SLOW_CLK cycles measured
        by the calibration routine. Higher numbers increase calibration
        precision, which may be important for applications which spend a lot of
        time in deep sleep. Lower numbers reduce startup time.

        When this option is set to 0, clock calibration will not be performed at
        startup, and approximate clock frequencies will be assumed:

        - 150000 Hz if internal RC oscillator is used as clock source. For this use value 1024.
        - 32768 Hz if the 32k crystal oscillator is used. For this use value 3000 or more.
            In case more value will help improve the definition of the launch of the crystal.
            If the crystal could not start, it will be switched to internal RC.

config RTC_XTAL_CAL_RETRY
    int "Number of attempts to repeat 32k XTAL calibration"
    default 1
    depends on RTC_CLK_SRC_EXT_CRYS
    help
        Number of attempts to repeat 32k XTAL calibration
        before giving up and switching to the internal RC.
        Increase this option if the 32k crystal oscillator
        does not start and switches to internal RC.
```

## components/esp_hw_support/port/esp32/Kconfig.xtal
```kconfig
choice XTAL_FREQ
    prompt "Main XTAL frequency"
    default XTAL_FREQ_40
    help
        This option selects the operating frequency of the XTAL (crystal) clock used to drive the ESP target.
        The selected value MUST reflect the frequency of the given hardware.

        Note: On ESP32, the XTAL_FREQ_AUTO option allows the ESP target to automatically estimating XTAL clock's
        operating frequency. The ESP32 uses the internal 8MHZ as a reference when estimating. Due to the internal
        oscillator's frequency being temperature dependent, usage of the XTAL_FREQ_AUTO is not recommended in
        applications that operate in high ambient temperatures or use high-temperature qualified chips and modules.

    config XTAL_FREQ_26
        bool "26 MHz"
    config XTAL_FREQ_32
        bool "32 MHz"
    config XTAL_FREQ_40
        bool "40 MHz"
    config XTAL_FREQ_AUTO
        bool "Autodetect"
endchoice

# soc_xtal_freq_t enum in soc/clk_tree_defs.h lists the XTAL frequencies can be supported
# SOC_XTAL_SUPPORT_XXX in soc_caps.h lists the XTAL frequencies already supported
config XTAL_FREQ
    int
    default 26 if XTAL_FREQ_26
    default 32 if XTAL_FREQ_32
    default 40 if XTAL_FREQ_40
    default 0  if XTAL_FREQ_AUTO
```

## components/esp_hw_support/port/esp32c2/Kconfig.hw_support
```kconfig
choice ESP32C2_REV_MIN
    prompt "Minimum Supported ESP32-C2 Revision"
    default ESP32C2_REV_MIN_1
    help
        Required minimum chip revision. ESP-IDF will check for it and
        reject to boot if the chip revision fails the check.
        This ensures the chip used will have some modifications (features, or bugfixes).

        The complied binary will only support chips above this revision,
        this will also help to reduce binary size.

    config ESP32C2_REV_MIN_1
        bool "Rev v1.0 (ECO1)"
    config ESP32C2_REV_MIN_1_1
        bool "Rev v1.1 (ECO2)"
endchoice

config ESP32C2_REV_MIN_FULL
    int
    default 100 if ESP32C2_REV_MIN_1
    default 101 if ESP32C2_REV_MIN_1_1

config ESP_REV_MIN_FULL
    int
    default ESP32C2_REV_MIN_FULL

    #
    # MAX Revision
    #

    comment "Maximum Supported ESP32-C2 Revision (Rev v1.99)"
    # Maximum revision that IDF supports.
    # It can not be changed by user.
    # Only Espressif can change it when a new version will be supported in IDF.
    # Supports all chips starting from ESP32C2_REV_MIN_FULL to ESP32C2_REV_MAX_FULL

config ESP32C2_REV_MAX_FULL
    int
    default 299 if ESP32C2_REV2_DEVELOPMENT
    default 199 if !ESP32C2_REV2_DEVELOPMENT
    # keep in sync the "Maximum Supported Revision" description with this value

config ESP_REV_MAX_FULL
    int
    default ESP32C2_REV_MAX_FULL

config ESP32C2_REV2_DEVELOPMENT
    bool "Develop on ESP32-C2 v2.0 (Preview)"
    default y if IDF_CI_BUILD

config ESP_EFUSE_BLOCK_REV_MIN_FULL
    int "Minimum Supported ESP32-C2 eFuse Block Revision"
    default 0
    help
        Required minimum eFuse Block revision. ESP-IDF will check it at the 2nd bootloader stage
        whether the current image can work correctly for this eFuse Block revision.
        So that to avoid running an incompatible image on a SoC that contains breaking change in the eFuse Block.
        If you want to update this value to run the image that not compatible with the current eFuse Block revision,
        please contact to Espressif's business team for details:
        https://www.espressif.com.cn/en/contact-us/sales-questions


config ESP_EFUSE_BLOCK_REV_MAX_FULL
    int
    default 99
    comment "Maximum Supported ESP32-C2 eFuse Block Revision (eFuse Block Rev v0.99)"
    # The revision in the comment must correspond to the default value of ESP_EFUSE_BLOCK_REV_MAX_FULL
```

## components/esp_hw_support/port/esp32c2/Kconfig.mac
```kconfig
choice ESP32C2_UNIVERSAL_MAC_ADDRESSES
    bool "Number of universally administered (by IEEE) MAC address"
    default ESP32C2_UNIVERSAL_MAC_ADDRESSES_FOUR
    help
        Configure the number of universally administered (by IEEE) MAC addresses.

        During initialization, MAC addresses for each network interface are generated or derived from a
        single base MAC address.

        If the number of universal MAC addresses is four, all four interfaces (WiFi station, WiFi softap,
        Bluetooth and Ethernet) receive a universally administered MAC address. These are generated
        sequentially by adding 0, 1, 2 and 3 (respectively) to the final octet of the base MAC address.

        If the number of universal MAC addresses is two, only two interfaces (WiFi station and Bluetooth)
        receive a universally administered MAC address. These are generated sequentially by adding 0
        and 1 (respectively) to the base MAC address. The remaining two interfaces (WiFi softap and Ethernet)
        receive local MAC addresses. These are derived from the universal WiFi station and Bluetooth MAC
        addresses, respectively.

        When using the default (Espressif-assigned) base MAC address, either setting can be used. When using
        a custom universal MAC address range, the correct setting will depend on the allocation of MAC
        addresses in this range (either 2 or 4 per device.)

        Note that ESP32-C2 has no integrated Ethernet MAC. Although it's possible to use the esp_read_mac()
        API to return a MAC for Ethernet, this can only be used with an external MAC peripheral.

    config ESP32C2_UNIVERSAL_MAC_ADDRESSES_TWO
        bool "Two"
        select ESP_MAC_UNIVERSAL_MAC_ADDRESSES_TWO
        select ESP_MAC_ADDR_UNIVERSE_WIFI_STA
        select ESP_MAC_ADDR_UNIVERSE_BT

    config ESP32C2_UNIVERSAL_MAC_ADDRESSES_FOUR
        bool "Four"
        select ESP_MAC_UNIVERSAL_MAC_ADDRESSES_FOUR
        select ESP_MAC_ADDR_UNIVERSE_WIFI_STA
        select ESP_MAC_ADDR_UNIVERSE_WIFI_AP
        select ESP_MAC_ADDR_UNIVERSE_BT
        select ESP_MAC_ADDR_UNIVERSE_ETH
endchoice

config ESP32C2_UNIVERSAL_MAC_ADDRESSES
    # TODO: check ESP32-C2 mac address WIFI-4134
    int
    default 2 if ESP32C2_UNIVERSAL_MAC_ADDRESSES_TWO
    default 4 if ESP32C2_UNIVERSAL_MAC_ADDRESSES_FOUR
```

## components/esp_hw_support/port/esp32c2/Kconfig.rtc
```kconfig
choice RTC_CLK_SRC
    prompt "RTC clock source"
    default RTC_CLK_SRC_INT_RC
    help
        Choose which clock is used as RTC clock source.

    config RTC_CLK_SRC_INT_RC
        bool "Internal 136kHz RC oscillator"
    config RTC_CLK_SRC_EXT_OSC
        bool "External 32kHz oscillator at pin0"
    config RTC_CLK_SRC_INT_8MD256
        bool "Internal 17.5MHz oscillator, divided by 256"
endchoice

config RTC_CLK_CAL_CYCLES
    int "Number of cycles for RTC_SLOW_CLK calibration"
    default 3000 if RTC_CLK_SRC_EXT_OSC || RTC_CLK_SRC_INT_8MD256
    default 1024 if RTC_CLK_SRC_INT_RC
    range 0 27000 if RTC_CLK_SRC_EXT_OSC || RTC_CLK_SRC_INT_8MD256
    range 0 32766 if RTC_CLK_SRC_INT_RC
    help
        When the startup code initializes RTC_SLOW_CLK, it can perform
        calibration by comparing the RTC_SLOW_CLK frequency with main XTAL
        frequency. This option sets the number of RTC_SLOW_CLK cycles measured
        by the calibration routine. Higher numbers increase calibration
        precision, which may be important for applications which spend a lot of
        time in deep sleep. Lower numbers reduce startup time.

        When this option is set to 0, clock calibration will not be performed at
        startup, and approximate clock frequencies will be assumed:

        - 150000 Hz if internal RC oscillator is used as clock source. For this use value 1024.
        - 32768 Hz if the 32k crystal oscillator is used. For this use value 3000 or more.
            In case more value will help improve the definition of the launch of the crystal.
            If the crystal could not start, it will be switched to internal RC.
```

## components/esp_hw_support/port/esp32c2/Kconfig.xtal
```kconfig
choice XTAL_FREQ
    prompt "Main XTAL frequency"
    default XTAL_FREQ_40
    help
        This option selects the operating frequency of the XTAL (crystal) clock used to drive the ESP target.
        The selected value MUST reflect the frequency of the given hardware.

    config XTAL_FREQ_26
        bool "26 MHz"
    config XTAL_FREQ_40
        bool "40 MHz"
endchoice

# soc_xtal_freq_t enum in soc/clk_tree_defs.h lists the XTAL frequencies can be supported
# SOC_XTAL_SUPPORT_XXX in soc_caps.h lists the XTAL frequencies already supported
config XTAL_FREQ
    int
    default 26 if XTAL_FREQ_26
    default 40 if XTAL_FREQ_40
```
