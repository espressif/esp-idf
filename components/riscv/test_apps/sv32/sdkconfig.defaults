## components/sdmmc/Kconfig
```kconfig
menu "SD Protocol Layer Configuration"
    config SD_READY_POLL_PERIOD_START_US
        int "Initial delay between card status polls (us)"
        default 100
        range 1 10000
        help
            While waiting for the card to leave its busy state (for example after a write),
            the driver polls it with CMD13 (SEND_STATUS). This is the delay before the
            first re-poll; the delay then doubles after every poll, up to one FreeRTOS
            tick period.

            Polling back-to-back without a delay turns every write into a storm of
            hundreds of CMD13 commands, which occupies the host controller and slows down
            unrelated work on both cores.

            The exponential backoff means a card that becomes ready after 1.5 ms is
            detected at about 1.5 ms rather than at the next FreeRTOS tick, using a
            handful of commands instead of hundreds. Once the delay reaches one tick
            period it stops growing, so a long busy period costs one poll per tick and
            is detected within one tick of the card becoming ready.

            Lower this value to detect very short busy periods sooner, at the cost of
            more commands on the bus. Values larger than one FreeRTOS tick period are
            clamped to it, so the largest useful setting depends on CONFIG_FREERTOS_HZ.

            Delays shorter than one FreeRTOS tick period are spent busy-waiting, since
            there is no shorter blocking sleep available; a delay of one tick blocks on
            vTaskDelay() and lets other tasks run.

            The busy-waited part of the ramp does not yield, so lower-priority tasks on
            that core are held off for its duration. It lasts at most until the backoff
            reaches one tick: with the default 100 us start, about 1.5 ms at a 1 kHz
            tick (100+200+400+800 us) and about 12.7 ms at a 100 Hz tick. A card that
            becomes ready sooner ends the wait sooner. No CMD13 is issued during the
            delays, so the host controller and the bus stay idle throughout.
endmenu
```

## components/ulp/Kconfig
```kconfig
menu "Ultra Low Power (ULP) Co-processor"
    depends on (SOC_ULP_SUPPORTED || SOC_RISCV_COPROC_SUPPORTED || SOC_LP_CORE_SUPPORTED)

    config ULP_COPROC_ENABLED
        bool "Enable Ultra Low Power (ULP) Co-processor"
        default "n"
        help
            Enable this feature if you plan to use the ULP Co-processor.
            Once this option is enabled, further ULP co-processor configuration will appear in the menu.

    menu "ULP Coprocessor types"
        depends on ULP_COPROC_ENABLED

        config ULP_COPROC_TYPE_FSM
            bool "ULP FSM (Finite State Machine)"
            depends on SOC_ULP_FSM_SUPPORTED
            default y if IDF_TARGET_ESP32

        config ULP_COPROC_TYPE_RISCV
            bool "ULP RISC-V"
            depends on SOC_RISCV_COPROC_SUPPORTED
            default y if (IDF_TARGET_ESP32S2 || IDF_TARGET_ESP32S3) && !ULP_COPROC_TYPE_FSM

        config ULP_COPROC_TYPE_LP_CORE
            bool "LP core RISC-V"
            depends on SOC_LP_CORE_SUPPORTED
            default y if (!IDF_TARGET_ESP32 && !IDF_TARGET_ESP32S2 && !IDF_TARGET_ESP32S3)
    endmenu

    config ULP_COPROC_RESERVE_MEM
        int
        prompt "RTC slow memory reserved for coprocessor"
        depends on ULP_COPROC_ENABLED
        default 512 if IDF_TARGET_ESP32
        default 4096 if !IDF_TARGET_ESP32
        range 32 8176 if IDF_TARGET_ESP32 || IDF_TARGET_ESP32S2 || IDF_TARGET_ESP32S3
        range 32 16352 if IDF_TARGET_ESP32C5 || IDF_TARGET_ESP32C6
        range 32 32744 if IDF_TARGET_ESP32S31
        range 32 31088 if IDF_TARGET_ESP32P4 # Some memory are reserved for ROM/RTC reserved
        help
            Bytes of memory to reserve for ULP Co-processor firmware & data.
            Data is reserved at the beginning of RTC slow memory.

            The target-specific maximum only accounts for fixed LP/RTC reservations
            such as retained RTC data, LP ROM, and secure-boot digest storage.
            On targets where the application RTC sections also live in LP/RTC RAM,
            this reservation shares the same memory pool with .rtc.text,
            RTC_DATA_ATTR, RTC_NOINIT_ATTR, RTC_SLOW_ATTR, and related sections.
            Setting this value close to the maximum may therefore still leave too
            little LP/RTC RAM for the rest of the application and cause link-time
            errors.


    menu "ULP RISC-V Settings"
        depends on ULP_COPROC_TYPE_RISCV

        # Declared by the component that builds the ULP RISC-V program.
        rsource "subproject/components/ulp_riscv/Kconfig.ulp_riscv"

        config ULP_RISCV_I2C_RW_TIMEOUT
            int
            prompt "Set timeout for ULP RISC-V I2C transaction timeout in ticks."
            default 500
            range -1 4294967295
            help
                Set the ULP RISC-V I2C read/write timeout. Set this value to -1
                if the ULP RISC-V I2C read and write APIs should wait forever.
                Please note that the tick rate of the ULP co-processor would be
                different than the OS tick rate of the main core and therefore
                can have different timeout value depending on which core the API
                is invoked on.
    endmenu

    config ULP_SHARED_MEM
        depends on ULP_COPROC_TYPE_LP_CORE
        hex
        default 0x10
        help
            Size of the shared memory defined in ulp_lp_core_memory_shared.c.
            Size should be kept in-sync with the size of the struct defined there.

    menu "LP Core HP Memory"
        depends on ULP_COPROC_TYPE_LP_CORE

        config ULP_COPROC_RUN_FROM_HP_MEM
            bool "Run LP Core from HP memory"
            depends on !SECURE_ENABLE_TEE
            default n
            help
                Enable this option to allow the LP Core application to use HP SRAM for
                code and data. This allows much larger LP Core applications than would
                fit in LP RAM.

                Note: When this option is enabled, the LP Core cannot run during deep
                sleep because HP SRAM is powered off during sleep.

        config ULP_COPROC_RESERVE_HP_MEM_BYTES
            hex "HP SRAM size reserved for LP Core (bytes)"
            depends on ULP_COPROC_RUN_FROM_HP_MEM
            default 0x10000
            range 0x1000 0x80000
            help
                Amount of HP SRAM (in bytes) to carve out from the top of the HP SRAM
                region for the LP Core application. This memory is not available to the
                HP application.
    endmenu

    # Declared by the component that builds the LP core program.
    rsource "subproject/components/lp_core/Kconfig.lp_core"

    config ULP_TRAP_WAKEUP
        depends on ULP_COPROC_TYPE_LP_CORE
        bool
        prompt "Enable wakeup of HP-CPU when LP-core encounters an exception"
        default "y"
        help
            Set this option to also trigger a wakeup signal to the HP-CPU when
            the LP-core encounters an exception.

    menu "ULP Debugging Options"
        # Declared by the component that builds the LP core program.
        rsource "subproject/components/lp_core/Kconfig.lp_core_debug"

        config ULP_NORESET_UNDER_DEBUG
            bool "Avoid resetting LP core when debugger is attached"
            depends on ULP_COPROC_TYPE_LP_CORE
            default "y"
            help
                Enable this feature to avoid resetting LP core in sleep mode when debugger is attached,
                otherwise configured HW breakpoints and dcsr.ebreak* bits will be missed.
                This is a workaround until it will be fixed in HW.

    endmenu

endmenu  # Ultra Low Power (ULP) Co-processor
```

## components/ulp/subproject/components/lp_core/Kconfig.lp_core
```kconfig
# Sourced by the ULP coprocessor driver on the HP core, in
# components/ulp/Kconfig. Not named Kconfig, which would also attach it to
# this component and define every option twice.

config ULP_ROM_PRINT_ENABLE
    depends on ULP_COPROC_TYPE_LP_CORE && ESP_ROM_HAS_LP_ROM
    bool
    prompt "Enable print utilities from LP ROM"
    default "y"
    help
        Set this option to enable printf functionality from LP ROM. This option
        can help reduce the LP core binary size by not linking printf functionality
        from RAM code.
        Note: For LP ROM prints to work properly, make sure that the LP core boots
        from the LP ROM.

config ULP_LP_CORE_MEMPROT
    bool "Enable LP Core memory protection (PMP)"
    depends on ULP_COPROC_TYPE_LP_CORE && SOC_LP_CORE_HAS_PMP && !ULP_COPROC_RUN_FROM_HP_MEM
    default n
    help
        Configures the LP CPU's PMP entries to enforce memory protection.
        LP RAM is split into executable (.text) and data (.data/.bss/stack)
        regions. Regions not explicitly permitted are inaccessible.
        Not available when "Run LP Core from HP memory" is enabled.
        Disable this if you need full control over PMP configuration.
```

## components/ulp/subproject/components/lp_core/Kconfig.lp_core_debug
```kconfig
# Sourced by the ULP coprocessor driver on the HP core, in
# components/ulp/Kconfig. Not named Kconfig, which would also attach it to
# this component and define every option twice.

config ULP_PANIC_OUTPUT_ENABLE
    depends on ULP_COPROC_TYPE_LP_CORE && SOC_ULP_LP_UART_SUPPORTED
    bool
    prompt "Enable panic handler which outputs over LP UART"
    default "n"
    help
        Set this option to enable panic handler functionality. If this option is
        enabled then the LP Core will output a panic dump over LP UART,
        similar to what the main core does. Output depends on LP UART already being
        initialized and configured.
        Disabling this option will reduce the LP core binary size by not
        linking in panic handler functionality.

config ULP_HP_UART_CONSOLE_PRINT
    depends on ULP_COPROC_TYPE_LP_CORE
    bool
    prompt "Route lp_core_printf to the console HP-UART"
    help
        Set this option to route lp_core_printf to the console HP-UART.
        This allows you to easily view print outputs from the LP core, without
        having to connect to the LP-UART. This option comes with the following
        limitations:

        1. There is no mutual exclusion between the HP-Core and the LP-Core accessing
        the HP-UART, which means that if both cores are logging heavily the output
        strings might get mangled together.
        2. The HP-UART can only work while the HP-Core is running, which means that
        if the HP-Core is in deep sleep, the LP-Core will not be able to print to the
        console HP-UART.

        Due to these limitations it is only recommended to use this option for easy debugging.
        For more serious use-cases you should use the LP-UART.
```

## components/ulp/test_apps/lp_core/lp_core_deep_sleep_tests/main/Kconfig.projbuild
```kconfig
menu "LP Core Deep Sleep Test Configuration"

    config TEST_LP_GPIO_SLEEP_PIN
        int "GPIO pin wired between the two boards for LP GPIO tests"
        default 2
        help
            RTC GPIO used for LP GPIO input, output, interrupt, and deep-sleep
            wakeup. The same pin number must be wired between the two boards.
            On ESP32-C5 this is also the default LP I2C SDA pin, so the I2C and
            GPIO cases run one at a time with the wire left connected.

endmenu
```

## examples/bluetooth/bluedroid/ble/ble_enc_adv_data/enc_adv_data_prph/main/Kconfig.projbuild
```kconfig
menu "Example Configuration"

    config EXAMPLE_ENABLE_KEY_MATERIAL
        bool "Enable Key Material characteristic in GAP Service"
        depends on BT_GATTS_ENABLE
        default y
        select BT_GATTS_KEY_MATERIAL_CHAR
        help
            Enable the Key Material characteristic in the built-in GAP service
            (UUID 0x2B88). This also enables Encrypted Advertising Data APIs
            (CONFIG_BT_BLE_FEAT_ENC_ADV_DATA).

            This is the standard-compliant approach as defined in Bluetooth
            Core Specification Version 5.4.

endmenu
```

## examples/bluetooth/bluedroid/classic_bt/bt_opp_client/main/Kconfig.projbuild
```kconfig
menu "OPP Example Configuration"

    config EXAMPLE_PEER_DEVICE_NAME
        string "Target device name"
        default "ESP_OPP_SERVER"
        help
            Bluetooth device name of the OPP server to connect.

endmenu
```

## examples/bluetooth/bluedroid/classic_bt/bt_opp_server/main/Kconfig.projbuild
```kconfig
menu "OPP Example Configuration"

    config EXAMPLE_LOCAL_DEVICE_NAME
        string "Local device name"
        default "ESP_OPP_SERVER"
        help
            Classic Bluetooth name advertised by this OPP server.

    config EXAMPLE_OPP_SRV_AUTO_ACCEPT
        bool "Auto-accept incoming objects"
        default y
        help
            If enabled, every incoming object is accepted automatically.
            If disabled, only the first object on an OBEX connection needs
            esp_opp_server_accept(); later objects on the same connection
            are auto-authorized.

endmenu
```

## examples/bluetooth/bluedroid/classic_bt/bt_pan_gn/main/Kconfig.projbuild
```kconfig
menu "PAN GN Example Configuration"

    config EXAMPLE_PAN_GN_BT_NAME
        string "GN Hub Bluetooth name"
        default "ESP_PAN_GN"
        help
            Bluetooth name advertised by this GN hub. PANU clients scan for this exact name.

endmenu
```

## examples/bluetooth/bluedroid/classic_bt/bt_pan_nap/main/Kconfig.projbuild
```kconfig
menu "PAN NAP Wi-Fi Tether Example"

    config EXAMPLE_WIFI_SSID
        string "Wi-Fi SSID (uplink)"
        default "myssid"
        help
            Wi-Fi network the ESP32 NAP connects to for Internet uplink.

    config EXAMPLE_WIFI_PASSWORD
        string "Wi-Fi Password"
        default "mypassword"

    config EXAMPLE_WIFI_CONN_MAX_RETRY
        int "Wi-Fi connection max retry"
        default 10
        range 0 100

    config EXAMPLE_PAN_NAP_BT_NAME
        string "Bluetooth device name (NAP)"
        default "ESP_PAN_NAP"
        help
            PANU peers (e.g. phone) discover and connect to this name.

endmenu
```

## examples/bluetooth/bluedroid/classic_bt/bt_pan_nap/sdkconfig.defaults
```kconfig
CONFIG_BT_ENABLED=y
CONFIG_BTDM_CTRL_MODE_BLE_ONLY=n
CONFIG_BTDM_CTRL_MODE_BR_EDR_ONLY=y
CONFIG_BTDM_CTRL_MODE_BTDM=n
CONFIG_BT_CLASSIC_ENABLED=y
CONFIG_BT_PAN_ENABLED=y
CONFIG_BT_BLE_ENABLED=n

CONFIG_ESP_COEX_SW_COEXIST_ENABLE=y

CONFIG_LWIP_IP_FORWARD=y
CONFIG_LWIP_IPV4_NAPT=y

CONFIG_PARTITION_TABLE_SINGLE_APP_LARGE=y
```

## examples/bluetooth/bluedroid/classic_bt/bt_pan_panu/main/Kconfig.projbuild
```kconfig
menu "PAN PANU Example Configuration"
    config EXAMPLE_PEER_DEVICE_NAME
        string "Target NAP Bluetooth Name"
        default "ESP_PAN_NAP"
        help
            Bluetooth name of the NAP device that shares network access.
            Default matches bt_pan_nap example device name.

    config EXAMPLE_PING_TARGET
        string "Ping Target (IPv4 address)"
        default "8.8.8.8"
        help
            IPv4 address to ping after PAN link obtains an IP via DHCP
            (e.g. 8.8.8.8). Hostnames are not resolved; use a dotted-quad
            address only.

    config EXAMPLE_PING_COUNT
        int "Ping Count"
        default 20
        range 1 1000

    config EXAMPLE_PING_TIMEOUT_MS
        int "Ping Timeout (ms)"
        default 3000
        range 500 30000
endmenu
```
