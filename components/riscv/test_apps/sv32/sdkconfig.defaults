## examples/bluetooth/esp_ble_audio/bap/broadcast_assistant/main/Kconfig.projbuild
```kconfig
# SPDX-FileCopyrightText: 2026 Espressif Systems (Shanghai) CO LTD
# SPDX-License-Identifier: Apache-2.0

menu "Example: Broadcast Assistant"

    config EXAMPLE_PAST
        bool "Transfer the local PA sync to the Scan Delegator (PAST)"
        default y
        select BT_BLE_FEAT_PERIODIC_ADV_SYNC_TRANSFER if BT_BLUEDROID_ENABLED
        select BT_NIMBLE_PERIODIC_ADV_SYNC_TRANSFER if BT_NIMBLE_ENABLED
        help
            Offer the sync used to read the BASE in Add Source (PA_Sync = 0x01)
            and hand it over on request, so the delegator never scans for the
            source. Off advertises 0x02 and leaves the delegator to sync itself;
            the host PAST-send feature must then be off as well, which on NimBLE
            (default y) means CONFIG_BT_NIMBLE_PERIODIC_ADV_SYNC_TRANSFER=n.

endmenu
```

## examples/bluetooth/esp_ble_audio/bap/broadcast_sink/main/Kconfig.projbuild
```kconfig
# SPDX-FileCopyrightText: 2022 Nordic Semiconductor ASA
# SPDX-FileContributor: 2026 Espressif Systems (Shanghai) CO LTD
# SPDX-License-Identifier: Apache-2.0

menu "Example: Broadcast Sink"

    config EXAMPLE_SCAN_OFFLOAD
        bool "Whether to wait for a Broadcast Assistant"
        help
            If set to true, the example advertises connectable for Broadcast
            Assistants and never picks a source itself — an Assistant selects
            one and drives PA / BIS sync over BASS. The scanner only runs
            while a requested periodic sync is being established.

            If set to false, the example scans for TARGET_DEVICE_NAME and
            syncs on its own, without advertising.

    config EXAMPLE_PAST
        bool "Accept a transferred PA sync from the Assistant (PAST)"
        depends on EXAMPLE_SCAN_OFFLOAD
        default y
        select BT_NIMBLE_PERIODIC_ADV_SYNC_TRANSFER if BT_NIMBLE_ENABLED
        select BT_BLE_FEAT_PERIODIC_ADV_SYNC_TRANSFER if BT_BLUEDROID_ENABLED
        help
            When the Assistant offers PA_Sync = 0x01, answer SyncInfo Request
            and let it hand its sync over, so no scanning is needed. Off means
            always establishing the sync locally instead, which BASS 3.1.1.4
            allows for either request value.

endmenu
```

## examples/bluetooth/esp_ble_audio/cap/handover/main/Kconfig.projbuild
```kconfig
# SPDX-FileCopyrightText: 2026 Espressif Systems (Shanghai) CO LTD
# SPDX-License-Identifier: Apache-2.0

menu "Example: CAP Handover"

    config EXAMPLE_HANDOVER_PERIOD_S
        int "Seconds between automatic handovers (0 to disable)"
        default 300
        help
            Once unicast audio is streaming the sample alternates between unicast
            and broadcast every this many seconds. Set to 0 to stay on unicast
            after the initial setup.

endmenu
```

## examples/bluetooth/esp_ble_audio/common_components/example_utils/Kconfig.projbuild
```kconfig
# SPDX-FileCopyrightText: 2026 Espressif Systems (Shanghai) CO LTD
# SPDX-License-Identifier: Apache-2.0

menu "Example: Common Audio Utilities"

    config EXAMPLE_AUDIO_TX_TIMESTAMP
        bool "Synchronize multi-stream TX with timestamps"
        depends on BT_BAP_BROADCAST_SOURCE || BT_BAP_UNICAST_CLIENT
        default n
        help
            Give the SDUs of all streams of a BIG or CIG the same timestamps,
            based on the controller clock, so that the SDUs of one frame (e.g.
            the left and right audio of one sampling period) go in one event.
            Each SDU is timestamped with its SDU reference time (R0, R1, ...:
            the CIG reference point or BIG anchor point of its event plus k SDU
            intervals):

              Host                               Controller
                |  every SDU interval, one SDU (ST1): |
                |  SDU 0, 1, ... without timestamp    |
                |------------------------------------>|  on air at R0, R1..
                |  after each, LE Read ISO TX Sync    |
                |<----------------------------------->|  seq, its event's A
                |  ... until SDU j starts an event:   |
                |  Rj = A, Rn = Rj + (n - j)I         |
                |                                     |
                |  every SDU interval, one frame:     |
                |  SDU at Rn on ST1, ST2, ...         |
                |------------------------------------>|  one event for all
                |  ST3 started: joins at next frame   |
                |                                     |
                |  per SDU: handled at, its ref. time |
                |<------------------------------------|
                |  best lead of 50 SDUs < 200 us:     |
                |  one more frame at the next tick    |
                |------------------------------------>|

            The controller places SDUs without timestamps by sequence number.
            TX Sync gives only the reference point A of an event, shared by its
            SDUs, so the first stream reads it after each SDU until SDUs
            ISO interval / SDU interval - 1 apart show the same A: the first of
            them starts the event and its reference time is A. The read is a
            blocking HCI command (about 2.5 ms), so it comes after the send,
            not to delay it. One TX scheduler for the group then sends one
            frame per SDU interval, one SDU with the same timestamp on each
            stream. The best lead (how long before its reference time an SDU
            is handled) of every 50 SDUs follows the clock difference between
            the timer and the controller: below 200 us one frame is added, above
            two SDU intervals more one is skipped. A stall lowers only some
            SDUs, and the ticks then catch up, so it changes nothing; a best
            lead below minus one SDU interval is a stall or a backlog, and no
            frame is added for it. A stream started later joins at the next
            frame, so it is as early as the others. TX Sync is not read again:
            the controller places SDUs by their timestamps, on anchors of its
            own clock.

            The first 4 bytes of each SDU carry its timestamp (0 without one).
            Supported on broadcast source and unicast client with unframed
            data; used by bap/broadcast_source, bap/unicast_client,
            cap/initiator, cap/handover and tmap/central, other examples
            ignore it.

    config EXAMPLE_AUDIO_RX_ALIGN_CHECK
        bool "Check on RX that timestamped SDUs share events"
        depends on BT_BAP_BROADCAST_SINK || BT_BAP_UNICAST_SERVER
        default n
        help
            For debugging the receiving side of a BIG or CIG whose TX side uses
            "Synchronize multi-stream TX with timestamps", which puts each
            SDU's timestamp, i.e. its frame, in its first 4 bytes. SDUs of one
            SDU reference time share the RX timestamp, so they must be of one
            frame; each SDU is compared with the one before. RX timestamps up to
            100 us apart count as one: each CIS anchor is estimated on its own.

            Every 6000 compared: "RX group: total, aligned, misaligned". The
            first misaligned SDUs are logged. Each RX log also adds the valid
            (empty), error and lost SDUs of the stream.

endmenu
```

## examples/bluetooth/esp_ble_audio/tmap/peripheral/main/Kconfig.projbuild
```kconfig
# SPDX-FileCopyrightText: 2022 Nordic Semiconductor ASA
# SPDX-FileContributor: 2026 Espressif Systems (Shanghai) CO LTD
# SPDX-License-Identifier: Apache-2.0

menu "Example: TMAP Peripheral (CT & UMR)"

    choice EXAMPLE_TMAP_PER_TYPE_CHOICE

        prompt "Earbuds type"
        default EXAMPLE_TMAP_PER_SINGLE
        help
            Select the Earbuds Type to compile. Together with Earbud Location this
            has to match the topology tmap_central is built for; the defaults of
            both examples pair up as "1 peripheral, 2 CISes".

        config EXAMPLE_TMAP_PER_SINGLE
            bool "Single headset"
            help
                A standalone acceptor: no CSIS instance and no RSI. Which channels
                it renders is the separate choice below.

        config EXAMPLE_TMAP_PER_DUO
            bool "Duo headset"
            select BT_CSIP_SET_MEMBER
            select BT_CAP_ACCEPTOR_SET_MEMBER

    endchoice

    choice EXAMPLE_TMAP_PER_LOCATION

        prompt "Earbud Location"
        default EXAMPLE_TMAP_PER_STEREO if EXAMPLE_TMAP_PER_SINGLE
        default EXAMPLE_TMAP_PER_LEFT
        help
            Which channels this device renders, published as the PACS Sink and
            Source Audio Locations, and what the central reads to decide the
            channel it sends here. The options follow the earbuds type: a single
            headset is a whole device, so it is mono or stereo, while a set member
            is one of a pair, so it is left or right.

        config EXAMPLE_TMAP_PER_MONO
            bool "Mono"
            depends on !EXAMPLE_TMAP_PER_DUO
            help
                Publish an empty Audio Locations bitmap, which BAP reads as "mono,
                no preference", so the central sends one mono stream. This is what
                a one-ear headset renders; pair it with the central's
                "1 peripheral, 1 CIS" topology.

        config EXAMPLE_TMAP_PER_STEREO
            bool "Stereo"
            depends on !EXAMPLE_TMAP_PER_DUO
            help
                Publish front left and front right, so one device renders both
                channels. This is the default, matching the central's default
                "1 peripheral, 2 CISes" topology, which configures both channels
                on this board.

        config EXAMPLE_TMAP_PER_LEFT
            bool "Left"
            depends on EXAMPLE_TMAP_PER_DUO

        config EXAMPLE_TMAP_PER_RIGHT
            bool "Right"
            depends on EXAMPLE_TMAP_PER_DUO

    endchoice

    if EXAMPLE_TMAP_PER_DUO
        config EXAMPLE_TMAP_PER_SET_RANK
            int "Device rank in set"
            range 1 2
            default 1 if EXAMPLE_TMAP_PER_LEFT
            default 2 if EXAMPLE_TMAP_PER_RIGHT
            default 1
            help
                Rank of this device in set. A lockable coordinated set requires a
                non-zero rank that is unique among its members, so the two boards
                must end up with rank 1 and rank 2 — duplicate ranks break the
                CSIP ordered access procedure the central locks the set with.

                The default follows Earbud Location (left is 1, right is 2), and a
                set member can only be left or right, so building the two boards
                for their respective ears already gives them distinct ranks.

                Rank orders the set lock, and decides which member the central's
                "2 peripherals" topology gives the bidirectional CIS to. It does
                not say which ear this board is — that comes from Earbud Location.
    endif

endmenu
```
