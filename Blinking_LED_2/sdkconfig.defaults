## components/app_trace/Kconfig.apptrace
```kconfig
menu "Application Level Tracing"
    depends on ESP_TRACE_TRANSPORT_APPTRACE
    choice APPTRACE_DESTINATION
        prompt "Data Destination"
        default APPTRACE_DEST_JTAG if !PM_ENABLE
        default APPTRACE_DEST_UART if PM_ENABLE
        help
            Select destination for application trace: JTAG, UART, or both.

        config APPTRACE_DEST_JTAG
            bool "JTAG"
            select APPTRACE_TRAX_ENABLE if IDF_TARGET_ARCH_XTENSA
            depends on !PM_ENABLE

        config APPTRACE_DEST_UART
            bool "UART"

        config APPTRACE_DEST_ALL
            bool "All (runtime selection)"
            help
                Compile both JTAG and UART interfaces in advance (higher IRAM usage).
                Allows runtime switching between JTAG and UART via esp_apptrace_get_user_params().

                If esp_apptrace_get_user_params() is not provided by the
                application, JTAG is used by default with the default
                configuration defined in components/app_trace/include/esp_app_trace_config.h.
    endchoice

    config APPTRACE_BUF_SIZE
        int "Size of the apptrace buffer"
        depends on APPTRACE_DEST_JTAG && !APPTRACE_TRAX_ENABLE
        default 16384
        help
            Size of the memory buffer for trace data in bytes.

    config APPTRACE_DEST_UART_NUM
        int "UART port number"
        depends on APPTRACE_DEST_UART
        range 0 1 if (SOC_UART_HP_NUM <= 2)
        range 0 2 if (SOC_UART_HP_NUM <= 3)
        range 0 4 if (SOC_UART_HP_NUM <= 5)
        default 1
        help
            UART communication port number for the apptrace destination.
            See UART documentation for available port numbers.

    config APPTRACE_UART_TX_GPIO
        int "UART TX on GPIO<num>"
        depends on APPTRACE_DEST_UART
        range 0 46
        default 12
        help
            This GPIO is used for UART TX pin.

    config APPTRACE_UART_RX_GPIO
        int "UART RX on GPIO<num>"
        depends on APPTRACE_DEST_UART
        range 0 46
        default 13
        help
            This GPIO is used for UART RX pin.

    config APPTRACE_UART_BAUDRATE
        int
        prompt "UART baud rate" if APPTRACE_DEST_UART
        depends on APPTRACE_DEST_UART
        default 1000000
        range 1200 8000000
        range 1200 1000000
        help
            This baud rate is used for UART.

            The app's maximum baud rate depends on the UART clock source. If Power Management is disabled,
            the UART clock source is the APB clock and all baud rates in the available range will be sufficiently
            accurate. If Power Management is enabled, REF_TICK clock source is used so the baud rate is divided
            from 1MHz. Baud rates above 1Mbps are not possible and values between 500Kbps and 1Mbps may not be
            accurate.

    config APPTRACE_UART_TX_BUFF_SIZE
        int
        prompt "UART TX ring buffer size" if APPTRACE_DEST_UART
        depends on APPTRACE_DEST_UART
        default 4096
        range 2048 32768
        help
            Size of the UART output ring buffer. Must be power of two.
            This size related to the baudrate, system tick frequency and amount of data to transfer.

    config APPTRACE_UART_TX_MSG_SIZE
        int
        prompt "UART TX message size" if APPTRACE_DEST_UART
        depends on APPTRACE_DEST_UART
        default 128
        range 64 32768
        help
            Maximum size of the single message to transfer.

    config APPTRACE_TRAX_ENABLE
        bool
        depends on IDF_TARGET_ARCH_XTENSA && !ESP32_TRAX && !ESP32S2_TRAX && !ESP32S3_TRAX
        select ESP32_MEMMAP_TRACEMEM
        select ESP32S2_MEMMAP_TRACEMEM
        select ESP32S3_MEMMAP_TRACEMEM
        select ESP32_MEMMAP_TRACEMEM_TWOBANKS
        select ESP32S2_MEMMAP_TRACEMEM_TWOBANKS
        select ESP32S3_MEMMAP_TRACEMEM_TWOBANKS
        default n
        help
            Enables/disable TRAX tracing HW.

    config APPTRACE_LOCK_ENABLE
        bool "Internal Sync Lock Enable"
        default n
        help
            Enables/disable application tracing module internal sync lock to prevent data corruption
            when multiple tasks are writing to the same trace buffer.
            Keep in mind this will slow down the trace data transfer to the host.

    config APPTRACE_ONPANIC_HOST_FLUSH_TMO
        int "Timeout for flushing last trace data to host on panic"
        range -1 5000
        default -1
        help
            Timeout for flushing last trace data to host in case of panic. In ms.
            Use -1 to disable timeout and wait forever.

    config APPTRACE_POSTMORTEM_FLUSH_THRESH
        int "Threshold for flushing last trace data to host on panic"
        range 0 16384
        default 0
        help
            Threshold for flushing last trace data to host on panic in post-mortem mode.
            This is minimal amount of data needed to perform flush. In bytes.
endmenu
```

## components/app_trace/sys_view/Kconfig.sysview
```kconfig
menu "SEGGER SystemView"
    depends on ESP_TRACE_LIB_SEGGER_SYSVIEW
    choice SEGGER_SYSVIEW_DEST_CPU
        prompt "CPU to trace"
        depends on ESP_TRACE_TRANSPORT_APPTRACE && APPTRACE_DEST_UART && !ESP_SYSTEM_SINGLE_CORE_MODE
        default SEGGER_SYSVIEW_DEST_CPU_0
        help
            Define the CPU to trace.

        config SEGGER_SYSVIEW_DEST_CPU_0
            bool "CPU0"
            help
                Send tracing data for Pro CPU.

        config SEGGER_SYSVIEW_DEST_CPU_1
            bool "CPU1"
            help
                Send tracing data for App CPU.

    endchoice

    config SEGGER_SYSVIEW_MAX_TASKS
        int "Maximum supported tasks"
        range 1 64
        default 16
        help
            Configures maximum supported tasks in sysview debug

    config SEGGER_SYSVIEW_BUF_WAIT_TMO
        int "Trace buffer wait timeout"
        default 500
        help
            Configures timeout (in us) to wait for free space in trace buffer.
            Set to -1 to wait forever and avoid lost events.

    config SEGGER_SYSVIEW_EVT_OVERFLOW_ENABLE
        bool "Trace Buffer Overflow Event"
        default y
        help
            Enables "Trace Buffer Overflow" event.

    config SEGGER_SYSVIEW_EVT_ISR_ENTER_ENABLE
        bool "ISR Enter Event"
        default y
        help
            Enables "ISR Enter" event.

    config SEGGER_SYSVIEW_EVT_ISR_EXIT_ENABLE
        bool "ISR Exit Event"
        default y
        help
            Enables "ISR Exit" event.

    config SEGGER_SYSVIEW_EVT_ISR_TO_SCHED_ENABLE
        bool "ISR Exit to Scheduler Event"
        default y
        help
            Enables "ISR to Scheduler" event.

    config SEGGER_SYSVIEW_EVT_TASK_START_EXEC_ENABLE
        bool "Task Start Execution Event"
        default y
        help
            Enables "Task Start Execution" event.

    config SEGGER_SYSVIEW_EVT_TASK_STOP_EXEC_ENABLE
        bool "Task Stop Execution Event"
        default y
        help
            Enables "Task Stop Execution" event.

    config SEGGER_SYSVIEW_EVT_TASK_START_READY_ENABLE
        bool "Task Start Ready State Event"
        default y
        help
            Enables "Task Start Ready State" event.

    config SEGGER_SYSVIEW_EVT_TASK_STOP_READY_ENABLE
        bool "Task Stop Ready State Event"
        default y
        help
            Enables "Task Stop Ready State" event.

    config SEGGER_SYSVIEW_EVT_TASK_CREATE_ENABLE
        bool "Task Create Event"
        default y
        help
            Enables "Task Create" event.

    config SEGGER_SYSVIEW_EVT_TASK_TERMINATE_ENABLE
        bool "Task Terminate Event"
        default y
        help
            Enables "Task Terminate" event.

    config SEGGER_SYSVIEW_EVT_IDLE_ENABLE
        bool "System Idle Event"
        default y
        help
            Enables "System Idle" event.

    config SEGGER_SYSVIEW_EVT_TIMER_ENTER_ENABLE
        bool "Timer Enter Event"
        default y
        help
            Enables "Timer Enter" event.

    config SEGGER_SYSVIEW_EVT_TIMER_EXIT_ENABLE
        bool "Timer Exit Event"
        default y
        help
            Enables "Timer Exit" event.
endmenu
```

## components/app_update/Kconfig.projbuild
```kconfig
menu "App Update config"
    config SECURE_SIGNED_DATA_PARTITION
        default n
        bool "Require signed Data partition images"
        depends on SECURE_SIGNED_ON_UPDATE_NO_SECURE_BOOT || SECURE_SIGNED_APPS
        help
            If set, the Data partition images will be verified during OTA updates.
            Only partitions with subtype ESP_PARTITION_SUBTYPE_DATA_UNDEFINED will be verified.
endmenu  # App Update config
```

## components/app_update/test_apps/sdkconfig.defaults
```kconfig
# General options for additional checks
CONFIG_HEAP_POISONING_COMPREHENSIVE=y
CONFIG_COMPILER_WARN_WRITE_STRINGS=y
CONFIG_BOOTLOADER_LOG_LEVEL_WARN=y
CONFIG_FREERTOS_WATCHPOINT_END_OF_STACK=y
CONFIG_COMPILER_STACK_CHECK_MODE_STRONG=y
CONFIG_COMPILER_STACK_CHECK=y

CONFIG_ESP_TASK_WDT=n

CONFIG_ESPTOOLPY_FLASHSIZE_4MB=y
CONFIG_PARTITION_TABLE_CUSTOM_FILENAME="partition_table_unit_test_two_ota.csv"
CONFIG_PARTITION_TABLE_FILENAME="partition_table_unit_test_two_ota.csv"

CONFIG_PARTITION_TABLE_CUSTOM=y
CONFIG_PARTITION_TABLE_OFFSET=0x18000
CONFIG_BOOTLOADER_HOLD_TIME_GPIO=2
CONFIG_BOOTLOADER_OTA_DATA_ERASE=y
```

## components/app_update/test_apps/sdkconfig.defaults.esp32c2
```kconfig
CONFIG_IDF_TARGET="esp32c2"
CONFIG_ESPTOOLPY_FLASHSIZE_2MB=y
CONFIG_PARTITION_TABLE_CUSTOM_FILENAME="partition_table_unit_test_two_ota_2m.csv"
CONFIG_PARTITION_TABLE_FILENAME="partition_table_unit_test_two_ota_2m.csv"
CONFIG_BOOTLOADER_NUM_PIN_APP_TEST=18
```

## components/app_update/test_apps/test_app_update/sdkconfig.defaults.esp32
```kconfig
CONFIG_IDF_TARGET="esp32"
CONFIG_BOOTLOADER_FACTORY_RESET=y
CONFIG_BOOTLOADER_APP_TEST=y
CONFIG_BOOTLOADER_DATA_FACTORY_RESET=""
CONFIG_BOOTLOADER_NUM_PIN_APP_TEST=32
CONFIG_BOOTLOADER_NUM_PIN_FACTORY_RESET=4
CONFIG_BOOTLOADER_HOLD_TIME_GPIO=2
```

## components/app_update/test_apps/test_app_update/sdkconfig.defaults.esp32c6
```kconfig
CONFIG_IDF_TARGET="esp32c6"
CONFIG_BOOTLOADER_NUM_PIN_APP_TEST=18
CONFIG_BOOTLOADER_NUM_PIN_FACTORY_RESET=4
```

## components/app_update/test_apps/test_app_update/sdkconfig.defaults.esp32c61
```kconfig
CONFIG_IDF_TARGET="esp32c61"
CONFIG_BOOTLOADER_NUM_PIN_APP_TEST=18
CONFIG_BOOTLOADER_NUM_PIN_FACTORY_RESET=19
```

## components/app_update/test_apps/test_app_update/sdkconfig.defaults.esp32h2
```kconfig
CONFIG_IDF_TARGET="esp32h2"
CONFIG_BOOTLOADER_NUM_PIN_APP_TEST=22
CONFIG_BOOTLOADER_NUM_PIN_FACTORY_RESET=4
```

## components/app_update/test_apps/test_app_update/sdkconfig.defaults.esp32p4
```kconfig
CONFIG_IDF_TARGET="esp32p4"
CONFIG_BOOTLOADER_NUM_PIN_APP_TEST=18
CONFIG_BOOTLOADER_NUM_PIN_FACTORY_RESET=19
```

## components/app_update/test_apps/test_app_update/sdkconfig.defaults.esp32s2
```kconfig
CONFIG_IDF_TARGET="esp32s2"
CONFIG_BOOTLOADER_NUM_PIN_APP_TEST=18
CONFIG_BOOTLOADER_NUM_PIN_FACTORY_RESET=4
```

## components/asio/Kconfig
```kconfig
menu "ESP-ASIO"
    visible if LWIP_IPV6

    config ASIO_SSL_SUPPORT
        bool "Enable SSL/TLS support of ASIO"
        default n
        help
            Enable support for basic SSL/TLS features, available for mbedTLS/OpenSSL
            as well as wolfSSL TLS library.

    choice ASIO_SSL_LIBRARY_CHOICE
        prompt "Choose SSL/TLS library for ESP-TLS (See help for more Info)"
        default ASIO_USE_ESP_OPENSSL
        depends on ASIO_SSL_SUPPORT
        help
            The ASIO support multiple backend TLS libraries. Currently the mbedTLS with a thin ESP-OpenSSL
            port layer (default choice) and WolfSSL are supported.
            Different TLS libraries may support different features and have different resource
            usage. Consult the ESP-TLS documentation in ESP-IDF Programming guide for more details.
        config ASIO_USE_ESP_OPENSSL
            bool "esp-openssl"
        config ASIO_USE_ESP_WOLFSSL
            depends on TLS_STACK_WOLFSSL
            bool "wolfSSL (License info in wolfSSL directory README)"
    endchoice

endmenu
```
