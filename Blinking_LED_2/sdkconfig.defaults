## components/aws_iot/Kconfig
```kconfig
menuconfig AWS_IOT_SDK
    bool "Amazon Web Services IoT Platform"
    help
       Select this option to enable support for the AWS IoT platform,
       via the esp-idf component for the AWS IoT Device C SDK.

config AWS_IOT_MQTT_HOST
    string "AWS IoT Endpoint Hostname"
    depends on AWS_IOT_SDK
    default ""
    help
        Default endpoint host name to connect to AWS IoT MQTT/S gateway

        This is the custom endpoint hostname and is specific to an AWS
        IoT account. You can find it by logging into your AWS IoT
        Console and clicking the Settings button. The endpoint hostname
        is shown under the "Custom Endpoint" heading on this page.

        If you need per-device hostnames for different regions or
        accounts, you can override the default hostname in your app.

config AWS_IOT_MQTT_PORT
    int "AWS IoT MQTT Port"
    depends on AWS_IOT_SDK
    default 8883
    range 0 65535
    help
        Default port number to connect to AWS IoT MQTT/S gateway

        If you need per-device port numbers for different regions, you can
        override the default port number in your app.


config AWS_IOT_MQTT_TX_BUF_LEN
    int "MQTT TX Buffer Length"
    depends on AWS_IOT_SDK
    default 512
    range 32 65536
    help
        Maximum MQTT transmit buffer size. This is the maximum MQTT
        message length (including protocol overhead) which can be sent.

        Sending longer messages will fail.

config AWS_IOT_MQTT_RX_BUF_LEN
    int "MQTT RX Buffer Length"
    depends on AWS_IOT_SDK
    default 512
    range 32 65536
    help
        Maximum MQTT receive buffer size. This is the maximum MQTT
        message length (including protocol overhead) which can be
        received.

        Longer messages are dropped.



config AWS_IOT_MQTT_NUM_SUBSCRIBE_HANDLERS
    int "Maximum MQTT Topic Filters"
    depends on AWS_IOT_SDK
    default 5
    range 1 100
    help
        Maximum number of concurrent MQTT topic filters.


config AWS_IOT_MQTT_MIN_RECONNECT_WAIT_INTERVAL
    int "Auto reconnect initial interval (ms)"
    depends on AWS_IOT_SDK
    default 1000
    range 10 3600000
    help
        Initial delay before making first reconnect attempt, if the AWS IoT connection fails.
        Client will perform exponential backoff, starting from this value.

config AWS_IOT_MQTT_MAX_RECONNECT_WAIT_INTERVAL
    int "Auto reconnect maximum interval (ms)"
    depends on AWS_IOT_SDK
    default 128000
    range 10 3600000
    help
        Maximum delay between reconnection attempts. If the exponentially increased delay
        interval reaches this value, the client will stop automatically attempting to reconnect.

menu "Thing Shadow"
    depends on AWS_IOT_SDK

config AWS_IOT_OVERRIDE_THING_SHADOW_RX_BUFFER
    bool "Override Shadow RX buffer size"
    depends on AWS_IOT_SDK
    default n
    help
        Allows setting a different Thing Shadow RX buffer
        size. This is the maximum size of a Thing Shadow
        message in bytes, plus one.

        If not overridden, the default value is the MQTT RX Buffer length plus one. If overriden, do not set higher than the default value.

config AWS_IOT_SHADOW_MAX_SIZE_OF_RX_BUFFER
    int "Maximum RX Buffer (bytes)"
    depends on AWS_IOT_OVERRIDE_THING_SHADOW_RX_BUFFER
    default 513
    range 32 65536
    help
        Allows setting a different Thing Shadow RX buffer size.
        This is the maximum size of a Thing Shadow message in bytes,
        plus one.


config AWS_IOT_SHADOW_MAX_SIZE_OF_UNIQUE_CLIENT_ID_BYTES
    int "Maximum unique client ID size (bytes)"
    depends on AWS_IOT_SDK
    default 80
    range 4 1000
    help
        Maximum size of the Unique Client Id.

config AWS_IOT_SHADOW_MAX_SIMULTANEOUS_ACKS
    int "Maximum simultaneous responses"
    depends on AWS_IOT_SDK
    default 10
    range 1 100
    help
        At any given time we will wait for this many responses. This will correlate to the rate at which the shadow actions are requested

config AWS_IOT_SHADOW_MAX_SIMULTANEOUS_THINGNAMES
    int "Maximum simultaneous Thing Name operations"
    depends on AWS_IOT_SDK
    default 10
    range 1 100
    help
       We could perform shadow action on any thing Name and this is maximum Thing Names we can act on at any given time

config AWS_IOT_SHADOW_MAX_JSON_TOKEN_EXPECTED
    int "Maximum expected JSON tokens"
    depends on AWS_IOT_SDK
    default 120
    help
        These are the max tokens that is expected to be in the Shadow JSON document. Includes the metadata which is published

config AWS_IOT_SHADOW_MAX_SHADOW_TOPIC_LENGTH_WITHOUT_THINGNAME
    int "Maximum topic length (not including Thing Name)"
    depends on AWS_IOT_SDK
    default 60
    range 10 1000
    help
       All shadow actions have to be published or subscribed to a topic which is of the format $aws/things/{thingName}/shadow/update/accepted. This refers to the size of the topic without the Thing Name

config AWS_IOT_SHADOW_MAX_SIZE_OF_THING_NAME
    int "Maximum Thing Name length"
    depends on AWS_IOT_SDK
    default 20
    range 4 1000
    help
        Maximum length of a Thing Name.

endmenu  # Thing Shadow
```

## components/bootloader/Kconfig.app_rollback
```kconfig
menu "Application Rollback"

    config BOOTLOADER_APP_ROLLBACK_ENABLE
        bool "Enable app rollback support"
        default n
        help
            After updating the app, the bootloader runs a new app with the "ESP_OTA_IMG_PENDING_VERIFY" state set.
            This state prevents the re-run of this app. After the first boot of the new app in the user code, the
            function should be called to confirm the operability of the app or vice versa about its non-operability.
            If the app is working, then it is marked as valid. Otherwise, it is marked as not valid and rolls back to
            the previous working app. A reboot is performed, and the app is booted before the software update.
            Note: If during the first boot a new app the power goes out or the WDT works, then roll back will happen.
            Rollback is possible only between the apps with the same security versions.

    config BOOTLOADER_APP_ANTI_ROLLBACK
        bool "Enable app anti-rollback support"
        depends on BOOTLOADER_APP_ROLLBACK_ENABLE
        default n
        help
            This option prevents rollback to previous firmware/application image with lower security version.

    config BOOTLOADER_APP_SECURE_VERSION
        int "eFuse secure version of app"
        depends on BOOTLOADER_APP_ANTI_ROLLBACK
        default 0
        help
            The secure version is the sequence number stored in the header of each firmware.
            The security version is set in the bootloader, version is recorded in the eFuse field
            as the number of set ones. The allocated number of bits in the efuse field
            for storing the security version is limited (see BOOTLOADER_APP_SEC_VER_SIZE_EFUSE_FIELD option).

            Bootloader: When bootloader selects an app to boot, an app is selected that has
            a security version greater or equal that recorded in eFuse field.
            The app is booted with a higher (or equal) secure version.

            The security version is worth increasing if in previous versions there is
            a significant vulnerability and their use is not acceptable.

            Your partition table should has a scheme with ota_0 + ota_1 (without factory).

    config BOOTLOADER_APP_SEC_VER_SIZE_EFUSE_FIELD
        int "Size of the efuse secure version field"
        depends on BOOTLOADER_APP_ANTI_ROLLBACK
        range 1 32 if IDF_TARGET_ESP32
        default 32 if IDF_TARGET_ESP32
        range 1 4 if IDF_TARGET_ESP32C2
        default 4 if IDF_TARGET_ESP32C2
        range 1 16
        default 16
        help
            The size of the efuse secure version field.
            Its length is limited to 32 bits for ESP32 and 16 bits for ESP32-S2.
            This determines how many times the security version can be increased.

    config BOOTLOADER_EFUSE_SECURE_VERSION_EMULATE
        bool "Emulate operations with efuse secure version(only test)"
        default n
        depends on BOOTLOADER_APP_ANTI_ROLLBACK
        select EFUSE_VIRTUAL
        select EFUSE_VIRTUAL_KEEP_IN_FLASH
        help
            This option allows to emulate read/write operations with all eFuses and efuse secure version.
            It allows to test anti-rollback implementation without permanent write eFuse bits.
            There should be an entry in partition table with following details: `emul_efuse, data, efuse, , 0x2000`.

            This option enables: EFUSE_VIRTUAL and EFUSE_VIRTUAL_KEEP_IN_FLASH.

endmenu
```

## components/bootloader/Kconfig.bootloader_rollback
```kconfig
menu "Recovery Bootloader and Rollback"

    config BOOTLOADER_RECOVERY_ENABLE
        bool "Enable Recovery Bootloader"
        depends on SOC_RECOVERY_BOOTLOADER_SUPPORTED
        default n
        help
            The recovery bootloader feature is implemented in the ROM bootloader. It is required for safe OTA
            updates of the bootloader. The feature is activated when the eFuse field
            (ESP_EFUSE_RECOVERY_BOOTLOADER_FLASH_SECTOR) is set, which defines the flash address of the
            recovery bootloader. If activated and the primary bootloader fails to load, the ROM bootloader
            will attempt to load the recovery bootloader from the address specified in eFuse.

    config BOOTLOADER_RECOVERY_OFFSET
        hex "Recovery Bootloader Flash Offset"
        depends on BOOTLOADER_RECOVERY_ENABLE
        default 0x3F0000
        range 0x0 0xFFE000
        help
            Flash address where the recovery bootloader is stored.
            This value must be written to the eFuse field (ESP_EFUSE_RECOVERY_BOOTLOADER_FLASH_SECTOR)
            to activate the recovery bootloader in the ROM bootloader. The eFuse can be programmed
            using espefuse.py or in the user application with the API esp_efuse_set_recovery_bootloader_offset().
            Setting this value in the config allows parttool.py to verify that it does not overlap with existing
            partitions in the partition table.

            The address must be a multiple of the flash sector size (0x1000 bytes).
            The eFuse field stores the offset in sectors.
            If the feature is no longer needed or unused, you can burn the 0xFFF value to disable this feature in
            the ROM bootloader.

    config BOOTLOADER_ANTI_ROLLBACK_ENABLE
        bool "Enable bootloader rollback support"
        depends on BOOTLOADER_RECOVERY_ENABLE
        default n
        help
            This option prevents rollback to previous bootloader image with lower security version.

    config BOOTLOADER_SECURE_VERSION
        int "Secure version of bootloader"
        depends on BOOTLOADER_ANTI_ROLLBACK_ENABLE
        default 0
        range 0 4
        help
            The secure version is the sequence number stored in the header of each bootloader.

            The ROM Bootloader which runs the 2nd stage bootloader (PRIMARY or RECOVERY) checks that
            the security version is greater or equal that recorded in the eFuse field.
            Bootloaders that have a secure version in the image < secure version in efuse will not boot.

            The security version is worth increasing if in previous versions there is
            a significant vulnerability and their use is not acceptable.

endmenu
```

## components/bootloader/Kconfig.log
```kconfig
menu "Log"

    choice BOOTLOADER_LOG_VERSION
        prompt "Log version"
        help
            Select the log version to be used by the ESP log component.
            The app log version (CONFIG_LOG_VERSION) controls the version used in the bootloader,
            preventing the selection of different versions.
            For description of V1 and V2 see CONFIG_LOG_VERSION.

        config BOOTLOADER_LOG_VERSION_1
            bool "V1" if LOG_VERSION_1
        config BOOTLOADER_LOG_VERSION_2
            bool "V2" if LOG_VERSION_2
    endchoice

    config BOOTLOADER_LOG_VERSION
        int
        default 1 if BOOTLOADER_LOG_VERSION_1
        default 2 if BOOTLOADER_LOG_VERSION_2
        help
            This configuration sets the log version number based on the chosen log version.

    choice BOOTLOADER_LOG_LEVEL
        bool "Bootloader log verbosity"
        default BOOTLOADER_LOG_LEVEL_INFO
        help
            Specify how much output to see in bootloader logs.

        config BOOTLOADER_LOG_LEVEL_NONE
            bool "No output"
        config BOOTLOADER_LOG_LEVEL_ERROR
            bool "Error"
        config BOOTLOADER_LOG_LEVEL_WARN
            bool "Warning"
        config BOOTLOADER_LOG_LEVEL_INFO
            bool "Info"
        config BOOTLOADER_LOG_LEVEL_DEBUG
            bool "Debug"
        config BOOTLOADER_LOG_LEVEL_VERBOSE
            bool "Verbose"
    endchoice

    config BOOTLOADER_LOG_LEVEL
        int
        default 0 if BOOTLOADER_LOG_LEVEL_NONE
        default 1 if BOOTLOADER_LOG_LEVEL_ERROR
        default 2 if BOOTLOADER_LOG_LEVEL_WARN
        default 3 if BOOTLOADER_LOG_LEVEL_INFO
        default 4 if BOOTLOADER_LOG_LEVEL_DEBUG
        default 5 if BOOTLOADER_LOG_LEVEL_VERBOSE

    rsource "Kconfig.log.format"

    rsource "Kconfig.log.settings"

endmenu
```
